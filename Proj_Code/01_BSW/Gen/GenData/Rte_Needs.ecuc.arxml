AUTOSAR XML (schema 4-0-3)
package /DaVinci_Project
  module config Rte
    7 x RteBswModuleInstance:
      BswM
        BswM_MainFunctionTimingEvent0 (RteBswEventToTaskMapping): RteBswUsedOsAlarmRef=Os/Rte_Al_TE2_Bsw_5ms_Task_Core0_0_10ms
      Det
      Dio
      EcuM
        EcuM_MainFunctionTimingEvent0 (RteBswEventToTaskMapping): RteBswUsedOsAlarmRef=Os/Rte_Al_TE2_Bsw_5ms_Task_Core0_0_10ms
      Irq
      Mcu
      Port
    7 x RteSwComponentInstance:
      BswM_EcuSwComposition
        Timer_BswM_MainFunction (RteEventToTaskMapping): RteUsedOsAlarmRef=Os/Rte_Al_TE2_Bsw_5ms_Task_Core0_0_10ms
      Det_EcuSwComposition
      EcuM_EcuSwComposition
        Timer_EcuM_MainFunction (RteEventToTaskMapping): RteUsedOsAlarmRef=Os/Rte_Al_TE2_Bsw_5ms_Task_Core0_0_10ms
      Os_OsCore{0..2}_swc_EcuSwComposition
      Test_Led_EcuSwComposition
        TMT_1_Test_Runable_1s (RteEventToTaskMapping): RteUsedOsEventRef=Rte_Ev_Run_Test_Led_Test_Runable_1s, RteUsedOsAlarmRef=Os/Rte_Al_TE_Test_Led_Test_Runable_1s
    RteOsInteraction
      Rte_Al_TE_Test_Led_Test_Runable_1s (RteUsedOsActivation): RteExpectedActivationOffset=0, RteActivationOsAlarmRef=Os/Rte_Al_TE_Test_Led_Test_Runable_1s, RteActivationOsTaskRef=App_10ms_Task_Core0
      Rte_Al_TE2_Bsw_5ms_Task_Core0_0_10ms (RteUsedOsActivation): RteExpectedActivationOffset=0, RteActivationOsAlarmRef=Os/Rte_Al_TE2_Bsw_5ms_Task_Core0_0_10ms, RteActivationOsTaskRef=Bsw_5ms_Task_Core0
  module config NvM
  module config Os
    App_10ms_Task_Core0 (OsTask): OsTaskActivation=1, OsTaskPriority=0, OsTaskSchedule=FULL, OsTaskEventRef=Rte_Ev_Run_Test_Led_Test_Runable_1s
    Rte_Al_TE_Test_Led_Test_Runable_1s (OsAlarm): OsAlarmCounterRef=SystemTimer_Core0
      OsAlarmAction
        OsAlarmSetEvent: OsAlarmSetEventRef=Rte_Ev_Run_Test_Led_Test_Runable_1s, OsAlarmSetEventTaskRef=App_10ms_Task_Core0
    3 x OsTask, all with OsTaskActivation=1, OsTaskPriority=0:
      App_10ms_Task_Core1: OsTaskSchedule=FULL, OsTaskAccessingApplication=SystemApplication_OsCore0
      App_10ms_Task_Core2: OsTaskSchedule=FULL, OsTaskAccessingApplication=SystemApplication_OsCore0
      Bsw_5ms_Task_Core0: OsTaskSchedule=NON
    Rte_Al_TE2_Bsw_5ms_Task_Core0_0_10ms (OsAlarm): OsAlarmCounterRef=SystemTimer_Core0
      OsAlarmAction
        OsAlarmActivateTask: OsAlarmActivateTaskRef=Bsw_5ms_Task_Core0
    Rte_Ev_Run_Test_Led_Test_Runable_1s (OsEvent)
    3 x OsApplication, all with OsTrusted=true:
      SystemApplication_OsCore0: OsAppTaskRef=App_10ms_Task_Core0, OsAppAlarmRef=Os/Rte_Al_TE_Test_Led_Test_Runable_1s, OsAppTaskRef=Bsw_5ms_Task_Core0, OsAppAlarmRef=Os/Rte_Al_TE2_Bsw_5ms_Task_Core0_0_10ms
      SystemApplication_OsCore1
      SystemApplication_OsCore2
  module config EcuC
  ecuc value collection DaVinci_Project: ecuc-values=[Com, Rte, Os, EcuC, NvM]
