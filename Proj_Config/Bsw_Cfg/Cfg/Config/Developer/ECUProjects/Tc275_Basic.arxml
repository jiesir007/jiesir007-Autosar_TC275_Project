AUTOSAR XML (schema 00046)
package /ECUCompositionTypes
  composition sw component type ECU_Composition
    component Test_Led: type=Test_Led
package /EndToEndProtections
  end to end protection set EndToEndProtectionSet
package /Systems
  system Tc275_Basic
    root-software-compositions:
      root sw composition prototype EcuSwComposition: software-composition=ECU_Composition
