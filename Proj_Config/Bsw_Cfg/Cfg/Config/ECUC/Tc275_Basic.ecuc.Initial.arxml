AUTOSAR XML (schema 00047)
package /InitialEcuC
  ecuc value collection InitialEcuC
