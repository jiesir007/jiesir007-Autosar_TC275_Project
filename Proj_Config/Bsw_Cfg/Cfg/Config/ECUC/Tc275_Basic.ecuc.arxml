AUTOSAR XML (schema 00047)
package /ActiveEcuC
  ecuc value collection ActiveEcuC: ecu-extract=SYSTEM, ecuc-values=[vLinkGen, vBRS, BswM, EcuM, vBaseEnv, Det, Rte, Os, EcuC, vSet, Resource, Mcu, Port, Irq, Dio]
