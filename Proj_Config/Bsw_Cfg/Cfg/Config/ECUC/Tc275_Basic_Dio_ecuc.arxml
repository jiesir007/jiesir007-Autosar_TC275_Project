AUTOSAR XML (schema 00047)
package /Dio
  module config Dio: implementation-config-variant=VARIANT-POST-BUILD-LOADABLE, module-description=Dio_Impl
    DioConfig_0 (DioConfig)
      DioPort_0 (DioPort): DioPortId=0
    DioGeneral:
      DioDevErrorDetect = false
      DioFlipChannelApi = false
      DioPBFixedAddress = false
      DioRunningInUser0Mode = false
      DioUserModeInitApiEnable = false
      DioUserModeRuntimeApiEnable = false
      DioVersionInfoApi = false
    DioSafety: DioInitCheckApi=false, DioSafetyEnable=false
    CommonPublishedInformation:
      ArMajorVersion = 2
      ArMinorVersion = 5
      ArPatchVersion = 0
      ModuleId = 120
      Release = _TRICORE_TC275
      SwMajorVersion = 3
      SwMinorVersion = 3
      SwPatchVersion = 0
      VendorId = 17
