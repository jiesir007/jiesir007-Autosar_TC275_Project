AUTOSAR XML (schema 00047)
package /ActiveEcuC
  module config EcuM: implementation-config-variant=VARIANT-PRE-COMPILE, module-description=EcuM_Impl
    EcuMFlexGeneral: EcuMAlarmClockPresent=false, EcuMResetLoopDetection=false, EcuMEnableDefBehaviour=false
    EcuMGeneral:
      EcuMDevErrorDetect = true
      EcuMIncludeDem = true
      EcuMIncludeDet = true
      EcuMVersionInfoApi = false
      EcuMMainFunctionPeriod = 0.01
      EcuMDeferredBswMNotification = false
      EcuMSlaveCoreHandling = true
      EcuMEnableFixBehavior = false
      EcuMNonChannelWakeupInRun = false
      EcuMGeneration: EcuMOutOfBoundsWriteSanitizer=false, EcuMOutOfBoundsReadSanitizer=false, EcuMInterfacesForDeactivatedData=false
    EcuMConfiguration
      EcuMCommonConfiguration: EcuMConfigConsistencyHash=14972011532815700707, EcuMDefaultAppMode=OSDEFAULTAPPMODE, EcuMOSResource=OsResource_Core0
        5 x EcuMWakeupSource, all with EcuMValidationTimeout=0, EcuMCheckWakeupTimeout=0, EcuMWakeupSourcePolling=false:
          ECUM_WKSOURCE_POWER: EcuMWakeupSourceId=0
          ECUM_WKSOURCE_RESET: EcuMWakeupSourceId=1
          ECUM_WKSOURCE_INTERNAL_RESET: EcuMWakeupSourceId=2
          ECUM_WKSOURCE_INTERNAL_WDG: EcuMWakeupSourceId=3
          ECUM_WKSOURCE_EXTERNAL_WDG: EcuMWakeupSourceId=4
        EcuMDefaultShutdownTarget: EcuMDefaultState=EcuMStateOff
        EcuMDriverInitListZero
          4 x EcuMDriverInitItem:
            BswM_InitMemory: index=0, EcuMModuleID=BswM, EcuMModuleService=BswM_InitMemory, EcuMModuleHeader=BswM.h
            Det_InitMemory: index=1, EcuMModuleID=Det, EcuMModuleService=Det_InitMemory, EcuMModuleHeader=Det.h
            Rte_InitMemory: index=2, EcuMModuleID=Rte, EcuMModuleService=Rte_InitMemory, EcuMModuleHeader=Rte_Main.h
            Det_Init: index=3, EcuMModuleID=Det, EcuMModuleService=Det_Init, EcuMModuleHeader=Det.h
        EcuMDriverInitListOne
          5 x EcuMDriverInitItem:
            Mcu_Init: index=0, EcuMModuleID=Mcu, EcuMModuleService=Mcu_Init, EcuMModuleHeader=Mcu.h
            Mcu_Init_AdditionalCode: index=1, EcuMModuleID=Code, EcuMAdditionalInitCode=Mcu_InitClock(0); while (MCU_PLL_LOCKED != Mcu_GetPllStatus()); Mcu_DistributePllClock();, EcuMModuleHeader=Mcu.h
            Port_Init: index=2, EcuMModuleID=Port, EcuMModuleService=Port_Init, EcuMModuleHeader=Port.h
            BswM_PreInit: index=3, EcuMModuleID=BswM, EcuMModuleService=BswM_PreInit, EcuMModuleHeader=BswM.h
            Dio_Init: index=4, EcuMModuleID=Dio, EcuMModuleService=Dio_Init, EcuMModuleHeader=Dio.h
      EcuMFlexConfiguration: EcuMNormalMcuModeRef=McuModeSettingConf_0
        3 x EcuMResetMode:
          ECUM_RESET_MCU: EcuMResetModeId=0
          ECUM_RESET_WDG: EcuMResetModeId=1
          ECUM_RESET_IO: EcuMResetModeId=2
        4 x EcuMShutdownCause:
          ECUM_CAUSE_UNKNOWN: EcuMShutdownCauseId=0
          ECUM_CAUSE_ECU_STATE: EcuMShutdownCauseId=1
          ECUM_CAUSE_WDGM: EcuMShutdownCauseId=2
          ECUM_CAUSE_DCM: EcuMShutdownCauseId=3
        ECUM_RESET_WAKEUP (EcuMResetMode): EcuMResetModeId=3
