AUTOSAR XML (schema 00047)
package /Port
  module config Port: implementation-config-variant=VARIANT-POST-BUILD-LOADABLE, module-description=Port_Impl
    PortConfigSet_0 (PortConfigSet)
      14 x PortContainer:
        PortContainer_0: PortNumber=0, PortNumberOfPortPins=13
          13 x PortPin, all with PortPinAnalogInput=DISABLE, PortPinControllerSelect=DISABLE, PortPinDirection=PORT_PIN_IN, PortPinDirectionChangeable=false, PortPinDriverStrength=PORT_CMOS_SPEED_GRADE1, PortPinInitialMode=PORT_PIN_MODE_GPIO, PortPinInputCharacteristic=PORT_PIN_IN_PULL_UP, PortPinInputHysteresis=false, PortPinLevelValue=PORT_PIN_LEVEL_LOW, PortPinMode=PORT_PIN_MODE_ALL, PortPinModeChangeable=false, PortPinPadLevel=PORT_PDR_CMOS_AUTOMOTIVE_LEVEL:
            PortPin_0: PortPinId=0, PortPinSymbolicName=PORT_0_PIN_0
            PortPin_1: PortPinId=1, PortPinSymbolicName=PORT_0_PIN_1
            PortPin_{10..12}: PortPinId={10..12}, PortPinSymbolicName=PORT_0_PIN_{10..12}
            PortPin_{2..9}: PortPinId={2..9}, PortPinSymbolicName=PORT_0_PIN_{2..9}
        PortContainer_1: PortNumber=2, PortNumberOfPortPins=9
          9 x PortPin, all with PortPinAnalogInput=DISABLE, PortPinControllerSelect=DISABLE, PortPinDirection=PORT_PIN_IN, PortPinDirectionChangeable=false, PortPinDriverStrength=PORT_CMOS_SPEED_GRADE1, PortPinInitialMode=PORT_PIN_MODE_GPIO, PortPinInputCharacteristic=PORT_PIN_IN_PULL_UP, PortPinInputHysteresis=false, PortPinLevelValue=PORT_PIN_LEVEL_LOW, PortPinMode=PORT_PIN_MODE_ALL, PortPinModeChangeable=false, PortPinPadLevel=PORT_PDR_CMOS_AUTOMOTIVE_LEVEL:
            PortPin_0: PortPinId=32, PortPinSymbolicName=PORT_2_PIN_0
            PortPin_1: PortPinId=33, PortPinSymbolicName=PORT_2_PIN_1
            PortPin_2: PortPinId=34, PortPinSymbolicName=PORT_2_PIN_2
            PortPin_3: PortPinId=35, PortPinSymbolicName=PORT_2_PIN_3
            PortPin_4: PortPinId=36, PortPinSymbolicName=PORT_2_PIN_4
            PortPin_5: PortPinId=37, PortPinSymbolicName=PORT_2_PIN_5
            PortPin_6: PortPinId=38, PortPinSymbolicName=PORT_2_PIN_6
            PortPin_7: PortPinId=39, PortPinSymbolicName=PORT_2_PIN_7
            PortPin_8: PortPinId=40, PortPinSymbolicName=PORT_2_PIN_8
        PortContainer_10: PortNumber=23, PortNumberOfPortPins=6
          6 x PortPin, all with PortPinAnalogInput=DISABLE, PortPinControllerSelect=DISABLE, PortPinDirection=PORT_PIN_IN, PortPinDirectionChangeable=false, PortPinDriverStrength=PORT_CMOS_SPEED_GRADE1, PortPinInitialMode=PORT_PIN_MODE_GPIO, PortPinInputCharacteristic=PORT_PIN_IN_PULL_UP, PortPinInputHysteresis=false, PortPinLevelValue=PORT_PIN_LEVEL_LOW, PortPinMode=PORT_PIN_MODE_ALL, PortPinModeChangeable=false, PortPinPadLevel=PORT_PDR_CMOS_AUTOMOTIVE_LEVEL:
            PortPin_0: PortPinId=368, PortPinSymbolicName=PORT_23_PIN_0
            PortPin_1: PortPinId=369, PortPinSymbolicName=PORT_23_PIN_1
            PortPin_2: PortPinId=370, PortPinSymbolicName=PORT_23_PIN_2
            PortPin_3: PortPinId=371, PortPinSymbolicName=PORT_23_PIN_3
            PortPin_4: PortPinId=372, PortPinSymbolicName=PORT_23_PIN_4
            PortPin_5: PortPinId=373, PortPinSymbolicName=PORT_23_PIN_5
        PortContainer_11: PortNumber=32, PortNumberOfPortPins=4
          4 x PortPin, all with PortPinAnalogInput=DISABLE, PortPinControllerSelect=DISABLE, PortPinDirection=PORT_PIN_IN, PortPinDirectionChangeable=false, PortPinDriverStrength=PORT_CMOS_SPEED_GRADE1, PortPinInitialMode=PORT_PIN_MODE_GPIO, PortPinInputCharacteristic=PORT_PIN_IN_PULL_UP, PortPinInputHysteresis=false, PortPinLevelValue=PORT_PIN_LEVEL_LOW, PortPinMode=PORT_PIN_MODE_ALL, PortPinModeChangeable=false, PortPinPadLevel=PORT_PDR_CMOS_AUTOMOTIVE_LEVEL:
            PortPin_0: PortPinId=512, PortPinSymbolicName=PORT_32_PIN_0
            PortPin_1: PortPinId=514, PortPinSymbolicName=PORT_32_PIN_2
            PortPin_2: PortPinId=515, PortPinSymbolicName=PORT_32_PIN_3
            PortPin_3: PortPinId=516, PortPinSymbolicName=PORT_32_PIN_4
        PortContainer_12: PortNumber=33, PortNumberOfPortPins=14
          14 x PortPin, all with PortPinAnalogInput=DISABLE, PortPinControllerSelect=DISABLE, PortPinDirection=PORT_PIN_IN, PortPinDirectionChangeable=false, PortPinDriverStrength=PORT_CMOS_SPEED_GRADE1, PortPinInitialMode=PORT_PIN_MODE_GPIO, PortPinInputCharacteristic=PORT_PIN_IN_PULL_UP, PortPinInputHysteresis=false, PortPinLevelValue=PORT_PIN_LEVEL_LOW, PortPinMode=PORT_PIN_MODE_ALL, PortPinModeChangeable=false, PortPinPadLevel=PORT_PDR_CMOS_AUTOMOTIVE_LEVEL:
            PortPin_0: PortPinId=528, PortPinSymbolicName=PORT_33_PIN_0
            PortPin_1: PortPinId=529, PortPinSymbolicName=PORT_33_PIN_1
            PortPin_10: PortPinId=538, PortPinSymbolicName=PORT_33_PIN_10
            PortPin_11: PortPinId=539, PortPinSymbolicName=PORT_33_PIN_11
            PortPin_12: PortPinId=540, PortPinSymbolicName=PORT_33_PIN_12
            PortPin_13: PortPinId=541, PortPinSymbolicName=PORT_33_PIN_13
            PortPin_2: PortPinId=530, PortPinSymbolicName=PORT_33_PIN_2
            PortPin_3: PortPinId=531, PortPinSymbolicName=PORT_33_PIN_3
            PortPin_4: PortPinId=532, PortPinSymbolicName=PORT_33_PIN_4
            PortPin_5: PortPinId=533, PortPinSymbolicName=PORT_33_PIN_5
            PortPin_6: PortPinId=534, PortPinSymbolicName=PORT_33_PIN_6
            PortPin_7: PortPinId=535, PortPinSymbolicName=PORT_33_PIN_7
            PortPin_8: PortPinId=536, PortPinSymbolicName=PORT_33_PIN_8
            PortPin_9: PortPinId=537, PortPinSymbolicName=PORT_33_PIN_9
        PortContainer_13: PortNumber=40, PortNumberOfPortPins=10
          10 x PortPin, all with PortPinAnalogInput=DISABLE, PortPinControllerSelect=DISABLE, PortPinDirection=PORT_PIN_IN, PortPinDirectionChangeable=false, PortPinDriverStrength=PORT_CMOS_SPEED_GRADE1, PortPinInitialMode=PORT_PIN_MODE_GPIO, PortPinInputCharacteristic=PORT_PIN_IN_PULL_UP, PortPinInputHysteresis=true, PortPinLevelValue=PORT_PIN_LEVEL_LOW, PortPinModeChangeable=false, PortPinPadLevel=PORT_PDR_CMOS_AUTOMOTIVE_LEVEL:
            PortPin_0: PortPinId=640, PortPinSymbolicName=PORT_40_PIN_0
            PortPin_1: PortPinId=641, PortPinSymbolicName=PORT_40_PIN_1
            PortPin_2: PortPinId=642, PortPinSymbolicName=PORT_40_PIN_2
            PortPin_3: PortPinId=643, PortPinSymbolicName=PORT_40_PIN_3
            PortPin_4: PortPinId=644, PortPinSymbolicName=PORT_40_PIN_4
            PortPin_5: PortPinId=645, PortPinSymbolicName=PORT_40_PIN_5
            PortPin_6: PortPinId=646, PortPinSymbolicName=PORT_40_PIN_6
            PortPin_7: PortPinId=647, PortPinSymbolicName=PORT_40_PIN_7
            PortPin_8: PortPinId=648, PortPinSymbolicName=PORT_40_PIN_8
            PortPin_9: PortPinId=649, PortPinSymbolicName=PORT_40_PIN_9
        PortContainer_2: PortNumber=10, PortNumberOfPortPins=9
          9 x PortPin, all with PortPinAnalogInput=DISABLE, PortPinControllerSelect=DISABLE, PortPinDirection=PORT_PIN_IN, PortPinDirectionChangeable=false, PortPinDriverStrength=PORT_CMOS_SPEED_GRADE1, PortPinInitialMode=PORT_PIN_MODE_GPIO, PortPinInputCharacteristic=PORT_PIN_IN_PULL_UP, PortPinInputHysteresis=false, PortPinLevelValue=PORT_PIN_LEVEL_LOW, PortPinMode=PORT_PIN_MODE_ALL, PortPinModeChangeable=false, PortPinPadLevel=PORT_PDR_CMOS_AUTOMOTIVE_LEVEL:
            PortPin_0: PortPinId=160, PortPinSymbolicName=PORT_10_PIN_0
            PortPin_1: PortPinId=161, PortPinSymbolicName=PORT_10_PIN_1
            PortPin_2: PortPinId=162, PortPinSymbolicName=PORT_10_PIN_2
            PortPin_3: PortPinId=163, PortPinSymbolicName=PORT_10_PIN_3
            PortPin_4: PortPinId=164, PortPinSymbolicName=PORT_10_PIN_4
            PortPin_5: PortPinId=165, PortPinSymbolicName=PORT_10_PIN_5
            PortPin_6: PortPinId=166, PortPinSymbolicName=PORT_10_PIN_6
            PortPin_7: PortPinId=167, PortPinSymbolicName=PORT_10_PIN_7
            PortPin_8: PortPinId=168, PortPinSymbolicName=PORT_10_PIN_8
        PortContainer_3: PortNumber=11, PortNumberOfPortPins=7
          7 x PortPin, all with PortPinAnalogInput=DISABLE, PortPinControllerSelect=DISABLE, PortPinDirection=PORT_PIN_IN, PortPinDirectionChangeable=false, PortPinDriverStrength=PORT_CMOS_SPEED_GRADE1, PortPinInitialMode=PORT_PIN_MODE_GPIO, PortPinInputCharacteristic=PORT_PIN_IN_PULL_UP, PortPinInputHysteresis=false, PortPinLevelValue=PORT_PIN_LEVEL_LOW, PortPinMode=PORT_PIN_MODE_ALL, PortPinModeChangeable=false, PortPinPadLevel=PORT_PDR_CMOS_AUTOMOTIVE_LEVEL:
            PortPin_0: PortPinId=178, PortPinSymbolicName=PORT_11_PIN_2
            PortPin_1: PortPinId=179, PortPinSymbolicName=PORT_11_PIN_3
            PortPin_2: PortPinId=182, PortPinSymbolicName=PORT_11_PIN_6
            PortPin_3: PortPinId=185, PortPinSymbolicName=PORT_11_PIN_9
            PortPin_4: PortPinId=186, PortPinSymbolicName=PORT_11_PIN_10
            PortPin_5: PortPinId=187, PortPinSymbolicName=PORT_11_PIN_11
            PortPin_6: PortPinId=188, PortPinSymbolicName=PORT_11_PIN_12
        PortContainer_4: PortNumber=13, PortNumberOfPortPins=4
          PortLVDSM_0 (PortLVDSM): PortLVDSMPinPair=Pin_0_Pin_1, PortPadSupplyVoltage=PAD_SUPPLY_5V
          PortLVDSM_1 (PortLVDSM): PortLVDSMPinPair=Pin_2_Pin_3, PortPadSupplyVoltage=PAD_SUPPLY_5V
          4 x PortPin, all with PortPinAnalogInput=DISABLE, PortPinControllerSelect=DISABLE, PortPinDirection=PORT_PIN_IN, PortPinDirectionChangeable=false, PortPinDriverStrength=PORT_CMOS_SPEED_GRADE1, PortPinInitialMode=PORT_PIN_MODE_GPIO, PortPinInputCharacteristic=PORT_PIN_IN_PULL_UP, PortPinInputHysteresis=false, PortPinLevelValue=PORT_PIN_LEVEL_LOW, PortPinMode=PORT_PIN_MODE_ALL, PortPinModeChangeable=false, PortPinPadLevel=PORT_PDR_CMOS_AUTOMOTIVE_LEVEL:
            PortPin_0: PortPinId=208, PortPinSymbolicName=PORT_13_PIN_0
            PortPin_1: PortPinId=209, PortPinSymbolicName=PORT_13_PIN_1
            PortPin_2: PortPinId=210, PortPinSymbolicName=PORT_13_PIN_2
            PortPin_3: PortPinId=211, PortPinSymbolicName=PORT_13_PIN_3
        PortContainer_5: PortNumber=14, PortNumberOfPortPins=11
          11 x PortPin, all with PortPinAnalogInput=DISABLE, PortPinControllerSelect=DISABLE, PortPinDirection=PORT_PIN_IN, PortPinDirectionChangeable=false, PortPinDriverStrength=PORT_CMOS_SPEED_GRADE1, PortPinInitialMode=PORT_PIN_MODE_GPIO, PortPinInputCharacteristic=PORT_PIN_IN_PULL_UP, PortPinLevelValue=PORT_PIN_LEVEL_LOW, PortPinMode=PORT_PIN_MODE_ALL, PortPinModeChangeable=false, PortPinPadLevel=PORT_PDR_CMOS_AUTOMOTIVE_LEVEL:
            PortPin_0: PortPinId=224, PortPinInputHysteresis=false, PortPinSymbolicName=PORT_14_PIN_0
            PortPin_1: PortPinId=225, PortPinInputHysteresis=false, PortPinSymbolicName=PORT_14_PIN_1
            PortPin_10: PortPinId=234, PortPinInputHysteresis=false, PortPinSymbolicName=PORT_14_PIN_10
            PortPin_2: PortPinId=226, PortPinInputHysteresis=true, PortPinSymbolicName=PORT_14_PIN_2
            PortPin_3: PortPinId=227, PortPinInputHysteresis=false, PortPinSymbolicName=PORT_14_PIN_3
            PortPin_4: PortPinId=228, PortPinInputHysteresis=true, PortPinSymbolicName=PORT_14_PIN_4
            PortPin_5: PortPinId=229, PortPinInputHysteresis=false, PortPinSymbolicName=PORT_14_PIN_5
            PortPin_6: PortPinId=230, PortPinInputHysteresis=false, PortPinSymbolicName=PORT_14_PIN_6
            PortPin_7: PortPinId=231, PortPinInputHysteresis=false, PortPinSymbolicName=PORT_14_PIN_7
            PortPin_8: PortPinId=232, PortPinInputHysteresis=false, PortPinSymbolicName=PORT_14_PIN_8
            PortPin_9: PortPinId=233, PortPinInputHysteresis=false, PortPinSymbolicName=PORT_14_PIN_9
        PortContainer_6: PortNumber=15, PortNumberOfPortPins=9
          9 x PortPin, all with PortPinAnalogInput=DISABLE, PortPinControllerSelect=DISABLE, PortPinDirection=PORT_PIN_IN, PortPinDirectionChangeable=false, PortPinDriverStrength=PORT_CMOS_SPEED_GRADE1, PortPinInitialMode=PORT_PIN_MODE_GPIO, PortPinInputCharacteristic=PORT_PIN_IN_PULL_UP, PortPinLevelValue=PORT_PIN_LEVEL_LOW, PortPinMode=PORT_PIN_MODE_ALL, PortPinModeChangeable=false, PortPinPadLevel=PORT_PDR_CMOS_AUTOMOTIVE_LEVEL:
            PortPin_0: PortPinId=240, PortPinInputHysteresis=false, PortPinSymbolicName=PORT_15_PIN_0
            PortPin_1: PortPinId=241, PortPinInputHysteresis=true, PortPinSymbolicName=PORT_15_PIN_1
            PortPin_2: PortPinId=242, PortPinInputHysteresis=false, PortPinSymbolicName=PORT_15_PIN_2
            PortPin_3: PortPinId=243, PortPinInputHysteresis=false, PortPinSymbolicName=PORT_15_PIN_3
            PortPin_4: PortPinId=244, PortPinInputHysteresis=false, PortPinSymbolicName=PORT_15_PIN_4
            PortPin_5: PortPinId=245, PortPinInputHysteresis=false, PortPinSymbolicName=PORT_15_PIN_5
            PortPin_6: PortPinId=246, PortPinInputHysteresis=false, PortPinSymbolicName=PORT_15_PIN_6
            PortPin_7: PortPinId=247, PortPinInputHysteresis=false, PortPinSymbolicName=PORT_15_PIN_7
            PortPin_8: PortPinId=248, PortPinInputHysteresis=false, PortPinSymbolicName=PORT_15_PIN_8
        PortContainer_7: PortNumber=20, PortNumberOfPortPins=13
          13 x PortPin, all with PortPinAnalogInput=DISABLE, PortPinControllerSelect=DISABLE, PortPinDirection=PORT_PIN_IN, PortPinDirectionChangeable=false, PortPinDriverStrength=PORT_CMOS_SPEED_GRADE1, PortPinInitialMode=PORT_PIN_MODE_GPIO, PortPinInputCharacteristic=PORT_PIN_IN_PULL_UP, PortPinInputHysteresis=false, PortPinLevelValue=PORT_PIN_LEVEL_LOW, PortPinMode=PORT_PIN_MODE_ALL, PortPinModeChangeable=false, PortPinPadLevel=PORT_PDR_CMOS_AUTOMOTIVE_LEVEL:
            PortPin_0: PortPinId=320, PortPinSymbolicName=PORT_20_PIN_0
            PortPin_1: PortPinId=321, PortPinSymbolicName=PORT_20_PIN_1
            PortPin_10: PortPinId=332, PortPinSymbolicName=PORT_20_PIN_12
            PortPin_11: PortPinId=333, PortPinSymbolicName=PORT_20_PIN_13
            PortPin_12: PortPinId=334, PortPinSymbolicName=PORT_20_PIN_14
            PortPin_2: PortPinId=322, PortPinSymbolicName=PORT_20_PIN_2
            PortPin_3: PortPinId=323, PortPinSymbolicName=PORT_20_PIN_3
            PortPin_4: PortPinId=326, PortPinSymbolicName=PORT_20_PIN_6
            PortPin_5: PortPinId=327, PortPinSymbolicName=PORT_20_PIN_7
            PortPin_6: PortPinId=328, PortPinSymbolicName=PORT_20_PIN_8
            PortPin_7: PortPinId=329, PortPinSymbolicName=PORT_20_PIN_9
            PortPin_8: PortPinId=330, PortPinSymbolicName=PORT_20_PIN_10
            PortPin_9: PortPinId=331, PortPinSymbolicName=PORT_20_PIN_11
        PortContainer_8: PortNumber=21, PortNumberOfPortPins=8
          PortLVDSH_0 (PortLVDSH):
            PortLVDSHPinPair = Pin_2_Pin_3
            PortLVDSRxDisable = DISABLE_LVDS
            PortLVDSRxDisableController = PORT_CONTROLLED
            PortLVDSRxTerminationMode = INTERNAL_TERMINATION
          PortLVDSH_1 (PortLVDSH):
            PortLVDSHPinPair = Pin_4_Pin_5
            PortLVDSPowerDown = PORT_LVDS_POWER_DOWN
            PortLVDSPowerDownPullDown = DISABLE
            PortLVDSTxDisable = DISABLE_LVDS
            PortLVDSTxDisableController = PORT_CONTROLLED
            PortLVDSTxSignallingMode = IEEE_GENERAL_PURPOSE_LINK
          8 x PortPin, all with PortPinAnalogInput=DISABLE, PortPinControllerSelect=DISABLE, PortPinDirection=PORT_PIN_IN, PortPinDirectionChangeable=false, PortPinDriverStrength=PORT_CMOS_SPEED_GRADE1, PortPinInitialMode=PORT_PIN_MODE_GPIO, PortPinInputCharacteristic=PORT_PIN_IN_PULL_UP, PortPinInputHysteresis=true, PortPinLevelValue=PORT_PIN_LEVEL_LOW, PortPinMode=PORT_PIN_MODE_ALL, PortPinModeChangeable=false, PortPinPadLevel=PORT_PDR_CMOS_AUTOMOTIVE_LEVEL:
            PortPin_0: PortPinId=336, PortPinSymbolicName=PORT_21_PIN_0
            PortPin_1: PortPinId=337, PortPinSymbolicName=PORT_21_PIN_1
            PortPin_2: PortPinId=338, PortPinSymbolicName=PORT_21_PIN_2
            PortPin_3: PortPinId=339, PortPinSymbolicName=PORT_21_PIN_3
            PortPin_4: PortPinId=340, PortPinSymbolicName=PORT_21_PIN_4
            PortPin_5: PortPinId=341, PortPinSymbolicName=PORT_21_PIN_5
            PortPin_6: PortPinId=342, PortPinSymbolicName=PORT_21_PIN_6
            PortPin_7: PortPinId=343, PortPinSymbolicName=PORT_21_PIN_7
        PortContainer_9: PortNumber=22, PortNumberOfPortPins=4
          PortLVDSM_0 (PortLVDSM): PortLVDSMPinPair=Pin_0_Pin_1, PortPadSupplyVoltage=PAD_SUPPLY_5V
          PortLVDSM_1 (PortLVDSM): PortLVDSMPinPair=Pin_2_Pin_3, PortPadSupplyVoltage=PAD_SUPPLY_5V
          4 x PortPin, all with PortPinAnalogInput=DISABLE, PortPinControllerSelect=DISABLE, PortPinDirection=PORT_PIN_IN, PortPinDirectionChangeable=false, PortPinDriverStrength=PORT_CMOS_SPEED_GRADE1, PortPinInitialMode=PORT_PIN_MODE_GPIO, PortPinInputCharacteristic=PORT_PIN_IN_PULL_UP, PortPinInputHysteresis=false, PortPinLevelValue=PORT_PIN_LEVEL_LOW, PortPinMode=PORT_PIN_MODE_ALL, PortPinModeChangeable=false, PortPinPadLevel=PORT_PDR_CMOS_AUTOMOTIVE_LEVEL:
            PortPin_0: PortPinId=352, PortPinSymbolicName=PORT_22_PIN_0
            PortPin_1: PortPinId=353, PortPinSymbolicName=PORT_22_PIN_1
            PortPin_2: PortPinId=354, PortPinSymbolicName=PORT_22_PIN_2
            PortPin_3: PortPinId=355, PortPinSymbolicName=PORT_22_PIN_3
    PortSafety: PortInitCheckApi=false, PortSafetyEnable=false
    PortGeneral:
      PortDevErrorDetect = false
      PortPBFixedAddress = false
      PortRunningInUser0Mode = false
      PortSetPinDirectionApi = false
      PortSetPinModeApi = false
      PortUserModeInitApiEnable = false
      PortUserModeRuntimeApiEnable = false
      PortVersionInfoApi = false
    CommonPublishedInformation:
      ArMajorVersion = 3
      ArMinorVersion = 2
      ArPatchVersion = 0
      ModuleId = 124
      Release = _TRICORE_TC275
      SwMajorVersion = 3
      SwMinorVersion = 1
      SwPatchVersion = 2
      VendorId = 17
