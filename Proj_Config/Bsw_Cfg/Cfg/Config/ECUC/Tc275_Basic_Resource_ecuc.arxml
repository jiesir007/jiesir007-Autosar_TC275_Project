AUTOSAR XML (schema 00047)
package /Resource
  module config Resource: implementation-config-variant=VARIANT-PRE-COMPILE
    ResourceGeneral: ResourceSubDerivative=TC275TP_64F200N
