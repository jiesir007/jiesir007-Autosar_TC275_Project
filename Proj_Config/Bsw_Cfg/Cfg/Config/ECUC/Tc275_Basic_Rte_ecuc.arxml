AUTOSAR XML (schema 00047)
package /ActiveEcuC
  module config Rte: implementation-config-variant=VARIANT-PRE-COMPILE, module-description=Rte_Impl
    RteOsInteraction
      Rte_Al_TE2_Bsw_5ms_Task_Core0_0_10ms (RteUsedOsActivation):
        RteExpectedActivationOffset = 0
        RteExpectedTickDuration = 0
        RteActivationOsAlarmRef = Rte_Al_TE2_Bsw_5ms_Task_Core0_0_10ms
        RteActivationOsTaskRef = Bsw_5ms_Task_Core0
      Rte_Al_TE_Test_Led_Test_Runable_1s (RteUsedOsActivation):
        RteExpectedActivationOffset = 0
        RteExpectedTickDuration = 0
        RteActivationOsAlarmRef = Rte_Al_TE_Test_Led_Test_Runable_1s
        RteActivationOsTaskRef = App_10ms_Task_Core0
    RteGeneration:
      RteGenerationMode = COMPATIBILITY_MODE
      RteIocInteractionReturnValue = RTE_IOC
      RteValueRangeCheckEnabled = false
      RteCalibrationSupport = NONE
      RteCodeVendorId = 30
      RteDevErrorDetect = false
      RteDevErrorDetectUninit = false
      RteMeasurementSupport = false
      RteOptimizationMode = MEMORY
      RteVfbTraceEnabled = false
    RteInitializationBehavior: RteInitializationStrategy=RTE_INITIALIZATION_STRATEGY_AT_DATA_DECLARATION, RteSectionInitializationPolicy=INIT
    RteBswGeneral: RteSchMVersionInfoApi=false, RteUseComShadowSignalApi=false
    5 x RteBswModuleInstance:
      BswM: RteBswImplementationRef=BswM_Impl, RteBswModuleConfigurationRef=BswM
        BswM_MainFunctionTimingEvent0 (RteBswEventToTaskMapping):
          RteBswImmediateRestart = false
          RteBswPositionInTask = 0
          RteBswEventRef = BswM_MainFunctionTimingEvent0
          RteBswMappedToTaskRef = Bsw_5ms_Task_Core0
          RteBswUsedOsAlarmRef = Rte_Al_TE2_Bsw_5ms_Task_Core0_0_10ms
        BSWM_EXCLUSIVE_AREA_0 (RteBswExclusiveAreaImpl): RteExclusiveAreaImplMechanism=ALL_INTERRUPT_BLOCKING, RteBswExclusiveAreaRef=BSWM_EXCLUSIVE_AREA_0
      Dio: RteBswImplementationRef=Dio_Impl, RteBswModuleConfigurationRef=Dio
      Irq: RteBswImplementationRef=Irq_Impl, RteBswModuleConfigurationRef=Irq
      Mcu: RteBswImplementationRef=Mcu_Impl, RteBswModuleConfigurationRef=Mcu
      Port: RteBswImplementationRef=Port_Impl, RteBswModuleConfigurationRef=Port
    3 x RteSwComponentInstance:
      BswM_EcuSwComposition: RteSoftwareComponentInstanceRef=BswM
        Timer_BswM_MainFunction (RteEventToTaskMapping):
          RteImmediateRestart = false
          RtePositionInTask = 0
          RteEventRef = Timer_BswM_MainFunction
          RteMappedToTaskRef = Bsw_5ms_Task_Core0
          RteUsedOsAlarmRef = Rte_Al_TE2_Bsw_5ms_Task_Core0_0_10ms
      Det_EcuSwComposition: RteSoftwareComponentInstanceRef=Det
        OpEventReportRuntimeError_ReportRuntimeError_DetModule_DetModuleInstance (RteEventToTaskMapping):
          RteImmediateRestart = false
          RtePositionInTask = 3
          RteEventRef = OpEventReportRuntimeError_ReportRuntimeError_DetModule_DetModuleInstance
          RteMappedToTaskRef = Bsw_5ms_Task_Core0
        OpEventReportError_ReportError_DetModule_DetModuleInstance (RteEventToTaskMapping):
          RteImmediateRestart = false
          RtePositionInTask = 2
          RteEventRef = OpEventReportError_ReportError_DetModule_DetModuleInstance
          RteMappedToTaskRef = Bsw_5ms_Task_Core0
      EcuM_EcuSwComposition: RteSoftwareComponentInstanceRef=EcuM
        8 x RteEventToTaskMapping, all with RteImmediateRestart=false:
          Timer_EcuM_MainFunction: RtePositionInTask=1, RteEventRef=Timer_EcuM_MainFunction, RteMappedToTaskRef=Bsw_5ms_Task_Core0, RteUsedOsAlarmRef=Rte_Al_TE2_Bsw_5ms_Task_Core0_0_10ms
          OpEventSelectShutdownTarget_SelectShutdownTarget_EcuM_ShutdownTarget: RteEventRef=OpEventSelectShutdownTarget_SelectShutdownTarget_EcuM_ShutdownTarget
          OpEventGetShutdownTarget_GetShutdownTarget_EcuM_ShutdownTarget: RteEventRef=OpEventGetShutdownTarget_GetShutdownTarget_EcuM_ShutdownTarget
          OpEventGetLastShutdownTarget_GetLastShutdownTarget_EcuM_ShutdownTarget: RteEventRef=OpEventGetLastShutdownTarget_GetLastShutdownTarget_EcuM_ShutdownTarget
          OpEventSelectShutdownCause_SelectShutdownCause_EcuM_ShutdownTarget: RteEventRef=OpEventSelectShutdownCause_SelectShutdownCause_EcuM_ShutdownTarget
          OpEventGetShutdownCause_GetShutdownCause_EcuM_ShutdownTarget: RteEventRef=OpEventGetShutdownCause_GetShutdownCause_EcuM_ShutdownTarget
          OpEventSelectBootTarget_SelectBootTarget_EcuM_BootTarget: RteEventRef=OpEventSelectBootTarget_SelectBootTarget_EcuM_BootTarget
          OpEventGetBootTarget_GetBootTarget_EcuM_BootTarget: RteEventRef=OpEventGetBootTarget_GetBootTarget_EcuM_BootTarget
    3 x RteBswModuleInstance:
      Det: RteBswImplementationRef=Det_Impl, RteBswModuleConfigurationRef=Det
        DET_EXCLUSIVE_AREA_0 (RteBswExclusiveAreaImpl): RteExclusiveAreaImplMechanism=ALL_INTERRUPT_BLOCKING, RteBswExclusiveAreaRef=DET_EXCLUSIVE_AREA_0
      Rte: RteBswImplementationRef=Rte_Impl, RteBswModuleConfigurationRef=Rte
      EcuM: RteBswImplementationRef=EcuM_Impl, RteBswModuleConfigurationRef=EcuM
        EcuM_MainFunctionTimingEvent0 (RteBswEventToTaskMapping):
          RteBswImmediateRestart = false
          RteBswPositionInTask = 1
          RteBswEventRef = EcuM_MainFunctionTimingEvent0
          RteBswMappedToTaskRef = Bsw_5ms_Task_Core0
          RteBswUsedOsAlarmRef = Rte_Al_TE2_Bsw_5ms_Task_Core0_0_10ms
        3 x RteBswExclusiveAreaImpl, all with RteExclusiveAreaImplMechanism=ALL_INTERRUPT_BLOCKING:
          ECUM_EXCLUSIVE_AREA_{0..2}: RteBswExclusiveAreaRef=ECUM_EXCLUSIVE_AREA_{0..2}
    4 x RteSwComponentInstance:
      Os_OsCore0_swc_EcuSwComposition: RteSoftwareComponentInstanceRef=Os_OsCore0_swc
        OpEventGetCounterValue_GetCounterValue_OsService_SystemTimer_Core0 (RteEventToTaskMapping):
          RteImmediateRestart = false
          RtePositionInTask = 0
          RteEventRef = OpEventGetCounterValue_GetCounterValue_OsService_SystemTimer_Core0
          RteMappedToTaskRef = App_10ms_Task_Core0
        OpEventGetElapsedValue_GetElapsedValue_OsService_SystemTimer_Core0 (RteEventToTaskMapping):
          RteImmediateRestart = false
          RtePositionInTask = 1
          RteEventRef = OpEventGetElapsedValue_GetElapsedValue_OsService_SystemTimer_Core0
          RteMappedToTaskRef = App_10ms_Task_Core0
      Os_OsCore1_swc_EcuSwComposition: RteSoftwareComponentInstanceRef=Os_OsCore1_swc
        OpEventGetCounterValue_GetCounterValue_OsService_SystemTimer_Core1 (RteEventToTaskMapping):
          RteImmediateRestart = false
          RtePositionInTask = 2
          RteEventRef = OpEventGetCounterValue_GetCounterValue_OsService_SystemTimer_Core1
          RteMappedToTaskRef = App_10ms_Task_Core1
        OpEventGetElapsedValue_GetElapsedValue_OsService_SystemTimer_Core1 (RteEventToTaskMapping):
          RteImmediateRestart = false
          RtePositionInTask = 3
          RteEventRef = OpEventGetElapsedValue_GetElapsedValue_OsService_SystemTimer_Core1
          RteMappedToTaskRef = App_10ms_Task_Core1
      Os_OsCore2_swc_EcuSwComposition: RteSoftwareComponentInstanceRef=Os_OsCore2_swc
        OpEventGetCounterValue_GetCounterValue_OsService_SystemTimer_Core2 (RteEventToTaskMapping):
          RteImmediateRestart = false
          RtePositionInTask = 1
          RteEventRef = OpEventGetCounterValue_GetCounterValue_OsService_SystemTimer_Core2
          RteMappedToTaskRef = App_10ms_Task_Core2
        OpEventGetElapsedValue_GetElapsedValue_OsService_SystemTimer_Core2 (RteEventToTaskMapping):
          RteImmediateRestart = false
          RtePositionInTask = 2
          RteEventRef = OpEventGetElapsedValue_GetElapsedValue_OsService_SystemTimer_Core2
          RteMappedToTaskRef = App_10ms_Task_Core2
      Test_Led_EcuSwComposition: RteSoftwareComponentInstanceRef=Test_Led
        Test_Led_InitEvent (RteEventToTaskMapping): RteImmediateRestart=false, RtePositionInTask=2, RteEventRef=Test_Led_InitEvent, RteMappedToTaskRef=App_10ms_Task_Core0
        TMT_1_Test_Runable_1s (RteEventToTaskMapping):
          RteImmediateRestart = false
          RtePositionInTask = 3
          RteEventRef = TMT_1_Test_Runable_1s
          RteMappedToTaskRef = App_10ms_Task_Core0
          RteUsedOsEventRef = Rte_Ev_Run_Test_Led_Test_Runable_1s
          RteUsedOsAlarmRef = Rte_Al_TE_Test_Led_Test_Runable_1s
    Test_Led (RteSwComponentType): RteComponentTypeRef=Test_Led, RteImplementationRef=Test_Led_Implementation
      ComponentTypeCalibration (RteComponentTypeCalibration): RteCalibrationSupportEnabled=false
