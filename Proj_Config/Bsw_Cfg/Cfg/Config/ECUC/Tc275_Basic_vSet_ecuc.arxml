AUTOSAR XML (schema 00047)
package /ActiveEcuC
  module config vSet: implementation-config-variant=VARIANT-PRE-COMPILE, module-description=vSet_Impl
    vSetGeneral: vSetDummyStatementKind=None
    vSetPlatform:
      vSetSizeOfEnum = Size32Bit
      vSetBitOrder = LSB_to_MSB
      vSetCPUType = CPU32Bit
      vSetByteOrder = LITTLE_ENDIAN
      vSetSizeOfROMPointer = Size32Bit
      vSetSizeOfRAMPointer = Size32Bit
      vSetSizeOfInt = Size32Bit
    vSetCalibration
