AUTOSAR XML (schema 4-0-3)
package /COM/VECTOR/CFG/WORKFLOW/SYSDESC/SYNC
  flat map FLATMAP
    flat instance descriptor Test_Led: upstream-reference=EcuSwComposition.Test_Led, ecu-extract-reference=COMPOSITIONTYPE.Test_Led
