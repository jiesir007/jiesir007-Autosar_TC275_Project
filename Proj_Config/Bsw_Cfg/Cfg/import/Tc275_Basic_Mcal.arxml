[part 1 of 2: packages /Resource to /Mcu]
AUTOSAR XML (schema 4-0-3)
package /Resource
  module config Resource: implementation-config-variant=VARIANT-PRE-COMPILE
    ResourceGeneral: ResourceSubDerivative=TC275TP_64F200N
package /Mcu
  module config Mcu: implementation-config-variant=VARIANT-POST-BUILD-SELECTABLE
    McuPublishedInformation
      18 x McuResetReasonConf:
        MCU_CB0_RESET: McuResetReason=8
        MCU_CB1_RESET: McuResetReason=9
        MCU_CB3_RESET: McuResetReason=10
        MCU_ESR0_RESET: McuResetReason=0
        MCU_ESR1_RESET: McuResetReason=1
        MCU_EVR13_RESET: McuResetReason=12
        MCU_EVR33_RESET: McuResetReason=13
        MCU_POWER_ON_RESET: McuResetReason=7
        MCU_RESET_MULTIPLE: McuResetReason=254
        MCU_RESET_UNDEFINED: McuResetReason=255
        MCU_SMU_RESET: McuResetReason=2
        MCU_STBYR_RESET: McuResetReason=15
        MCU_STM0_RESET: McuResetReason=4
        MCU_STM1_RESET: McuResetReason=5
        MCU_STM2_RESET: McuResetReason=6
        MCU_SUPPLY_WDOG_RESET: McuResetReason=14
        MCU_SW_RESET: McuResetReason=3
        MCU_TP_RESET: McuResetReason=11
    McuGeneralConfiguration:
      McuClearColdResetApi = 0
      McuDeInitApi = 0
      McuDevErrorDetect = 0
      McuErayPllDisable = 0
      McuErayPllInitDelay = 10
      McuFmPllEnable = 0
      McuGetRamStateApi = 0
      McuIdleModeCpuCore = CPU_CORE_0
      McuInitClock = 1
      McuMainOscillatorFrequency = 20
      McuNoPll = 0
      McuPBFixedAddress = 0
      McuPerformResetApi = 0
      McuPllInitDelay = 10
      McuResetSfrAtInit = 0
      McuRunningInUser0Mode = 0
      McuSystemModeCpuCore = CPU_CORE_0
      McuUserModeDeInitApiEnable = 0
      McuUserModeInitApiEnable = 0
      McuUserModeRuntimeApiEnable = 0
      McuVersionInfoApi = 0
    McuModuleConfiguration_0 (McuModuleConfiguration):
      McuClockSrcFailureNotification = DISABLED
      McuNumberOfMcuModes = 1
      McuRamSectors = 0
      McuResetSetting = 0
      McuStm{0..2}ResetDisable = 0
      AscLinConfiguration: AscLin0=USE_FOR_NONE, AscLin1=USE_FOR_NONE, AscLin2=USE_FOR_NONE, AscLin3=USE_FOR_NONE
      GtmConfiguration_0 (GtmConfiguration)
        5 x Atom:
          Atom_0
            8 x AtomChannel:
              AtomChannel_0
                AtomChannelAruConfiguration: AtomChAruBlockingMode=GTM_ABM_DISABLED, AtomChAruReadAddress0=510, AtomChAruReadAddress1=510, AtomChannelAruEnable=0, AtomChannelCpuWriteRequest=0
                AtomChannelEnable: AtomChDisableOnAgcTrigger=0, AtomChannelEnable=AT_START
                AtomChannelInterrupt:
                  AtomCcu0Notification = NULL_PTR
                  AtomCcu1Notification = NULL_PTR
                  AtomGlobalCcuSel = 0
                  AtomIntEnableOnCcu0Trigger = 0
                  AtomIntEnableOnCcu1Trigger = 0
                  AtomInterruptMode = GTM_INTERRUPT_LEVEL_MODE
                  AtomNotification = NULL_PTR
                AtomChannelOutput:
                  AtomChOutputDisableOnAgcTrig = 0
                  AtomChannelOutputControl = DONT_ENABLE_CHANNEL_OUTPUT
                  AtomChannelOutputSignalLevel = LOW
                  AtomChannelPortPinSelect = TOUT9_SELC_PORT0_PIN0
                AtomChannelTimerParameters:
                  AtomChEnableForceUpdate = 0
                  AtomChResetCn0OnForceUpdate = 0
                  AtomChShadowCompareValSr0 = 0
                  AtomChShadowCompareValSr1 = 0
                  AtomChSomcCompareStrategy = TIMEBASE_GREATER_EQUAL_TO_CMx
                  AtomChSomcTimebaseForComparison = TBU_TS1
                  AtomChUpdateEnableOnCn0Reset = 0
                  AtomChannelClockSelect = GTM_CONFIGURABLE_CLOCK_0
                  AtomChannelCompareValueCm0 = 0
                  AtomChannelCompareValueCm1 = 0
                  AtomChannelCounterCn0Reset = ON_COMPARE_MATCH_ON_CHANNEL
                  AtomChannelCounterValCn0 = 0
                  AtomChannelModeSelect = ATOM_SIG_OUTPUT_MODE_IMMEDIATE
                  AtomChannelOneShotMode = 0
                  AtomChannelTriggerOutput = TRIG_FROM_PREVIOUS_CHANNEL
                  AtomModeControlBits = 0
                  AtomServeLastAruCommStrategy = 0
                AtomChannelUsage: AtomChannelUsage=USED_BY_OTHER_DRIVERS_OR_UNUSED
              AtomChannel_1
                AtomChannelAruConfiguration: AtomChAruBlockingMode=GTM_ABM_DISABLED, AtomChAruReadAddress0=510, AtomChAruReadAddress1=510, AtomChannelAruEnable=0, AtomChannelCpuWriteRequest=0
                AtomChannelEnable: AtomChDisableOnAgcTrigger=0, AtomChannelEnable=AT_START
                AtomChannelInterrupt:
                  AtomCcu0Notification = NULL_PTR
                  AtomCcu1Notification = NULL_PTR
                  AtomGlobalCcuSel = 0
                  AtomIntEnableOnCcu0Trigger = 0
                  AtomIntEnableOnCcu1Trigger = 0
                  AtomInterruptMode = GTM_INTERRUPT_LEVEL_MODE
                  AtomNotification = NULL_PTR
                AtomChannelOutput:
                  AtomChOutputDisableOnAgcTrig = 0
                  AtomChannelOutputControl = DONT_ENABLE_CHANNEL_OUTPUT
                  AtomChannelOutputSignalLevel = LOW
                  AtomChannelPortPinSelect = TOUT10_SELC_PORT0_PIN1
                AtomChannelTimerParameters:
                  AtomChEnableForceUpdate = 0
                  AtomChResetCn0OnForceUpdate = 0
                  AtomChShadowCompareValSr0 = 0
                  AtomChShadowCompareValSr1 = 0
                  AtomChSomcCompareStrategy = TIMEBASE_GREATER_EQUAL_TO_CMx
                  AtomChSomcTimebaseForComparison = TBU_TS1
                  AtomChUpdateEnableOnCn0Reset = 0
                  AtomChannelClockSelect = GTM_CONFIGURABLE_CLOCK_0
                  AtomChannelCompareValueCm0 = 0
                  AtomChannelCompareValueCm1 = 0
                  AtomChannelCounterCn0Reset = ON_COMPARE_MATCH_ON_CHANNEL
                  AtomChannelCounterValCn0 = 0
                  AtomChannelModeSelect = ATOM_SIG_OUTPUT_MODE_IMMEDIATE
                  AtomChannelOneShotMode = 0
                  AtomChannelTriggerOutput = TRIG_FROM_PREVIOUS_CHANNEL
                  AtomModeControlBits = 0
                  AtomServeLastAruCommStrategy = 0
                AtomChannelUsage: AtomChannelUsage=USED_BY_OTHER_DRIVERS_OR_UNUSED
              AtomChannel_2
                AtomChannelAruConfiguration: AtomChAruBlockingMode=GTM_ABM_DISABLED, AtomChAruReadAddress0=510, AtomChAruReadAddress1=510, AtomChannelAruEnable=0, AtomChannelCpuWriteRequest=0
                AtomChannelEnable: AtomChDisableOnAgcTrigger=0, AtomChannelEnable=AT_START
                AtomChannelInterrupt:
                  AtomCcu0Notification = NULL_PTR
                  AtomCcu1Notification = NULL_PTR
                  AtomGlobalCcuSel = 0
                  AtomIntEnableOnCcu0Trigger = 0
                  AtomIntEnableOnCcu1Trigger = 0
                  AtomInterruptMode = GTM_INTERRUPT_LEVEL_MODE
                  AtomNotification = NULL_PTR
                AtomChannelOutput:
                  AtomChOutputDisableOnAgcTrig = 0
                  AtomChannelOutputControl = DONT_ENABLE_CHANNEL_OUTPUT
                  AtomChannelOutputSignalLevel = LOW
                  AtomChannelPortPinSelect = TOUT12_SELC_PORT0_PIN3
                AtomChannelTimerParameters:
                  AtomChEnableForceUpdate = 0
                  AtomChResetCn0OnForceUpdate = 0
                  AtomChShadowCompareValSr0 = 0
                  AtomChShadowCompareValSr1 = 0
                  AtomChSomcCompareStrategy = TIMEBASE_GREATER_EQUAL_TO_CMx
                  AtomChSomcTimebaseForComparison = TBU_TS1
                  AtomChUpdateEnableOnCn0Reset = 0
                  AtomChannelClockSelect = GTM_CONFIGURABLE_CLOCK_0
                  AtomChannelCompareValueCm0 = 0
                  AtomChannelCompareValueCm1 = 0
                  AtomChannelCounterCn0Reset = ON_COMPARE_MATCH_ON_CHANNEL
                  AtomChannelCounterValCn0 = 0
                  AtomChannelModeSelect = ATOM_SIG_OUTPUT_MODE_IMMEDIATE
                  AtomChannelOneShotMode = 0
                  AtomChannelTriggerOutput = TRIG_FROM_PREVIOUS_CHANNEL
                  AtomModeControlBits = 0
                  AtomServeLastAruCommStrategy = 0
                AtomChannelUsage: AtomChannelUsage=USED_BY_OTHER_DRIVERS_OR_UNUSED
              AtomChannel_3
                AtomChannelAruConfiguration: AtomChAruBlockingMode=GTM_ABM_DISABLED, AtomChAruReadAddress0=510, AtomChAruReadAddress1=510, AtomChannelAruEnable=0, AtomChannelCpuWriteRequest=0
                AtomChannelEnable: AtomChDisableOnAgcTrigger=0, AtomChannelEnable=AT_START
                AtomChannelInterrupt:
                  AtomCcu0Notification = NULL_PTR
                  AtomCcu1Notification = NULL_PTR
                  AtomGlobalCcuSel = 0
                  AtomIntEnableOnCcu0Trigger = 0
                  AtomIntEnableOnCcu1Trigger = 0
                  AtomInterruptMode = GTM_INTERRUPT_LEVEL_MODE
                  AtomNotification = NULL_PTR
                AtomChannelOutput:
                  AtomChOutputDisableOnAgcTrig = 0
                  AtomChannelOutputControl = DONT_ENABLE_CHANNEL_OUTPUT
                  AtomChannelOutputSignalLevel = LOW
                  AtomChannelPortPinSelect = TOUT13_SELC_PORT0_PIN4
                AtomChannelTimerParameters:
                  AtomChEnableForceUpdate = 0
                  AtomChResetCn0OnForceUpdate = 0
                  AtomChShadowCompareValSr0 = 0
                  AtomChShadowCompareValSr1 = 0
                  AtomChSomcCompareStrategy = TIMEBASE_GREATER_EQUAL_TO_CMx
                  AtomChSomcTimebaseForComparison = TBU_TS1
                  AtomChUpdateEnableOnCn0Reset = 0
                  AtomChannelClockSelect = GTM_CONFIGURABLE_CLOCK_0
                  AtomChannelCompareValueCm0 = 0
                  AtomChannelCompareValueCm1 = 0
                  AtomChannelCounterCn0Reset = ON_COMPARE_MATCH_ON_CHANNEL
                  AtomChannelCounterValCn0 = 0
                  AtomChannelModeSelect = ATOM_SIG_OUTPUT_MODE_IMMEDIATE
                  AtomChannelOneShotMode = 0
                  AtomChannelTriggerOutput = TRIG_FROM_PREVIOUS_CHANNEL
                  AtomModeControlBits = 0
                  AtomServeLastAruCommStrategy = 0
                AtomChannelUsage: AtomChannelUsage=USED_BY_OTHER_DRIVERS_OR_UNUSED
              AtomChannel_4
                AtomChannelAruConfiguration: AtomChAruBlockingMode=GTM_ABM_DISABLED, AtomChAruReadAddress0=510, AtomChAruReadAddress1=510, AtomChannelAruEnable=0, AtomChannelCpuWriteRequest=0
                AtomChannelEnable: AtomChDisableOnAgcTrigger=0, AtomChannelEnable=AT_START
                AtomChannelInterrupt:
                  AtomCcu0Notification = NULL_PTR
                  AtomCcu1Notification = NULL_PTR
                  AtomGlobalCcuSel = 0
                  AtomIntEnableOnCcu0Trigger = 0
                  AtomIntEnableOnCcu1Trigger = 0
                  AtomInterruptMode = GTM_INTERRUPT_LEVEL_MODE
                  AtomNotification = NULL_PTR
                AtomChannelOutput:
                  AtomChOutputDisableOnAgcTrig = 0
                  AtomChannelOutputControl = DONT_ENABLE_CHANNEL_OUTPUT
                  AtomChannelOutputSignalLevel = LOW
                  AtomChannelPortPinSelect = TOUT14_SELC_PORT0_PIN5
                AtomChannelTimerParameters:
                  AtomChEnableForceUpdate = 0
                  AtomChResetCn0OnForceUpdate = 0
                  AtomChShadowCompareValSr0 = 0
                  AtomChShadowCompareValSr1 = 0
                  AtomChSomcCompareStrategy = TIMEBASE_GREATER_EQUAL_TO_CMx
                  AtomChSomcTimebaseForComparison = TBU_TS1
                  AtomChUpdateEnableOnCn0Reset = 0
                  AtomChannelClockSelect = GTM_CONFIGURABLE_CLOCK_0
                  AtomChannelCompareValueCm0 = 0
                  AtomChannelCompareValueCm1 = 0
                  AtomChannelCounterCn0Reset = ON_COMPARE_MATCH_ON_CHANNEL
                  AtomChannelCounterValCn0 = 0
                  AtomChannelModeSelect = ATOM_SIG_OUTPUT_MODE_IMMEDIATE
                  AtomChannelOneShotMode = 0
                  AtomChannelTriggerOutput = TRIG_FROM_PREVIOUS_CHANNEL
                  AtomModeControlBits = 0
                  AtomServeLastAruCommStrategy = 0
                AtomChannelUsage: AtomChannelUsage=USED_BY_OTHER_DRIVERS_OR_UNUSED
              AtomChannel_5
                AtomChannelAruConfiguration: AtomChAruBlockingMode=GTM_ABM_DISABLED, AtomChAruReadAddress0=510, AtomChAruReadAddress1=510, AtomChannelAruEnable=0, AtomChannelCpuWriteRequest=0
                AtomChannelEnable: AtomChDisableOnAgcTrigger=0, AtomChannelEnable=AT_START
                AtomChannelInterrupt:
                  AtomCcu0Notification = NULL_PTR
                  AtomCcu1Notification = NULL_PTR
                  AtomGlobalCcuSel = 0
                  AtomIntEnableOnCcu0Trigger = 0
                  AtomIntEnableOnCcu1Trigger = 0
                  AtomInterruptMode = GTM_INTERRUPT_LEVEL_MODE
                  AtomNotification = NULL_PTR
                AtomChannelOutput:
                  AtomChOutputDisableOnAgcTrig = 0
                  AtomChannelOutputControl = DONT_ENABLE_CHANNEL_OUTPUT
                  AtomChannelOutputSignalLevel = LOW
                  AtomChannelPortPinSelect = TOUT15_SELC_PORT0_PIN6
                AtomChannelTimerParameters:
                  AtomChEnableForceUpdate = 0
                  AtomChResetCn0OnForceUpdate = 0
                  AtomChShadowCompareValSr0 = 0
                  AtomChShadowCompareValSr1 = 0
                  AtomChSomcCompareStrategy = TIMEBASE_GREATER_EQUAL_TO_CMx
                  AtomChSomcTimebaseForComparison = TBU_TS1
                  AtomChUpdateEnableOnCn0Reset = 0
                  AtomChannelClockSelect = GTM_CONFIGURABLE_CLOCK_0
                  AtomChannelCompareValueCm0 = 0
                  AtomChannelCompareValueCm1 = 0
                  AtomChannelCounterCn0Reset = ON_COMPARE_MATCH_ON_CHANNEL
                  AtomChannelCounterValCn0 = 0
                  AtomChannelModeSelect = ATOM_SIG_OUTPUT_MODE_IMMEDIATE
                  AtomChannelOneShotMode = 0
                  AtomChannelTriggerOutput = TRIG_FROM_PREVIOUS_CHANNEL
                  AtomModeControlBits = 0
                  AtomServeLastAruCommStrategy = 0
                AtomChannelUsage: AtomChannelUsage=USED_BY_OTHER_DRIVERS_OR_UNUSED
              AtomChannel_6
                AtomChannelAruConfiguration: AtomChAruBlockingMode=GTM_ABM_DISABLED, AtomChAruReadAddress0=510, AtomChAruReadAddress1=510, AtomChannelAruEnable=0, AtomChannelCpuWriteRequest=0
                AtomChannelEnable: AtomChDisableOnAgcTrigger=0, AtomChannelEnable=AT_START
                AtomChannelInterrupt:
                  AtomCcu0Notification = NULL_PTR
                  AtomCcu1Notification = NULL_PTR
                  AtomGlobalCcuSel = 0
                  AtomIntEnableOnCcu0Trigger = 0
                  AtomIntEnableOnCcu1Trigger = 0
                  AtomInterruptMode = GTM_INTERRUPT_LEVEL_MODE
                  AtomNotification = NULL_PTR
                AtomChannelOutput:
                  AtomChOutputDisableOnAgcTrig = 0
                  AtomChannelOutputControl = DONT_ENABLE_CHANNEL_OUTPUT
                  AtomChannelOutputSignalLevel = LOW
                  AtomChannelPortPinSelect = TOUT16_SELC_PORT0_PIN7
                AtomChannelTimerParameters:
                  AtomChEnableForceUpdate = 0
                  AtomChResetCn0OnForceUpdate = 0
                  AtomChShadowCompareValSr0 = 0
                  AtomChShadowCompareValSr1 = 0
                  AtomChSomcCompareStrategy = TIMEBASE_GREATER_EQUAL_TO_CMx
                  AtomChSomcTimebaseForComparison = TBU_TS1
                  AtomChUpdateEnableOnCn0Reset = 0
                  AtomChannelClockSelect = GTM_CONFIGURABLE_CLOCK_0
                  AtomChannelCompareValueCm0 = 0
                  AtomChannelCompareValueCm1 = 0
                  AtomChannelCounterCn0Reset = ON_COMPARE_MATCH_ON_CHANNEL
                  AtomChannelCounterValCn0 = 0
                  AtomChannelModeSelect = ATOM_SIG_OUTPUT_MODE_IMMEDIATE
                  AtomChannelOneShotMode = 0
                  AtomChannelTriggerOutput = TRIG_FROM_PREVIOUS_CHANNEL
                  AtomModeControlBits = 0
                  AtomServeLastAruCommStrategy = 0
                AtomChannelUsage: AtomChannelUsage=USED_BY_OTHER_DRIVERS_OR_UNUSED
              AtomChannel_7
                AtomChannelAruConfiguration: AtomChAruBlockingMode=GTM_ABM_DISABLED, AtomChAruReadAddress0=510, AtomChAruReadAddress1=510, AtomChannelAruEnable=0, AtomChannelCpuWriteRequest=0
                AtomChannelEnable: AtomChDisableOnAgcTrigger=0, AtomChannelEnable=AT_START
                AtomChannelInterrupt:
                  AtomCcu0Notification = NULL_PTR
                  AtomCcu1Notification = NULL_PTR
                  AtomGlobalCcuSel = 0
                  AtomIntEnableOnCcu0Trigger = 0
                  AtomIntEnableOnCcu1Trigger = 0
                  AtomInterruptMode = GTM_INTERRUPT_LEVEL_MODE
                  AtomNotification = NULL_PTR
                AtomChannelOutput:
                  AtomChOutputDisableOnAgcTrig = 0
                  AtomChannelOutputControl = DONT_ENABLE_CHANNEL_OUTPUT
                  AtomChannelOutputSignalLevel = LOW
                  AtomChannelPortPinSelect = TOUT17_SELC_PORT0_PIN8
                AtomChannelTimerParameters:
                  AtomChEnableForceUpdate = 0
                  AtomChResetCn0OnForceUpdate = 0
                  AtomChShadowCompareValSr0 = 0
                  AtomChShadowCompareValSr1 = 0
                  AtomChSomcCompareStrategy = TIMEBASE_GREATER_EQUAL_TO_CMx
                  AtomChSomcTimebaseForComparison = TBU_TS1
                  AtomChUpdateEnableOnCn0Reset = 0
                  AtomChannelClockSelect = GTM_CONFIGURABLE_CLOCK_0
                  AtomChannelCompareValueCm0 = 0
                  AtomChannelCompareValueCm1 = 0
                  AtomChannelCounterCn0Reset = ON_COMPARE_MATCH_ON_CHANNEL
                  AtomChannelCounterValCn0 = 0
                  AtomChannelModeSelect = ATOM_SIG_OUTPUT_MODE_IMMEDIATE
                  AtomChannelOneShotMode = 0
                  AtomChannelTriggerOutput = TRIG_FROM_PREVIOUS_CHANNEL
                  AtomModeControlBits = 0
                  AtomServeLastAruCommStrategy = 0
                AtomChannelUsage: AtomChannelUsage=USED_BY_OTHER_DRIVERS_OR_UNUSED
            AtomTriggerForAgc
              AtomAgcInternalTriggerSelect:
                AtomAgcIntTriggerFromChannel{0..7} = 0
              AtomAgcTriggerByTimebase: AtomAgcTbuTimebaseSelect=TBU_TS0_TIMEBASE, AtomAgcTimeBaseTriggerEnable=0, AtomAgcTimebaseMatchValue=0
          Atom_1
            8 x AtomChannel:
              AtomChannel_0
                AtomChannelAruConfiguration: AtomChAruBlockingMode=GTM_ABM_DISABLED, AtomChAruReadAddress0=510, AtomChAruReadAddress1=510, AtomChannelAruEnable=0, AtomChannelCpuWriteRequest=0
                AtomChannelEnable: AtomChDisableOnAgcTrigger=0, AtomChannelEnable=AT_START
                AtomChannelInterrupt:
                  AtomCcu0Notification = NULL_PTR
                  AtomCcu1Notification = NULL_PTR
                  AtomGlobalCcuSel = 0
                  AtomIntEnableOnCcu0Trigger = 0
                  AtomIntEnableOnCcu1Trigger = 0
                  AtomInterruptMode = GTM_INTERRUPT_LEVEL_MODE
                  AtomNotification = NULL_PTR
                AtomChannelOutput:
                  AtomChOutputDisableOnAgcTrig = 0
                  AtomChannelOutputControl = DONT_ENABLE_CHANNEL_OUTPUT
                  AtomChannelOutputSignalLevel = LOW
                  AtomChannelPortPinSelect = TOUT9_SELD_PORT0_PIN0
                AtomChannelTimerParameters:
                  AtomChEnableForceUpdate = 0
                  AtomChResetCn0OnForceUpdate = 0
                  AtomChShadowCompareValSr0 = 0
                  AtomChShadowCompareValSr1 = 0
                  AtomChSomcCompareStrategy = TIMEBASE_GREATER_EQUAL_TO_CMx
                  AtomChSomcTimebaseForComparison = TBU_TS1
                  AtomChUpdateEnableOnCn0Reset = 0
                  AtomChannelClockSelect = GTM_CONFIGURABLE_CLOCK_0
                  AtomChannelCompareValueCm0 = 0
                  AtomChannelCompareValueCm1 = 0
                  AtomChannelCounterCn0Reset = ON_COMPARE_MATCH_ON_CHANNEL
                  AtomChannelCounterValCn0 = 0
                  AtomChannelModeSelect = ATOM_SIG_OUTPUT_MODE_IMMEDIATE
                  AtomChannelOneShotMode = 0
                  AtomChannelTriggerOutput = TRIG_FROM_PREVIOUS_CHANNEL
                  AtomModeControlBits = 0
                  AtomServeLastAruCommStrategy = 0
                AtomChannelUsage: AtomChannelUsage=USED_BY_OTHER_DRIVERS_OR_UNUSED
              AtomChannel_1
                AtomChannelAruConfiguration: AtomChAruBlockingMode=GTM_ABM_DISABLED, AtomChAruReadAddress0=510, AtomChAruReadAddress1=510, AtomChannelAruEnable=0, AtomChannelCpuWriteRequest=0
                AtomChannelEnable: AtomChDisableOnAgcTrigger=0, AtomChannelEnable=AT_START
                AtomChannelInterrupt:
                  AtomCcu0Notification = NULL_PTR
                  AtomCcu1Notification = NULL_PTR
                  AtomGlobalCcuSel = 0
                  AtomIntEnableOnCcu0Trigger = 0
                  AtomIntEnableOnCcu1Trigger = 0
                  AtomInterruptMode = GTM_INTERRUPT_LEVEL_MODE
                  AtomNotification = NULL_PTR
                AtomChannelOutput:
                  AtomChOutputDisableOnAgcTrig = 0
                  AtomChannelOutputControl = DONT_ENABLE_CHANNEL_OUTPUT
                  AtomChannelOutputSignalLevel = LOW
                  AtomChannelPortPinSelect = TOUT10_SELD_PORT0_PIN1
                AtomChannelTimerParameters:
                  AtomChEnableForceUpdate = 0
                  AtomChResetCn0OnForceUpdate = 0
                  AtomChShadowCompareValSr0 = 0
                  AtomChShadowCompareValSr1 = 0
                  AtomChSomcCompareStrategy = TIMEBASE_GREATER_EQUAL_TO_CMx
                  AtomChSomcTimebaseForComparison = TBU_TS1
                  AtomChUpdateEnableOnCn0Reset = 0
                  AtomChannelClockSelect = GTM_CONFIGURABLE_CLOCK_0
                  AtomChannelCompareValueCm0 = 0
                  AtomChannelCompareValueCm1 = 0
                  AtomChannelCounterCn0Reset = ON_COMPARE_MATCH_ON_CHANNEL
                  AtomChannelCounterValCn0 = 0
                  AtomChannelModeSelect = ATOM_SIG_OUTPUT_MODE_IMMEDIATE
                  AtomChannelOneShotMode = 0
                  AtomChannelTriggerOutput = TRIG_FROM_PREVIOUS_CHANNEL
                  AtomModeControlBits = 0
                  AtomServeLastAruCommStrategy = 0
                AtomChannelUsage: AtomChannelUsage=USED_BY_OTHER_DRIVERS_OR_UNUSED
              AtomChannel_2
                AtomChannelAruConfiguration: AtomChAruBlockingMode=GTM_ABM_DISABLED, AtomChAruReadAddress0=510, AtomChAruReadAddress1=510, AtomChannelAruEnable=0, AtomChannelCpuWriteRequest=0
                AtomChannelEnable: AtomChDisableOnAgcTrigger=0, AtomChannelEnable=AT_START
                AtomChannelInterrupt:
                  AtomCcu0Notification = NULL_PTR
                  AtomCcu1Notification = NULL_PTR
                  AtomGlobalCcuSel = 0
                  AtomIntEnableOnCcu0Trigger = 0
                  AtomIntEnableOnCcu1Trigger = 0
                  AtomInterruptMode = GTM_INTERRUPT_LEVEL_MODE
                  AtomNotification = NULL_PTR
                AtomChannelOutput:
                  AtomChOutputDisableOnAgcTrig = 0
                  AtomChannelOutputControl = DONT_ENABLE_CHANNEL_OUTPUT
                  AtomChannelOutputSignalLevel = LOW
                  AtomChannelPortPinSelect = TOUT12_SELD_PORT0_PIN3
                AtomChannelTimerParameters:
                  AtomChEnableForceUpdate = 0
                  AtomChResetCn0OnForceUpdate = 0
                  AtomChShadowCompareValSr0 = 0
                  AtomChShadowCompareValSr1 = 0
                  AtomChSomcCompareStrategy = TIMEBASE_GREATER_EQUAL_TO_CMx
                  AtomChSomcTimebaseForComparison = TBU_TS1
                  AtomChUpdateEnableOnCn0Reset = 0
                  AtomChannelClockSelect = GTM_CONFIGURABLE_CLOCK_0
                  AtomChannelCompareValueCm0 = 0
                  AtomChannelCompareValueCm1 = 0
                  AtomChannelCounterCn0Reset = ON_COMPARE_MATCH_ON_CHANNEL
                  AtomChannelCounterValCn0 = 0
                  AtomChannelModeSelect = ATOM_SIG_OUTPUT_MODE_IMMEDIATE
                  AtomChannelOneShotMode = 0
                  AtomChannelTriggerOutput = TRIG_FROM_PREVIOUS_CHANNEL
                  AtomModeControlBits = 0
                  AtomServeLastAruCommStrategy = 0
                AtomChannelUsage: AtomChannelUsage=USED_BY_OTHER_DRIVERS_OR_UNUSED
              AtomChannel_3
                AtomChannelAruConfiguration: AtomChAruBlockingMode=GTM_ABM_DISABLED, AtomChAruReadAddress0=510, AtomChAruReadAddress1=510, AtomChannelAruEnable=0, AtomChannelCpuWriteRequest=0
                AtomChannelEnable: AtomChDisableOnAgcTrigger=0, AtomChannelEnable=AT_START
                AtomChannelInterrupt:
                  AtomCcu0Notification = NULL_PTR
                  AtomCcu1Notification = NULL_PTR
                  AtomGlobalCcuSel = 0
                  AtomIntEnableOnCcu0Trigger = 0
                  AtomIntEnableOnCcu1Trigger = 0
                  AtomInterruptMode = GTM_INTERRUPT_LEVEL_MODE
                  AtomNotification = NULL_PTR
                AtomChannelOutput:
                  AtomChOutputDisableOnAgcTrig = 0
                  AtomChannelOutputControl = DONT_ENABLE_CHANNEL_OUTPUT
                  AtomChannelOutputSignalLevel = LOW
                  AtomChannelPortPinSelect = TOUT13_SELD_PORT0_PIN4
                AtomChannelTimerParameters:
                  AtomChEnableForceUpdate = 0
                  AtomChResetCn0OnForceUpdate = 0
                  AtomChShadowCompareValSr0 = 0
                  AtomChShadowCompareValSr1 = 0
                  AtomChSomcCompareStrategy = TIMEBASE_GREATER_EQUAL_TO_CMx
                  AtomChSomcTimebaseForComparison = TBU_TS1
                  AtomChUpdateEnableOnCn0Reset = 0
                  AtomChannelClockSelect = GTM_CONFIGURABLE_CLOCK_0
                  AtomChannelCompareValueCm0 = 0
                  AtomChannelCompareValueCm1 = 0
                  AtomChannelCounterCn0Reset = ON_COMPARE_MATCH_ON_CHANNEL
                  AtomChannelCounterValCn0 = 0
                  AtomChannelModeSelect = ATOM_SIG_OUTPUT_MODE_IMMEDIATE
                  AtomChannelOneShotMode = 0
                  AtomChannelTriggerOutput = TRIG_FROM_PREVIOUS_CHANNEL
                  AtomModeControlBits = 0
                  AtomServeLastAruCommStrategy = 0
                AtomChannelUsage: AtomChannelUsage=USED_BY_OTHER_DRIVERS_OR_UNUSED
              AtomChannel_4
                AtomChannelAruConfiguration: AtomChAruBlockingMode=GTM_ABM_DISABLED, AtomChAruReadAddress0=510, AtomChAruReadAddress1=510, AtomChannelAruEnable=0, AtomChannelCpuWriteRequest=0
                AtomChannelEnable: AtomChDisableOnAgcTrigger=0, AtomChannelEnable=AT_START
                AtomChannelInterrupt:
                  AtomCcu0Notification = NULL_PTR
                  AtomCcu1Notification = NULL_PTR
                  AtomGlobalCcuSel = 0
                  AtomIntEnableOnCcu0Trigger = 0
                  AtomIntEnableOnCcu1Trigger = 0
                  AtomInterruptMode = GTM_INTERRUPT_LEVEL_MODE
                  AtomNotification = NULL_PTR
                AtomChannelOutput:
                  AtomChOutputDisableOnAgcTrig = 0
                  AtomChannelOutputControl = DONT_ENABLE_CHANNEL_OUTPUT
                  AtomChannelOutputSignalLevel = LOW
                  AtomChannelPortPinSelect = TOUT14_SELD_PORT0_PIN5
                AtomChannelTimerParameters:
                  AtomChEnableForceUpdate = 0
                  AtomChResetCn0OnForceUpdate = 0
                  AtomChShadowCompareValSr0 = 0
                  AtomChShadowCompareValSr1 = 0
                  AtomChSomcCompareStrategy = TIMEBASE_GREATER_EQUAL_TO_CMx
                  AtomChSomcTimebaseForComparison = TBU_TS1
                  AtomChUpdateEnableOnCn0Reset = 0
                  AtomChannelClockSelect = GTM_CONFIGURABLE_CLOCK_0
                  AtomChannelCompareValueCm0 = 0
                  AtomChannelCompareValueCm1 = 0
                  AtomChannelCounterCn0Reset = ON_COMPARE_MATCH_ON_CHANNEL
                  AtomChannelCounterValCn0 = 0
                  AtomChannelModeSelect = ATOM_SIG_OUTPUT_MODE_IMMEDIATE
                  AtomChannelOneShotMode = 0
                  AtomChannelTriggerOutput = TRIG_FROM_PREVIOUS_CHANNEL
                  AtomModeControlBits = 0
                  AtomServeLastAruCommStrategy = 0
                AtomChannelUsage: AtomChannelUsage=USED_BY_OTHER_DRIVERS_OR_UNUSED
              AtomChannel_5
                AtomChannelAruConfiguration: AtomChAruBlockingMode=GTM_ABM_DISABLED, AtomChAruReadAddress0=510, AtomChAruReadAddress1=510, AtomChannelAruEnable=0, AtomChannelCpuWriteRequest=0
                AtomChannelEnable: AtomChDisableOnAgcTrigger=0, AtomChannelEnable=AT_START
                AtomChannelInterrupt:
                  AtomCcu0Notification = NULL_PTR
                  AtomCcu1Notification = NULL_PTR
                  AtomGlobalCcuSel = 0
                  AtomIntEnableOnCcu0Trigger = 0
                  AtomIntEnableOnCcu1Trigger = 0
                  AtomInterruptMode = GTM_INTERRUPT_LEVEL_MODE
                  AtomNotification = NULL_PTR
                AtomChannelOutput:
                  AtomChOutputDisableOnAgcTrig = 0
                  AtomChannelOutputControl = DONT_ENABLE_CHANNEL_OUTPUT
                  AtomChannelOutputSignalLevel = LOW
                  AtomChannelPortPinSelect = TOUT15_SELD_PORT0_PIN6
                AtomChannelTimerParameters:
                  AtomChEnableForceUpdate = 0
                  AtomChResetCn0OnForceUpdate = 0
                  AtomChShadowCompareValSr0 = 0
                  AtomChShadowCompareValSr1 = 0
                  AtomChSomcCompareStrategy = TIMEBASE_GREATER_EQUAL_TO_CMx
                  AtomChSomcTimebaseForComparison = TBU_TS1
                  AtomChUpdateEnableOnCn0Reset = 0
                  AtomChannelClockSelect = GTM_CONFIGURABLE_CLOCK_0
                  AtomChannelCompareValueCm0 = 0
                  AtomChannelCompareValueCm1 = 0
                  AtomChannelCounterCn0Reset = ON_COMPARE_MATCH_ON_CHANNEL
                  AtomChannelCounterValCn0 = 0
                  AtomChannelModeSelect = ATOM_SIG_OUTPUT_MODE_IMMEDIATE
                  AtomChannelOneShotMode = 0
                  AtomChannelTriggerOutput = TRIG_FROM_PREVIOUS_CHANNEL
                  AtomModeControlBits = 0
                  AtomServeLastAruCommStrategy = 0
                AtomChannelUsage: AtomChannelUsage=USED_BY_OTHER_DRIVERS_OR_UNUSED
              AtomChannel_6
                AtomChannelAruConfiguration: AtomChAruBlockingMode=GTM_ABM_DISABLED, AtomChAruReadAddress0=510, AtomChAruReadAddress1=510, AtomChannelAruEnable=0, AtomChannelCpuWriteRequest=0
                AtomChannelEnable: AtomChDisableOnAgcTrigger=0, AtomChannelEnable=AT_START
                AtomChannelInterrupt:
                  AtomCcu0Notification = NULL_PTR
                  AtomCcu1Notification = NULL_PTR
                  AtomGlobalCcuSel = 0
                  AtomIntEnableOnCcu0Trigger = 0
                  AtomIntEnableOnCcu1Trigger = 0
                  AtomInterruptMode = GTM_INTERRUPT_LEVEL_MODE
                  AtomNotification = NULL_PTR
                AtomChannelOutput:
                  AtomChOutputDisableOnAgcTrig = 0
                  AtomChannelOutputControl = DONT_ENABLE_CHANNEL_OUTPUT
                  AtomChannelOutputSignalLevel = LOW
                  AtomChannelPortPinSelect = TOUT16_SELD_PORT0_PIN7
                AtomChannelTimerParameters:
                  AtomChEnableForceUpdate = 0
                  AtomChResetCn0OnForceUpdate = 0
                  AtomChShadowCompareValSr0 = 0
                  AtomChShadowCompareValSr1 = 0
                  AtomChSomcCompareStrategy = TIMEBASE_GREATER_EQUAL_TO_CMx
                  AtomChSomcTimebaseForComparison = TBU_TS1
                  AtomChUpdateEnableOnCn0Reset = 0
                  AtomChannelClockSelect = GTM_CONFIGURABLE_CLOCK_0
                  AtomChannelCompareValueCm0 = 0
                  AtomChannelCompareValueCm1 = 0
                  AtomChannelCounterCn0Reset = ON_COMPARE_MATCH_ON_CHANNEL
                  AtomChannelCounterValCn0 = 0
                  AtomChannelModeSelect = ATOM_SIG_OUTPUT_MODE_IMMEDIATE
                  AtomChannelOneShotMode = 0
                  AtomChannelTriggerOutput = TRIG_FROM_PREVIOUS_CHANNEL
                  AtomModeControlBits = 0
                  AtomServeLastAruCommStrategy = 0
                AtomChannelUsage: AtomChannelUsage=USED_BY_OTHER_DRIVERS_OR_UNUSED
              AtomChannel_7
                AtomChannelAruConfiguration: AtomChAruBlockingMode=GTM_ABM_DISABLED, AtomChAruReadAddress0=510, AtomChAruReadAddress1=510, AtomChannelAruEnable=0, AtomChannelCpuWriteRequest=0
                AtomChannelEnable: AtomChDisableOnAgcTrigger=0, AtomChannelEnable=AT_START
                AtomChannelInterrupt:
                  AtomCcu0Notification = NULL_PTR
                  AtomCcu1Notification = NULL_PTR
                  AtomGlobalCcuSel = 0
                  AtomIntEnableOnCcu0Trigger = 0
                  AtomIntEnableOnCcu1Trigger = 0
                  AtomInterruptMode = GTM_INTERRUPT_LEVEL_MODE
                  AtomNotification = NULL_PTR
                AtomChannelOutput:
                  AtomChOutputDisableOnAgcTrig = 0
                  AtomChannelOutputControl = DONT_ENABLE_CHANNEL_OUTPUT
                  AtomChannelOutputSignalLevel = LOW
                  AtomChannelPortPinSelect = TOUT17_SELD_PORT0_PIN8
                AtomChannelTimerParameters:
                  AtomChEnableForceUpdate = 0
                  AtomChResetCn0OnForceUpdate = 0
                  AtomChShadowCompareValSr0 = 0
                  AtomChShadowCompareValSr1 = 0
                  AtomChSomcCompareStrategy = TIMEBASE_GREATER_EQUAL_TO_CMx
                  AtomChSomcTimebaseForComparison = TBU_TS1
                  AtomChUpdateEnableOnCn0Reset = 0
                  AtomChannelClockSelect = GTM_CONFIGURABLE_CLOCK_0
                  AtomChannelCompareValueCm0 = 0
                  AtomChannelCompareValueCm1 = 0
                  AtomChannelCounterCn0Reset = ON_COMPARE_MATCH_ON_CHANNEL
                  AtomChannelCounterValCn0 = 0
                  AtomChannelModeSelect = ATOM_SIG_OUTPUT_MODE_IMMEDIATE
                  AtomChannelOneShotMode = 0
                  AtomChannelTriggerOutput = TRIG_FROM_PREVIOUS_CHANNEL
                  AtomModeControlBits = 0
                  AtomServeLastAruCommStrategy = 0
                AtomChannelUsage: AtomChannelUsage=USED_BY_OTHER_DRIVERS_OR_UNUSED
            AtomTriggerForAgc
              AtomAgcInternalTriggerSelect:
                AtomAgcIntTriggerFromChannel{0..7} = 0
              AtomAgcTriggerByTimebase: AtomAgcTbuTimebaseSelect=TBU_TS0_TIMEBASE, AtomAgcTimeBaseTriggerEnable=0, AtomAgcTimebaseMatchValue=0
          Atom_2
            8 x AtomChannel:
              AtomChannel_0
                AtomChannelAruConfiguration: AtomChAruBlockingMode=GTM_ABM_DISABLED, AtomChAruReadAddress0=510, AtomChAruReadAddress1=510, AtomChannelAruEnable=0, AtomChannelCpuWriteRequest=0
                AtomChannelEnable: AtomChDisableOnAgcTrigger=0, AtomChannelEnable=AT_START
                AtomChannelInterrupt:
                  AtomCcu0Notification = NULL_PTR
                  AtomCcu1Notification = NULL_PTR
                  AtomGlobalCcuSel = 0
                  AtomIntEnableOnCcu0Trigger = 0
                  AtomIntEnableOnCcu1Trigger = 0
                  AtomInterruptMode = GTM_INTERRUPT_LEVEL_MODE
                  AtomNotification = NULL_PTR
                AtomChannelOutput:
                  AtomChOutputDisableOnAgcTrig = 0
                  AtomChannelOutputControl = DONT_ENABLE_CHANNEL_OUTPUT
                  AtomChannelOutputSignalLevel = LOW
                  AtomChannelPortPinSelect = TOUT18_SELC_PORT0_PIN9
                AtomChannelTimerParameters:
                  AtomChEnableForceUpdate = 0
                  AtomChResetCn0OnForceUpdate = 0
                  AtomChShadowCompareValSr0 = 0
                  AtomChShadowCompareValSr1 = 0
                  AtomChSomcCompareStrategy = TIMEBASE_GREATER_EQUAL_TO_CMx
                  AtomChSomcTimebaseForComparison = TBU_TS1
                  AtomChUpdateEnableOnCn0Reset = 0
                  AtomChannelClockSelect = GTM_CONFIGURABLE_CLOCK_0
                  AtomChannelCompareValueCm0 = 0
                  AtomChannelCompareValueCm1 = 0
                  AtomChannelCounterCn0Reset = ON_COMPARE_MATCH_ON_CHANNEL
                  AtomChannelCounterValCn0 = 0
                  AtomChannelModeSelect = ATOM_SIG_OUTPUT_MODE_IMMEDIATE
                  AtomChannelOneShotMode = 0
                  AtomChannelTriggerOutput = TRIG_FROM_PREVIOUS_CHANNEL
                  AtomModeControlBits = 0
                  AtomServeLastAruCommStrategy = 0
                AtomChannelUsage: AtomChannelUsage=USED_BY_OTHER_DRIVERS_OR_UNUSED
              AtomChannel_1
                AtomChannelAruConfiguration: AtomChAruBlockingMode=GTM_ABM_DISABLED, AtomChAruReadAddress0=510, AtomChAruReadAddress1=510, AtomChannelAruEnable=0, AtomChannelCpuWriteRequest=0
                AtomChannelEnable: AtomChDisableOnAgcTrigger=0, AtomChannelEnable=AT_START
                AtomChannelInterrupt:
                  AtomCcu0Notification = NULL_PTR
                  AtomCcu1Notification = NULL_PTR
                  AtomGlobalCcuSel = 0
                  AtomIntEnableOnCcu0Trigger = 0
                  AtomIntEnableOnCcu1Trigger = 0
                  AtomInterruptMode = GTM_INTERRUPT_LEVEL_MODE
                  AtomNotification = NULL_PTR
                AtomChannelOutput:
                  AtomChOutputDisableOnAgcTrig = 0
                  AtomChannelOutputControl = DONT_ENABLE_CHANNEL_OUTPUT
                  AtomChannelOutputSignalLevel = LOW
                  AtomChannelPortPinSelect = TOUT19_SELC_PORT0_PIN10
                AtomChannelTimerParameters:
                  AtomChEnableForceUpdate = 0
                  AtomChResetCn0OnForceUpdate = 0
                  AtomChShadowCompareValSr0 = 0
                  AtomChShadowCompareValSr1 = 0
                  AtomChSomcCompareStrategy = TIMEBASE_GREATER_EQUAL_TO_CMx
                  AtomChSomcTimebaseForComparison = TBU_TS1
                  AtomChUpdateEnableOnCn0Reset = 0
                  AtomChannelClockSelect = GTM_CONFIGURABLE_CLOCK_0
                  AtomChannelCompareValueCm0 = 0
                  AtomChannelCompareValueCm1 = 0
                  AtomChannelCounterCn0Reset = ON_COMPARE_MATCH_ON_CHANNEL
                  AtomChannelCounterValCn0 = 0
                  AtomChannelModeSelect = ATOM_SIG_OUTPUT_MODE_IMMEDIATE
                  AtomChannelOneShotMode = 0
                  AtomChannelTriggerOutput = TRIG_FROM_PREVIOUS_CHANNEL
                  AtomModeControlBits = 0
                  AtomServeLastAruCommStrategy = 0
                AtomChannelUsage: AtomChannelUsage=USED_BY_OTHER_DRIVERS_OR_UNUSED
              AtomChannel_2
                AtomChannelAruConfiguration: AtomChAruBlockingMode=GTM_ABM_DISABLED, AtomChAruReadAddress0=510, AtomChAruReadAddress1=510, AtomChannelAruEnable=0, AtomChannelCpuWriteRequest=0
                AtomChannelEnable: AtomChDisableOnAgcTrigger=0, AtomChannelEnable=AT_START
                AtomChannelInterrupt:
                  AtomCcu0Notification = NULL_PTR
                  AtomCcu1Notification = NULL_PTR
                  AtomGlobalCcuSel = 0
                  AtomIntEnableOnCcu0Trigger = 0
                  AtomIntEnableOnCcu1Trigger = 0
                  AtomInterruptMode = GTM_INTERRUPT_LEVEL_MODE
                  AtomNotification = NULL_PTR
                AtomChannelOutput:
                  AtomChOutputDisableOnAgcTrig = 0
                  AtomChannelOutputControl = DONT_ENABLE_CHANNEL_OUTPUT
                  AtomChannelOutputSignalLevel = LOW
                  AtomChannelPortPinSelect = TOUT20_SELC_PORT0_PIN11
                AtomChannelTimerParameters:
                  AtomChEnableForceUpdate = 0
                  AtomChResetCn0OnForceUpdate = 0
                  AtomChShadowCompareValSr0 = 0
                  AtomChShadowCompareValSr1 = 0
                  AtomChSomcCompareStrategy = TIMEBASE_GREATER_EQUAL_TO_CMx
                  AtomChSomcTimebaseForComparison = TBU_TS1
                  AtomChUpdateEnableOnCn0Reset = 0
                  AtomChannelClockSelect = GTM_CONFIGURABLE_CLOCK_0
                  AtomChannelCompareValueCm0 = 0
                  AtomChannelCompareValueCm1 = 0
                  AtomChannelCounterCn0Reset = ON_COMPARE_MATCH_ON_CHANNEL
                  AtomChannelCounterValCn0 = 0
                  AtomChannelModeSelect = ATOM_SIG_OUTPUT_MODE_IMMEDIATE
                  AtomChannelOneShotMode = 0
                  AtomChannelTriggerOutput = TRIG_FROM_PREVIOUS_CHANNEL
                  AtomModeControlBits = 0
                  AtomServeLastAruCommStrategy = 0
                AtomChannelUsage: AtomChannelUsage=USED_BY_OTHER_DRIVERS_OR_UNUSED
              AtomChannel_3
                AtomChannelAruConfiguration: AtomChAruBlockingMode=GTM_ABM_DISABLED, AtomChAruReadAddress0=510, AtomChAruReadAddress1=510, AtomChannelAruEnable=0, AtomChannelCpuWriteRequest=0
                AtomChannelEnable: AtomChDisableOnAgcTrigger=0, AtomChannelEnable=AT_START
                AtomChannelInterrupt:
                  AtomCcu0Notification = NULL_PTR
                  AtomCcu1Notification = NULL_PTR
                  AtomGlobalCcuSel = 0
                  AtomIntEnableOnCcu0Trigger = 0
                  AtomIntEnableOnCcu1Trigger = 0
                  AtomInterruptMode = GTM_INTERRUPT_LEVEL_MODE
                  AtomNotification = NULL_PTR
                AtomChannelOutput:
                  AtomChOutputDisableOnAgcTrig = 0
                  AtomChannelOutputControl = DONT_ENABLE_CHANNEL_OUTPUT
                  AtomChannelOutputSignalLevel = LOW
                  AtomChannelPortPinSelect = TOUT21_SELC_PORT0_PIN12
                AtomChannelTimerParameters:
                  AtomChEnableForceUpdate = 0
                  AtomChResetCn0OnForceUpdate = 0
                  AtomChShadowCompareValSr0 = 0
                  AtomChShadowCompareValSr1 = 0
                  AtomChSomcCompareStrategy = TIMEBASE_GREATER_EQUAL_TO_CMx
                  AtomChSomcTimebaseForComparison = TBU_TS1
                  AtomChUpdateEnableOnCn0Reset = 0
                  AtomChannelClockSelect = GTM_CONFIGURABLE_CLOCK_0
                  AtomChannelCompareValueCm0 = 0
                  AtomChannelCompareValueCm1 = 0
                  AtomChannelCounterCn0Reset = ON_COMPARE_MATCH_ON_CHANNEL
                  AtomChannelCounterValCn0 = 0
                  AtomChannelModeSelect = ATOM_SIG_OUTPUT_MODE_IMMEDIATE
                  AtomChannelOneShotMode = 0
                  AtomChannelTriggerOutput = TRIG_FROM_PREVIOUS_CHANNEL
                  AtomModeControlBits = 0
                  AtomServeLastAruCommStrategy = 0
                AtomChannelUsage: AtomChannelUsage=USED_BY_OTHER_DRIVERS_OR_UNUSED
              AtomChannel_4
                AtomChannelAruConfiguration: AtomChAruBlockingMode=GTM_ABM_DISABLED, AtomChAruReadAddress0=510, AtomChAruReadAddress1=510, AtomChannelAruEnable=0, AtomChannelCpuWriteRequest=0
                AtomChannelEnable: AtomChDisableOnAgcTrigger=0, AtomChannelEnable=AT_START
                AtomChannelInterrupt:
                  AtomCcu0Notification = NULL_PTR
                  AtomCcu1Notification = NULL_PTR
                  AtomGlobalCcuSel = 0
                  AtomIntEnableOnCcu0Trigger = 0
                  AtomIntEnableOnCcu1Trigger = 0
                  AtomInterruptMode = GTM_INTERRUPT_LEVEL_MODE
                  AtomNotification = NULL_PTR
                AtomChannelOutput:
                  AtomChOutputDisableOnAgcTrig = 0
                  AtomChannelOutputControl = DONT_ENABLE_CHANNEL_OUTPUT
                  AtomChannelOutputSignalLevel = LOW
                  AtomChannelPortPinSelect = TOUT98_SELC_PORT11_PIN9
                AtomChannelTimerParameters:
                  AtomChEnableForceUpdate = 0
                  AtomChResetCn0OnForceUpdate = 0
                  AtomChShadowCompareValSr0 = 0
                  AtomChShadowCompareValSr1 = 0
                  AtomChSomcCompareStrategy = TIMEBASE_GREATER_EQUAL_TO_CMx
                  AtomChSomcTimebaseForComparison = TBU_TS1
                  AtomChUpdateEnableOnCn0Reset = 0
                  AtomChannelClockSelect = GTM_CONFIGURABLE_CLOCK_0
                  AtomChannelCompareValueCm0 = 0
                  AtomChannelCompareValueCm1 = 0
                  AtomChannelCounterCn0Reset = ON_COMPARE_MATCH_ON_CHANNEL
                  AtomChannelCounterValCn0 = 0
                  AtomChannelModeSelect = ATOM_SIG_OUTPUT_MODE_IMMEDIATE
                  AtomChannelOneShotMode = 0
                  AtomChannelTriggerOutput = TRIG_FROM_PREVIOUS_CHANNEL
                  AtomModeControlBits = 0
                  AtomServeLastAruCommStrategy = 0
                AtomChannelUsage: AtomChannelUsage=USED_BY_OTHER_DRIVERS_OR_UNUSED
              AtomChannel_5
                AtomChannelAruConfiguration: AtomChAruBlockingMode=GTM_ABM_DISABLED, AtomChAruReadAddress0=510, AtomChAruReadAddress1=510, AtomChannelAruEnable=0, AtomChannelCpuWriteRequest=0
                AtomChannelEnable: AtomChDisableOnAgcTrigger=0, AtomChannelEnable=AT_START
                AtomChannelInterrupt:
                  AtomCcu0Notification = NULL_PTR
                  AtomCcu1Notification = NULL_PTR
                  AtomGlobalCcuSel = 0
                  AtomIntEnableOnCcu0Trigger = 0
                  AtomIntEnableOnCcu1Trigger = 0
                  AtomInterruptMode = GTM_INTERRUPT_LEVEL_MODE
                  AtomNotification = NULL_PTR
                AtomChannelOutput:
                  AtomChOutputDisableOnAgcTrig = 0
                  AtomChannelOutputControl = DONT_ENABLE_CHANNEL_OUTPUT
                  AtomChannelOutputSignalLevel = LOW
                  AtomChannelPortPinSelect = TOUT99_SELC_PORT11_PIN10
                AtomChannelTimerParameters:
                  AtomChEnableForceUpdate = 0
                  AtomChResetCn0OnForceUpdate = 0
                  AtomChShadowCompareValSr0 = 0
                  AtomChShadowCompareValSr1 = 0
                  AtomChSomcCompareStrategy = TIMEBASE_GREATER_EQUAL_TO_CMx
                  AtomChSomcTimebaseForComparison = TBU_TS1
                  AtomChUpdateEnableOnCn0Reset = 0
                  AtomChannelClockSelect = GTM_CONFIGURABLE_CLOCK_0
                  AtomChannelCompareValueCm0 = 0
                  AtomChannelCompareValueCm1 = 0
                  AtomChannelCounterCn0Reset = ON_COMPARE_MATCH_ON_CHANNEL
                  AtomChannelCounterValCn0 = 0
                  AtomChannelModeSelect = ATOM_SIG_OUTPUT_MODE_IMMEDIATE
                  AtomChannelOneShotMode = 0
                  AtomChannelTriggerOutput = TRIG_FROM_PREVIOUS_CHANNEL
                  AtomModeControlBits = 0
                  AtomServeLastAruCommStrategy = 0
                AtomChannelUsage: AtomChannelUsage=USED_BY_OTHER_DRIVERS_OR_UNUSED
              AtomChannel_6
                AtomChannelAruConfiguration: AtomChAruBlockingMode=GTM_ABM_DISABLED, AtomChAruReadAddress0=510, AtomChAruReadAddress1=510, AtomChannelAruEnable=0, AtomChannelCpuWriteRequest=0
                AtomChannelEnable: AtomChDisableOnAgcTrigger=0, AtomChannelEnable=AT_START
                AtomChannelInterrupt:
                  AtomCcu0Notification = NULL_PTR
                  AtomCcu1Notification = NULL_PTR
                  AtomGlobalCcuSel = 0
                  AtomIntEnableOnCcu0Trigger = 0
                  AtomIntEnableOnCcu1Trigger = 0
                  AtomInterruptMode = GTM_INTERRUPT_LEVEL_MODE
                  AtomNotification = NULL_PTR
                AtomChannelOutput:
                  AtomChOutputDisableOnAgcTrig = 0
                  AtomChannelOutputControl = DONT_ENABLE_CHANNEL_OUTPUT
                  AtomChannelOutputSignalLevel = LOW
                  AtomChannelPortPinSelect = TOUT100_SELC_PORT11_PIN11
                AtomChannelTimerParameters:
                  AtomChEnableForceUpdate = 0
                  AtomChResetCn0OnForceUpdate = 0
                  AtomChShadowCompareValSr0 = 0
                  AtomChShadowCompareValSr1 = 0
                  AtomChSomcCompareStrategy = TIMEBASE_GREATER_EQUAL_TO_CMx
                  AtomChSomcTimebaseForComparison = TBU_TS1
                  AtomChUpdateEnableOnCn0Reset = 0
                  AtomChannelClockSelect = GTM_CONFIGURABLE_CLOCK_0
                  AtomChannelCompareValueCm0 = 0
                  AtomChannelCompareValueCm1 = 0
                  AtomChannelCounterCn0Reset = ON_COMPARE_MATCH_ON_CHANNEL
                  AtomChannelCounterValCn0 = 0
                  AtomChannelModeSelect = ATOM_SIG_OUTPUT_MODE_IMMEDIATE
                  AtomChannelOneShotMode = 0
                  AtomChannelTriggerOutput = TRIG_FROM_PREVIOUS_CHANNEL
                  AtomModeControlBits = 0
                  AtomServeLastAruCommStrategy = 0
                AtomChannelUsage: AtomChannelUsage=USED_BY_OTHER_DRIVERS_OR_UNUSED
              AtomChannel_7
                AtomChannelAruConfiguration: AtomChAruBlockingMode=GTM_ABM_DISABLED, AtomChAruReadAddress0=510, AtomChAruReadAddress1=510, AtomChannelAruEnable=0, AtomChannelCpuWriteRequest=0
                AtomChannelEnable: AtomChDisableOnAgcTrigger=0, AtomChannelEnable=AT_START
                AtomChannelInterrupt:
                  AtomCcu0Notification = NULL_PTR
                  AtomCcu1Notification = NULL_PTR
                  AtomGlobalCcuSel = 0
                  AtomIntEnableOnCcu0Trigger = 0
                  AtomIntEnableOnCcu1Trigger = 0
                  AtomInterruptMode = GTM_INTERRUPT_LEVEL_MODE
                  AtomNotification = NULL_PTR
                AtomChannelOutput:
                  AtomChOutputDisableOnAgcTrig = 0
                  AtomChannelOutputControl = DONT_ENABLE_CHANNEL_OUTPUT
                  AtomChannelOutputSignalLevel = LOW
                  AtomChannelPortPinSelect = TOUT101_SELC_PORT11_PIN12
                AtomChannelTimerParameters:
                  AtomChEnableForceUpdate = 0
                  AtomChResetCn0OnForceUpdate = 0
                  AtomChShadowCompareValSr0 = 0
                  AtomChShadowCompareValSr1 = 0
                  AtomChSomcCompareStrategy = TIMEBASE_GREATER_EQUAL_TO_CMx
                  AtomChSomcTimebaseForComparison = TBU_TS1
                  AtomChUpdateEnableOnCn0Reset = 0
                  AtomChannelClockSelect = GTM_CONFIGURABLE_CLOCK_0
                  AtomChannelCompareValueCm0 = 0
                  AtomChannelCompareValueCm1 = 0
                  AtomChannelCounterCn0Reset = ON_COMPARE_MATCH_ON_CHANNEL
                  AtomChannelCounterValCn0 = 0
                  AtomChannelModeSelect = ATOM_SIG_OUTPUT_MODE_IMMEDIATE
                  AtomChannelOneShotMode = 0
                  AtomChannelTriggerOutput = TRIG_FROM_PREVIOUS_CHANNEL
                  AtomModeControlBits = 0
                  AtomServeLastAruCommStrategy = 0
                AtomChannelUsage: AtomChannelUsage=USED_BY_OTHER_DRIVERS_OR_UNUSED
            AtomTriggerForAgc
              AtomAgcInternalTriggerSelect:
                AtomAgcIntTriggerFromChannel{0..7} = 0
              AtomAgcTriggerByTimebase: AtomAgcTbuTimebaseSelect=TBU_TS0_TIMEBASE, AtomAgcTimeBaseTriggerEnable=0, AtomAgcTimebaseMatchValue=0
          Atom_3
            8 x AtomChannel:
              AtomChannel_0
                AtomChannelAruConfiguration: AtomChAruBlockingMode=GTM_ABM_DISABLED, AtomChAruReadAddress0=510, AtomChAruReadAddress1=510, AtomChannelAruEnable=0, AtomChannelCpuWriteRequest=0
                AtomChannelEnable: AtomChDisableOnAgcTrigger=0, AtomChannelEnable=AT_START
                AtomChannelInterrupt:
                  AtomCcu0Notification = NULL_PTR
                  AtomCcu1Notification = NULL_PTR
                  AtomGlobalCcuSel = 0
                  AtomIntEnableOnCcu0Trigger = 0
                  AtomIntEnableOnCcu1Trigger = 0
                  AtomInterruptMode = GTM_INTERRUPT_LEVEL_MODE
                  AtomNotification = NULL_PTR
                AtomChannelOutput:
                  AtomChOutputDisableOnAgcTrig = 0
                  AtomChannelOutputControl = DONT_ENABLE_CHANNEL_OUTPUT
                  AtomChannelOutputSignalLevel = LOW
                  AtomChannelPortPinSelect = TOUT18_SELD_PORT0_PIN9
                AtomChannelTimerParameters:
                  AtomChEnableForceUpdate = 0
                  AtomChResetCn0OnForceUpdate = 0
                  AtomChShadowCompareValSr0 = 0
                  AtomChShadowCompareValSr1 = 0
                  AtomChSomcCompareStrategy = TIMEBASE_GREATER_EQUAL_TO_CMx
                  AtomChSomcTimebaseForComparison = TBU_TS1
                  AtomChUpdateEnableOnCn0Reset = 0
                  AtomChannelClockSelect = GTM_CONFIGURABLE_CLOCK_0
                  AtomChannelCompareValueCm0 = 0
                  AtomChannelCompareValueCm1 = 0
                  AtomChannelCounterCn0Reset = ON_COMPARE_MATCH_ON_CHANNEL
                  AtomChannelCounterValCn0 = 0
                  AtomChannelModeSelect = ATOM_SIG_OUTPUT_MODE_IMMEDIATE
                  AtomChannelOneShotMode = 0
                  AtomChannelTriggerOutput = TRIG_FROM_PREVIOUS_CHANNEL
                  AtomModeControlBits = 0
                  AtomServeLastAruCommStrategy = 0
                AtomChannelUsage: AtomChannelUsage=USED_BY_OTHER_DRIVERS_OR_UNUSED
              AtomChannel_1
                AtomChannelAruConfiguration: AtomChAruBlockingMode=GTM_ABM_DISABLED, AtomChAruReadAddress0=510, AtomChAruReadAddress1=510, AtomChannelAruEnable=0, AtomChannelCpuWriteRequest=0
                AtomChannelEnable: AtomChDisableOnAgcTrigger=0, AtomChannelEnable=AT_START
                AtomChannelInterrupt:
                  AtomCcu0Notification = NULL_PTR
                  AtomCcu1Notification = NULL_PTR
                  AtomGlobalCcuSel = 0
                  AtomIntEnableOnCcu0Trigger = 0
                  AtomIntEnableOnCcu1Trigger = 0
                  AtomInterruptMode = GTM_INTERRUPT_LEVEL_MODE
                  AtomNotification = NULL_PTR
                AtomChannelOutput:
                  AtomChOutputDisableOnAgcTrig = 0
                  AtomChannelOutputControl = DONT_ENABLE_CHANNEL_OUTPUT
                  AtomChannelOutputSignalLevel = LOW
                  AtomChannelPortPinSelect = TOUT19_SELD_PORT0_PIN10
                AtomChannelTimerParameters:
                  AtomChEnableForceUpdate = 0
                  AtomChResetCn0OnForceUpdate = 0
                  AtomChShadowCompareValSr0 = 0
                  AtomChShadowCompareValSr1 = 0
                  AtomChSomcCompareStrategy = TIMEBASE_GREATER_EQUAL_TO_CMx
                  AtomChSomcTimebaseForComparison = TBU_TS1
                  AtomChUpdateEnableOnCn0Reset = 0
                  AtomChannelClockSelect = GTM_CONFIGURABLE_CLOCK_0
                  AtomChannelCompareValueCm0 = 0
                  AtomChannelCompareValueCm1 = 0
                  AtomChannelCounterCn0Reset = ON_COMPARE_MATCH_ON_CHANNEL
                  AtomChannelCounterValCn0 = 0
                  AtomChannelModeSelect = ATOM_SIG_OUTPUT_MODE_IMMEDIATE
                  AtomChannelOneShotMode = 0
                  AtomChannelTriggerOutput = TRIG_FROM_PREVIOUS_CHANNEL
                  AtomModeControlBits = 0
                  AtomServeLastAruCommStrategy = 0
                AtomChannelUsage: AtomChannelUsage=USED_BY_OTHER_DRIVERS_OR_UNUSED
              AtomChannel_2
                AtomChannelAruConfiguration: AtomChAruBlockingMode=GTM_ABM_DISABLED, AtomChAruReadAddress0=510, AtomChAruReadAddress1=510, AtomChannelAruEnable=0, AtomChannelCpuWriteRequest=0
                AtomChannelEnable: AtomChDisableOnAgcTrigger=0, AtomChannelEnable=AT_START
                AtomChannelInterrupt:
                  AtomCcu0Notification = NULL_PTR
                  AtomCcu1Notification = NULL_PTR
                  AtomGlobalCcuSel = 0
                  AtomIntEnableOnCcu0Trigger = 0
                  AtomIntEnableOnCcu1Trigger = 0
                  AtomInterruptMode = GTM_INTERRUPT_LEVEL_MODE
                  AtomNotification = NULL_PTR
                AtomChannelOutput:
                  AtomChOutputDisableOnAgcTrig = 0
                  AtomChannelOutputControl = DONT_ENABLE_CHANNEL_OUTPUT
                  AtomChannelOutputSignalLevel = LOW
                  AtomChannelPortPinSelect = TOUT20_SELD_PORT0_PIN11
                AtomChannelTimerParameters:
                  AtomChEnableForceUpdate = 0
                  AtomChResetCn0OnForceUpdate = 0
                  AtomChShadowCompareValSr0 = 0
                  AtomChShadowCompareValSr1 = 0
                  AtomChSomcCompareStrategy = TIMEBASE_GREATER_EQUAL_TO_CMx
                  AtomChSomcTimebaseForComparison = TBU_TS1
                  AtomChUpdateEnableOnCn0Reset = 0
                  AtomChannelClockSelect = GTM_CONFIGURABLE_CLOCK_0
                  AtomChannelCompareValueCm0 = 0
                  AtomChannelCompareValueCm1 = 0
                  AtomChannelCounterCn0Reset = ON_COMPARE_MATCH_ON_CHANNEL
                  AtomChannelCounterValCn0 = 0
                  AtomChannelModeSelect = ATOM_SIG_OUTPUT_MODE_IMMEDIATE
                  AtomChannelOneShotMode = 0
                  AtomChannelTriggerOutput = TRIG_FROM_PREVIOUS_CHANNEL
                  AtomModeControlBits = 0
                  AtomServeLastAruCommStrategy = 0
                AtomChannelUsage: AtomChannelUsage=USED_BY_OTHER_DRIVERS_OR_UNUSED
              AtomChannel_3
                AtomChannelAruConfiguration: AtomChAruBlockingMode=GTM_ABM_DISABLED, AtomChAruReadAddress0=510, AtomChAruReadAddress1=510, AtomChannelAruEnable=0, AtomChannelCpuWriteRequest=0
                AtomChannelEnable: AtomChDisableOnAgcTrigger=0, AtomChannelEnable=AT_START
                AtomChannelInterrupt:
                  AtomCcu0Notification = NULL_PTR
                  AtomCcu1Notification = NULL_PTR
                  AtomGlobalCcuSel = 0
                  AtomIntEnableOnCcu0Trigger = 0
                  AtomIntEnableOnCcu1Trigger = 0
                  AtomInterruptMode = GTM_INTERRUPT_LEVEL_MODE
                  AtomNotification = NULL_PTR
                AtomChannelOutput:
                  AtomChOutputDisableOnAgcTrig = 0
                  AtomChannelOutputControl = DONT_ENABLE_CHANNEL_OUTPUT
                  AtomChannelOutputSignalLevel = LOW
                  AtomChannelPortPinSelect = TOUT21_SELD_PORT0_PIN12
                AtomChannelTimerParameters:
                  AtomChEnableForceUpdate = 0
                  AtomChResetCn0OnForceUpdate = 0
                  AtomChShadowCompareValSr0 = 0
                  AtomChShadowCompareValSr1 = 0
                  AtomChSomcCompareStrategy = TIMEBASE_GREATER_EQUAL_TO_CMx
                  AtomChSomcTimebaseForComparison = TBU_TS1
                  AtomChUpdateEnableOnCn0Reset = 0
                  AtomChannelClockSelect = GTM_CONFIGURABLE_CLOCK_0
                  AtomChannelCompareValueCm0 = 0
                  AtomChannelCompareValueCm1 = 0
                  AtomChannelCounterCn0Reset = ON_COMPARE_MATCH_ON_CHANNEL
                  AtomChannelCounterValCn0 = 0
                  AtomChannelModeSelect = ATOM_SIG_OUTPUT_MODE_IMMEDIATE
                  AtomChannelOneShotMode = 0
                  AtomChannelTriggerOutput = TRIG_FROM_PREVIOUS_CHANNEL
                  AtomModeControlBits = 0
                  AtomServeLastAruCommStrategy = 0
                AtomChannelUsage: AtomChannelUsage=USED_BY_OTHER_DRIVERS_OR_UNUSED
              AtomChannel_4
                AtomChannelAruConfiguration: AtomChAruBlockingMode=GTM_ABM_DISABLED, AtomChAruReadAddress0=510, AtomChAruReadAddress1=510, AtomChannelAruEnable=0, AtomChannelCpuWriteRequest=0
                AtomChannelEnable: AtomChDisableOnAgcTrigger=0, AtomChannelEnable=AT_START
                AtomChannelInterrupt:
                  AtomCcu0Notification = NULL_PTR
                  AtomCcu1Notification = NULL_PTR
                  AtomGlobalCcuSel = 0
                  AtomIntEnableOnCcu0Trigger = 0
                  AtomIntEnableOnCcu1Trigger = 0
                  AtomInterruptMode = GTM_INTERRUPT_LEVEL_MODE
                  AtomNotification = NULL_PTR
                AtomChannelOutput:
                  AtomChOutputDisableOnAgcTrig = 0
                  AtomChannelOutputControl = DONT_ENABLE_CHANNEL_OUTPUT
                  AtomChannelOutputSignalLevel = LOW
                  AtomChannelPortPinSelect = TOUT98_SELD_PORT11_PIN9
                AtomChannelTimerParameters:
                  AtomChEnableForceUpdate = 0
                  AtomChResetCn0OnForceUpdate = 0
                  AtomChShadowCompareValSr0 = 0
                  AtomChShadowCompareValSr1 = 0
                  AtomChSomcCompareStrategy = TIMEBASE_GREATER_EQUAL_TO_CMx
                  AtomChSomcTimebaseForComparison = TBU_TS1
                  AtomChUpdateEnableOnCn0Reset = 0
                  AtomChannelClockSelect = GTM_CONFIGURABLE_CLOCK_0
                  AtomChannelCompareValueCm0 = 0
                  AtomChannelCompareValueCm1 = 0
                  AtomChannelCounterCn0Reset = ON_COMPARE_MATCH_ON_CHANNEL
                  AtomChannelCounterValCn0 = 0
                  AtomChannelModeSelect = ATOM_SIG_OUTPUT_MODE_IMMEDIATE
                  AtomChannelOneShotMode = 0
                  AtomChannelTriggerOutput = TRIG_FROM_PREVIOUS_CHANNEL
                  AtomModeControlBits = 0
                  AtomServeLastAruCommStrategy = 0
                AtomChannelUsage: AtomChannelUsage=USED_BY_OTHER_DRIVERS_OR_UNUSED
              AtomChannel_5
                AtomChannelAruConfiguration: AtomChAruBlockingMode=GTM_ABM_DISABLED, AtomChAruReadAddress0=510, AtomChAruReadAddress1=510, AtomChannelAruEnable=0, AtomChannelCpuWriteRequest=0
                AtomChannelEnable: AtomChDisableOnAgcTrigger=0, AtomChannelEnable=AT_START
                AtomChannelInterrupt:
                  AtomCcu0Notification = NULL_PTR
                  AtomCcu1Notification = NULL_PTR
                  AtomGlobalCcuSel = 0
                  AtomIntEnableOnCcu0Trigger = 0
                  AtomIntEnableOnCcu1Trigger = 0
                  AtomInterruptMode = GTM_INTERRUPT_LEVEL_MODE
                  AtomNotification = NULL_PTR
                AtomChannelOutput:
                  AtomChOutputDisableOnAgcTrig = 0
                  AtomChannelOutputControl = DONT_ENABLE_CHANNEL_OUTPUT
                  AtomChannelOutputSignalLevel = LOW
                  AtomChannelPortPinSelect = TOUT99_SELD_PORT11_PIN10
                AtomChannelTimerParameters:
                  AtomChEnableForceUpdate = 0
                  AtomChResetCn0OnForceUpdate = 0
                  AtomChShadowCompareValSr0 = 0
                  AtomChShadowCompareValSr1 = 0
                  AtomChSomcCompareStrategy = TIMEBASE_GREATER_EQUAL_TO_CMx
                  AtomChSomcTimebaseForComparison = TBU_TS1
                  AtomChUpdateEnableOnCn0Reset = 0
                  AtomChannelClockSelect = GTM_CONFIGURABLE_CLOCK_0
                  AtomChannelCompareValueCm0 = 0
                  AtomChannelCompareValueCm1 = 0
                  AtomChannelCounterCn0Reset = ON_COMPARE_MATCH_ON_CHANNEL
                  AtomChannelCounterValCn0 = 0
                  AtomChannelModeSelect = ATOM_SIG_OUTPUT_MODE_IMMEDIATE
                  AtomChannelOneShotMode = 0
                  AtomChannelTriggerOutput = TRIG_FROM_PREVIOUS_CHANNEL
                  AtomModeControlBits = 0
                  AtomServeLastAruCommStrategy = 0
                AtomChannelUsage: AtomChannelUsage=USED_BY_OTHER_DRIVERS_OR_UNUSED
              AtomChannel_6
                AtomChannelAruConfiguration: AtomChAruBlockingMode=GTM_ABM_DISABLED, AtomChAruReadAddress0=510, AtomChAruReadAddress1=510, AtomChannelAruEnable=0, AtomChannelCpuWriteRequest=0
                AtomChannelEnable: AtomChDisableOnAgcTrigger=0, AtomChannelEnable=AT_START
                AtomChannelInterrupt:
                  AtomCcu0Notification = NULL_PTR
                  AtomCcu1Notification = NULL_PTR
                  AtomGlobalCcuSel = 0
                  AtomIntEnableOnCcu0Trigger = 0
                  AtomIntEnableOnCcu1Trigger = 0
                  AtomInterruptMode = GTM_INTERRUPT_LEVEL_MODE
                  AtomNotification = NULL_PTR
                AtomChannelOutput:
                  AtomChOutputDisableOnAgcTrig = 0
                  AtomChannelOutputControl = DONT_ENABLE_CHANNEL_OUTPUT
                  AtomChannelOutputSignalLevel = LOW
                  AtomChannelPortPinSelect = TOUT100_SELD_PORT11_PIN11
                AtomChannelTimerParameters:
                  AtomChEnableForceUpdate = 0
                  AtomChResetCn0OnForceUpdate = 0
                  AtomChShadowCompareValSr0 = 0
                  AtomChShadowCompareValSr1 = 0
                  AtomChSomcCompareStrategy = TIMEBASE_GREATER_EQUAL_TO_CMx
                  AtomChSomcTimebaseForComparison = TBU_TS1
                  AtomChUpdateEnableOnCn0Reset = 0
                  AtomChannelClockSelect = GTM_CONFIGURABLE_CLOCK_0
                  AtomChannelCompareValueCm0 = 0
                  AtomChannelCompareValueCm1 = 0
                  AtomChannelCounterCn0Reset = ON_COMPARE_MATCH_ON_CHANNEL
                  AtomChannelCounterValCn0 = 0
                  AtomChannelModeSelect = ATOM_SIG_OUTPUT_MODE_IMMEDIATE
                  AtomChannelOneShotMode = 0
                  AtomChannelTriggerOutput = TRIG_FROM_PREVIOUS_CHANNEL
                  AtomModeControlBits = 0
                  AtomServeLastAruCommStrategy = 0
                AtomChannelUsage: AtomChannelUsage=USED_BY_OTHER_DRIVERS_OR_UNUSED
              AtomChannel_7
                AtomChannelAruConfiguration: AtomChAruBlockingMode=GTM_ABM_DISABLED, AtomChAruReadAddress0=510, AtomChAruReadAddress1=510, AtomChannelAruEnable=0, AtomChannelCpuWriteRequest=0
                AtomChannelEnable: AtomChDisableOnAgcTrigger=0, AtomChannelEnable=AT_START
                AtomChannelInterrupt:
                  AtomCcu0Notification = NULL_PTR
                  AtomCcu1Notification = NULL_PTR
                  AtomGlobalCcuSel = 0
                  AtomIntEnableOnCcu0Trigger = 0
                  AtomIntEnableOnCcu1Trigger = 0
                  AtomInterruptMode = GTM_INTERRUPT_LEVEL_MODE
                  AtomNotification = NULL_PTR
                AtomChannelOutput:
                  AtomChOutputDisableOnAgcTrig = 0
                  AtomChannelOutputControl = DONT_ENABLE_CHANNEL_OUTPUT
                  AtomChannelOutputSignalLevel = LOW
                  AtomChannelPortPinSelect = TOUT101_SELD_PORT11_PIN12
                AtomChannelTimerParameters:
                  AtomChEnableForceUpdate = 0
                  AtomChResetCn0OnForceUpdate = 0
                  AtomChShadowCompareValSr0 = 0
                  AtomChShadowCompareValSr1 = 0
                  AtomChSomcCompareStrategy = TIMEBASE_GREATER_EQUAL_TO_CMx
                  AtomChSomcTimebaseForComparison = TBU_TS1
                  AtomChUpdateEnableOnCn0Reset = 0
                  AtomChannelClockSelect = GTM_CONFIGURABLE_CLOCK_0
                  AtomChannelCompareValueCm0 = 0
                  AtomChannelCompareValueCm1 = 0
                  AtomChannelCounterCn0Reset = ON_COMPARE_MATCH_ON_CHANNEL
                  AtomChannelCounterValCn0 = 0
                  AtomChannelModeSelect = ATOM_SIG_OUTPUT_MODE_IMMEDIATE
                  AtomChannelOneShotMode = 0
                  AtomChannelTriggerOutput = TRIG_FROM_PREVIOUS_CHANNEL
                  AtomModeControlBits = 0
                  AtomServeLastAruCommStrategy = 0
                AtomChannelUsage: AtomChannelUsage=USED_BY_OTHER_DRIVERS_OR_UNUSED
            AtomTriggerForAgc
              AtomAgcInternalTriggerSelect:
                AtomAgcIntTriggerFromChannel{0..7} = 0
              AtomAgcTriggerByTimebase: AtomAgcTbuTimebaseSelect=TBU_TS0_TIMEBASE, AtomAgcTimeBaseTriggerEnable=0, AtomAgcTimebaseMatchValue=0
          Atom_4
            8 x AtomChannel:
              AtomChannel_0
                AtomChannelAruConfiguration: AtomChAruBlockingMode=GTM_ABM_DISABLED, AtomChAruReadAddress0=510, AtomChAruReadAddress1=510, AtomChannelAruEnable=0, AtomChannelCpuWriteRequest=0
                AtomChannelEnable: AtomChDisableOnAgcTrigger=0, AtomChannelEnable=AT_START
                AtomChannelInterrupt:
                  AtomCcu0Notification = NULL_PTR
                  AtomCcu1Notification = NULL_PTR
                  AtomGlobalCcuSel = 0
                  AtomIntEnableOnCcu0Trigger = 0
                  AtomIntEnableOnCcu1Trigger = 0
                  AtomInterruptMode = GTM_INTERRUPT_LEVEL_MODE
                  AtomNotification = NULL_PTR
                AtomChannelOutput:
                  AtomChOutputDisableOnAgcTrig = 0
                  AtomChannelOutputControl = DONT_ENABLE_CHANNEL_OUTPUT
                  AtomChannelOutputSignalLevel = LOW
                  AtomChannelPortPinSelect = TOUT109_SELD_PORT10_PIN7
                AtomChannelTimerParameters:
                  AtomChEnableForceUpdate = 0
                  AtomChResetCn0OnForceUpdate = 0
                  AtomChShadowCompareValSr0 = 0
                  AtomChShadowCompareValSr1 = 0
                  AtomChSomcCompareStrategy = TIMEBASE_GREATER_EQUAL_TO_CMx
                  AtomChSomcTimebaseForComparison = TBU_TS1
                  AtomChUpdateEnableOnCn0Reset = 0
                  AtomChannelClockSelect = GTM_CONFIGURABLE_CLOCK_0
                  AtomChannelCompareValueCm0 = 0
                  AtomChannelCompareValueCm1 = 0
                  AtomChannelCounterCn0Reset = ON_COMPARE_MATCH_ON_CHANNEL
                  AtomChannelCounterValCn0 = 0
                  AtomChannelModeSelect = ATOM_SIG_OUTPUT_MODE_IMMEDIATE
                  AtomChannelOneShotMode = 0
                  AtomChannelTriggerOutput = TRIG_FROM_PREVIOUS_CHANNEL
                  AtomModeControlBits = 0
                  AtomServeLastAruCommStrategy = 0
                AtomChannelUsage: AtomChannelUsage=USED_BY_OTHER_DRIVERS_OR_UNUSED
              AtomChannel_1
                AtomChannelAruConfiguration: AtomChAruBlockingMode=GTM_ABM_DISABLED, AtomChAruReadAddress0=510, AtomChAruReadAddress1=510, AtomChannelAruEnable=0, AtomChannelCpuWriteRequest=0
                AtomChannelEnable: AtomChDisableOnAgcTrigger=0, AtomChannelEnable=AT_START
                AtomChannelInterrupt:
                  AtomCcu0Notification = NULL_PTR
                  AtomCcu1Notification = NULL_PTR
                  AtomGlobalCcuSel = 0
                  AtomIntEnableOnCcu0Trigger = 0
                  AtomIntEnableOnCcu1Trigger = 0
                  AtomInterruptMode = GTM_INTERRUPT_LEVEL_MODE
                  AtomNotification = NULL_PTR
                AtomChannelOutput:
                  AtomChOutputDisableOnAgcTrig = 0
                  AtomChannelOutputControl = DONT_ENABLE_CHANNEL_OUTPUT
                  AtomChannelOutputSignalLevel = LOW
                  AtomChannelPortPinSelect = TOUT103_SELD_PORT10_PIN1
                AtomChannelTimerParameters:
                  AtomChEnableForceUpdate = 0
                  AtomChResetCn0OnForceUpdate = 0
                  AtomChShadowCompareValSr0 = 0
                  AtomChShadowCompareValSr1 = 0
                  AtomChSomcCompareStrategy = TIMEBASE_GREATER_EQUAL_TO_CMx
                  AtomChSomcTimebaseForComparison = TBU_TS1
                  AtomChUpdateEnableOnCn0Reset = 0
                  AtomChannelClockSelect = GTM_CONFIGURABLE_CLOCK_0
                  AtomChannelCompareValueCm0 = 0
                  AtomChannelCompareValueCm1 = 0
                  AtomChannelCounterCn0Reset = ON_COMPARE_MATCH_ON_CHANNEL
                  AtomChannelCounterValCn0 = 0
                  AtomChannelModeSelect = ATOM_SIG_OUTPUT_MODE_IMMEDIATE
                  AtomChannelOneShotMode = 0
                  AtomChannelTriggerOutput = TRIG_FROM_PREVIOUS_CHANNEL
                  AtomModeControlBits = 0
                  AtomServeLastAruCommStrategy = 0
                AtomChannelUsage: AtomChannelUsage=USED_BY_OTHER_DRIVERS_OR_UNUSED
              AtomChannel_2
                AtomChannelAruConfiguration: AtomChAruBlockingMode=GTM_ABM_DISABLED, AtomChAruReadAddress0=510, AtomChAruReadAddress1=510, AtomChannelAruEnable=0, AtomChannelCpuWriteRequest=0
                AtomChannelEnable: AtomChDisableOnAgcTrigger=0, AtomChannelEnable=AT_START
                AtomChannelInterrupt:
                  AtomCcu0Notification = NULL_PTR
                  AtomCcu1Notification = NULL_PTR
                  AtomGlobalCcuSel = 0
                  AtomIntEnableOnCcu0Trigger = 0
                  AtomIntEnableOnCcu1Trigger = 0
                  AtomInterruptMode = GTM_INTERRUPT_LEVEL_MODE
                  AtomNotification = NULL_PTR
                AtomChannelOutput:
                  AtomChOutputDisableOnAgcTrig = 0
                  AtomChannelOutputControl = DONT_ENABLE_CHANNEL_OUTPUT
                  AtomChannelOutputSignalLevel = LOW
                  AtomChannelPortPinSelect = TOUT104_SELD_PORT10_PIN2
                AtomChannelTimerParameters:
                  AtomChEnableForceUpdate = 0
                  AtomChResetCn0OnForceUpdate = 0
                  AtomChShadowCompareValSr0 = 0
                  AtomChShadowCompareValSr1 = 0
                  AtomChSomcCompareStrategy = TIMEBASE_GREATER_EQUAL_TO_CMx
                  AtomChSomcTimebaseForComparison = TBU_TS1
                  AtomChUpdateEnableOnCn0Reset = 0
                  AtomChannelClockSelect = GTM_CONFIGURABLE_CLOCK_0
                  AtomChannelCompareValueCm0 = 0
                  AtomChannelCompareValueCm1 = 0
                  AtomChannelCounterCn0Reset = ON_COMPARE_MATCH_ON_CHANNEL
                  AtomChannelCounterValCn0 = 0
                  AtomChannelModeSelect = ATOM_SIG_OUTPUT_MODE_IMMEDIATE
                  AtomChannelOneShotMode = 0
                  AtomChannelTriggerOutput = TRIG_FROM_PREVIOUS_CHANNEL
                  AtomModeControlBits = 0
                  AtomServeLastAruCommStrategy = 0
                AtomChannelUsage: AtomChannelUsage=USED_BY_OTHER_DRIVERS_OR_UNUSED
              AtomChannel_3
                AtomChannelAruConfiguration: AtomChAruBlockingMode=GTM_ABM_DISABLED, AtomChAruReadAddress0=510, AtomChAruReadAddress1=510, AtomChannelAruEnable=0, AtomChannelCpuWriteRequest=0
                AtomChannelEnable: AtomChDisableOnAgcTrigger=0, AtomChannelEnable=AT_START
                AtomChannelInterrupt:
                  AtomCcu0Notification = NULL_PTR
                  AtomCcu1Notification = NULL_PTR
                  AtomGlobalCcuSel = 0
                  AtomIntEnableOnCcu0Trigger = 0
                  AtomIntEnableOnCcu1Trigger = 0
                  AtomInterruptMode = GTM_INTERRUPT_LEVEL_MODE
                  AtomNotification = NULL_PTR
                AtomChannelOutput:
                  AtomChOutputDisableOnAgcTrig = 0
                  AtomChannelOutputControl = DONT_ENABLE_CHANNEL_OUTPUT
                  AtomChannelOutputSignalLevel = LOW
                  AtomChannelPortPinSelect = TOUT105_SELD_PORT10_PIN3
                AtomChannelTimerParameters:
                  AtomChEnableForceUpdate = 0
                  AtomChResetCn0OnForceUpdate = 0
                  AtomChShadowCompareValSr0 = 0
                  AtomChShadowCompareValSr1 = 0
                  AtomChSomcCompareStrategy = TIMEBASE_GREATER_EQUAL_TO_CMx
                  AtomChSomcTimebaseForComparison = TBU_TS1
                  AtomChUpdateEnableOnCn0Reset = 0
                  AtomChannelClockSelect = GTM_CONFIGURABLE_CLOCK_0
                  AtomChannelCompareValueCm0 = 0
                  AtomChannelCompareValueCm1 = 0
                  AtomChannelCounterCn0Reset = ON_COMPARE_MATCH_ON_CHANNEL
                  AtomChannelCounterValCn0 = 0
                  AtomChannelModeSelect = ATOM_SIG_OUTPUT_MODE_IMMEDIATE
                  AtomChannelOneShotMode = 0
                  AtomChannelTriggerOutput = TRIG_FROM_PREVIOUS_CHANNEL
                  AtomModeControlBits = 0
                  AtomServeLastAruCommStrategy = 0
                AtomChannelUsage: AtomChannelUsage=USED_BY_OTHER_DRIVERS_OR_UNUSED
              AtomChannel_4
                AtomChannelAruConfiguration: AtomChAruBlockingMode=GTM_ABM_DISABLED, AtomChAruReadAddress0=510, AtomChAruReadAddress1=510, AtomChannelAruEnable=0, AtomChannelCpuWriteRequest=0
                AtomChannelEnable: AtomChDisableOnAgcTrigger=0, AtomChannelEnable=AT_START
                AtomChannelInterrupt:
                  AtomCcu0Notification = NULL_PTR
                  AtomCcu1Notification = NULL_PTR
                  AtomGlobalCcuSel = 0
                  AtomIntEnableOnCcu0Trigger = 0
                  AtomIntEnableOnCcu1Trigger = 0
                  AtomInterruptMode = GTM_INTERRUPT_LEVEL_MODE
                  AtomNotification = NULL_PTR
                AtomChannelOutput:
                  AtomChOutputDisableOnAgcTrig = 0
                  AtomChannelOutputControl = DONT_ENABLE_CHANNEL_OUTPUT
                  AtomChannelOutputSignalLevel = LOW
                  AtomChannelPortPinSelect = TOUT102_SELD_PORT10_PIN0
                AtomChannelTimerParameters:
                  AtomChEnableForceUpdate = 0
                  AtomChResetCn0OnForceUpdate = 0
                  AtomChShadowCompareValSr0 = 0
                  AtomChShadowCompareValSr1 = 0
                  AtomChSomcCompareStrategy = TIMEBASE_GREATER_EQUAL_TO_CMx
                  AtomChSomcTimebaseForComparison = TBU_TS1
                  AtomChUpdateEnableOnCn0Reset = 0
                  AtomChannelClockSelect = GTM_CONFIGURABLE_CLOCK_0
                  AtomChannelCompareValueCm0 = 0
                  AtomChannelCompareValueCm1 = 0
                  AtomChannelCounterCn0Reset = ON_COMPARE_MATCH_ON_CHANNEL
                  AtomChannelCounterValCn0 = 0
                  AtomChannelModeSelect = ATOM_SIG_OUTPUT_MODE_IMMEDIATE
                  AtomChannelOneShotMode = 0
                  AtomChannelTriggerOutput = TRIG_FROM_PREVIOUS_CHANNEL
                  AtomModeControlBits = 0
                  AtomServeLastAruCommStrategy = 0
                AtomChannelUsage: AtomChannelUsage=USED_BY_OTHER_DRIVERS_OR_UNUSED
              AtomChannel_5
                AtomChannelAruConfiguration: AtomChAruBlockingMode=GTM_ABM_DISABLED, AtomChAruReadAddress0=510, AtomChAruReadAddress1=510, AtomChannelAruEnable=0, AtomChannelCpuWriteRequest=0
                AtomChannelEnable: AtomChDisableOnAgcTrigger=0, AtomChannelEnable=AT_START
                AtomChannelInterrupt:
                  AtomCcu0Notification = NULL_PTR
                  AtomCcu1Notification = NULL_PTR
                  AtomGlobalCcuSel = 0
                  AtomIntEnableOnCcu0Trigger = 0
                  AtomIntEnableOnCcu1Trigger = 0
                  AtomInterruptMode = GTM_INTERRUPT_LEVEL_MODE
                  AtomNotification = NULL_PTR
                AtomChannelOutput:
                  AtomChOutputDisableOnAgcTrig = 0
                  AtomChannelOutputControl = DONT_ENABLE_CHANNEL_OUTPUT
                  AtomChannelOutputSignalLevel = LOW
                  AtomChannelPortPinSelect = TOUT110_SELD_PORT10_PIN8
                AtomChannelTimerParameters:
                  AtomChEnableForceUpdate = 0
                  AtomChResetCn0OnForceUpdate = 0
                  AtomChShadowCompareValSr0 = 0
                  AtomChShadowCompareValSr1 = 0
                  AtomChSomcCompareStrategy = TIMEBASE_GREATER_EQUAL_TO_CMx
                  AtomChSomcTimebaseForComparison = TBU_TS1
                  AtomChUpdateEnableOnCn0Reset = 0
                  AtomChannelClockSelect = GTM_CONFIGURABLE_CLOCK_0
                  AtomChannelCompareValueCm0 = 0
                  AtomChannelCompareValueCm1 = 0
                  AtomChannelCounterCn0Reset = ON_COMPARE_MATCH_ON_CHANNEL
                  AtomChannelCounterValCn0 = 0
                  AtomChannelModeSelect = ATOM_SIG_OUTPUT_MODE_IMMEDIATE
                  AtomChannelOneShotMode = 0
                  AtomChannelTriggerOutput = TRIG_FROM_PREVIOUS_CHANNEL
                  AtomModeControlBits = 0
                  AtomServeLastAruCommStrategy = 0
                AtomChannelUsage: AtomChannelUsage=USED_BY_OTHER_DRIVERS_OR_UNUSED
              AtomChannel_6
                AtomChannelAruConfiguration: AtomChAruBlockingMode=GTM_ABM_DISABLED, AtomChAruReadAddress0=510, AtomChAruReadAddress1=510, AtomChannelAruEnable=0, AtomChannelCpuWriteRequest=0
                AtomChannelEnable: AtomChDisableOnAgcTrigger=0, AtomChannelEnable=AT_START
                AtomChannelInterrupt:
                  AtomCcu0Notification = NULL_PTR
                  AtomCcu1Notification = NULL_PTR
                  AtomGlobalCcuSel = 0
                  AtomIntEnableOnCcu0Trigger = 0
                  AtomIntEnableOnCcu1Trigger = 0
                  AtomInterruptMode = GTM_INTERRUPT_LEVEL_MODE
                  AtomNotification = NULL_PTR
                AtomChannelOutput:
                  AtomChOutputDisableOnAgcTrig = 0
                  AtomChannelOutputControl = DONT_ENABLE_CHANNEL_OUTPUT
                  AtomChannelOutputSignalLevel = LOW
                  AtomChannelPortPinSelect = TOUT106_SELD_PORT10_PIN4
                AtomChannelTimerParameters:
                  AtomChEnableForceUpdate = 0
                  AtomChResetCn0OnForceUpdate = 0
                  AtomChShadowCompareValSr0 = 0
                  AtomChShadowCompareValSr1 = 0
                  AtomChSomcCompareStrategy = TIMEBASE_GREATER_EQUAL_TO_CMx
                  AtomChSomcTimebaseForComparison = TBU_TS1
                  AtomChUpdateEnableOnCn0Reset = 0
                  AtomChannelClockSelect = GTM_CONFIGURABLE_CLOCK_0
                  AtomChannelCompareValueCm0 = 0
                  AtomChannelCompareValueCm1 = 0
                  AtomChannelCounterCn0Reset = ON_COMPARE_MATCH_ON_CHANNEL
                  AtomChannelCounterValCn0 = 0
                  AtomChannelModeSelect = ATOM_SIG_OUTPUT_MODE_IMMEDIATE
                  AtomChannelOneShotMode = 0
                  AtomChannelTriggerOutput = TRIG_FROM_PREVIOUS_CHANNEL
                  AtomModeControlBits = 0
                  AtomServeLastAruCommStrategy = 0
                AtomChannelUsage: AtomChannelUsage=USED_BY_OTHER_DRIVERS_OR_UNUSED
              AtomChannel_7
                AtomChannelAruConfiguration: AtomChAruBlockingMode=GTM_ABM_DISABLED, AtomChAruReadAddress0=510, AtomChAruReadAddress1=510, AtomChannelAruEnable=0, AtomChannelCpuWriteRequest=0
                AtomChannelEnable: AtomChDisableOnAgcTrigger=0, AtomChannelEnable=AT_START
                AtomChannelInterrupt:
                  AtomCcu0Notification = NULL_PTR
                  AtomCcu1Notification = NULL_PTR
                  AtomGlobalCcuSel = 0
                  AtomIntEnableOnCcu0Trigger = 0
                  AtomIntEnableOnCcu1Trigger = 0
                  AtomInterruptMode = GTM_INTERRUPT_LEVEL_MODE
                  AtomNotification = NULL_PTR
                AtomChannelOutput:
                  AtomChOutputDisableOnAgcTrig = 0
                  AtomChannelOutputControl = DONT_ENABLE_CHANNEL_OUTPUT
                  AtomChannelOutputSignalLevel = LOW
                  AtomChannelPortPinSelect = TOUT75_SELD_PORT15_PIN4
                AtomChannelTimerParameters:
                  AtomChEnableForceUpdate = 0
                  AtomChResetCn0OnForceUpdate = 0
                  AtomChShadowCompareValSr0 = 0
                  AtomChShadowCompareValSr1 = 0
                  AtomChSomcCompareStrategy = TIMEBASE_GREATER_EQUAL_TO_CMx
                  AtomChSomcTimebaseForComparison = TBU_TS1
                  AtomChUpdateEnableOnCn0Reset = 0
                  AtomChannelClockSelect = GTM_CONFIGURABLE_CLOCK_0
                  AtomChannelCompareValueCm0 = 0
                  AtomChannelCompareValueCm1 = 0
                  AtomChannelCounterCn0Reset = ON_COMPARE_MATCH_ON_CHANNEL
                  AtomChannelCounterValCn0 = 0
                  AtomChannelModeSelect = ATOM_SIG_OUTPUT_MODE_IMMEDIATE
                  AtomChannelOneShotMode = 0
                  AtomChannelTriggerOutput = TRIG_FROM_PREVIOUS_CHANNEL
                  AtomModeControlBits = 0
                  AtomServeLastAruCommStrategy = 0
                AtomChannelUsage: AtomChannelUsage=USED_BY_OTHER_DRIVERS_OR_UNUSED
            AtomTriggerForAgc
              AtomAgcInternalTriggerSelect:
                AtomAgcIntTriggerFromChannel{0..7} = 0
              AtomAgcTriggerByTimebase: AtomAgcTbuTimebaseSelect=TBU_TS0_TIMEBASE, AtomAgcTimeBaseTriggerEnable=0, AtomAgcTimebaseMatchValue=0
        GtmAeiInterface:
          GtmAeiIllegalModuleAddErrIntEn = 0
          GtmAeiIllegalModuleAddIntEn = 0
          GtmAeiInterruptMode = GTM_INTERRUPT_LEVEL_MODE
          GtmAeiTimeOutMode = OBSERVE
          GtmAeiTimeOutValue = 0
          GtmAeiTimeoutExceptionErrIntEn = 0
          GtmAeiTimeoutExceptionIntEn = 0
          GtmAeiUnsupportedAddressErrIntEn = 0
          GtmAeiUnsupportedAddressIntEn = 0
          GtmAeiUnsupportedByteEnErrIntEn = 0
          GtmAeiUnsupportedByteEnIntEn = 0
        GtmGeneral: GtmEnRstAndForceIntFunctionality=0, GtmGlobalClkDivDenominator=1, GtmGlobalClkDivNumerator=1, GtmSleepMode=GTM_SLEEP_ENABLE
        4 x Mcs:
          Mcs_0
            8 x McsChannel, all with McsChMemoryErrorInterruptEnable=0, McsChMemoryErrorInterruptEnableErr=0, McsChStackErrorInterruptEnable=0, McsChStackErrorInterruptEnableErr=0, McsChannelEnable=0, McsChannelInterruptEnable=0, McsChannelInterruptEnableErr=0, McsChannelInterruptMode=GTM_INTERRUPT_LEVEL_MODE:
              McsChannel_{0..7}
            McsGeneral: McsHaltOnStackPointerOverflow=0, McsSchedulingScheme=ACCELERATED_SCHEDULING_SCHEME, McsUsage=UNUSED
          Mcs_1
            8 x McsChannel, all with McsChMemoryErrorInterruptEnable=0, McsChMemoryErrorInterruptEnableErr=0, McsChStackErrorInterruptEnable=0, McsChStackErrorInterruptEnableErr=0, McsChannelEnable=0, McsChannelInterruptEnable=0, McsChannelInterruptEnableErr=0, McsChannelInterruptMode=GTM_INTERRUPT_LEVEL_MODE:
              McsChannel_{0..7}
            McsGeneral: McsHaltOnStackPointerOverflow=0, McsSchedulingScheme=ACCELERATED_SCHEDULING_SCHEME, McsUsage=UNUSED
          Mcs_2
            8 x McsChannel, all with McsChMemoryErrorInterruptEnable=0, McsChMemoryErrorInterruptEnableErr=0, McsChStackErrorInterruptEnable=0, McsChStackErrorInterruptEnableErr=0, McsChannelEnable=0, McsChannelInterruptEnable=0, McsChannelInterruptEnableErr=0, McsChannelInterruptMode=GTM_INTERRUPT_LEVEL_MODE:
              McsChannel_{0..7}
            McsGeneral: McsHaltOnStackPointerOverflow=0, McsSchedulingScheme=ACCELERATED_SCHEDULING_SCHEME, McsUsage=UNUSED
          Mcs_3
            8 x McsChannel, all with McsChMemoryErrorInterruptEnable=0, McsChMemoryErrorInterruptEnableErr=0, McsChStackErrorInterruptEnable=0, McsChStackErrorInterruptEnableErr=0, McsChannelEnable=0, McsChannelInterruptEnable=0, McsChannelInterruptEnableErr=0, McsChannelInterruptMode=GTM_INTERRUPT_LEVEL_MODE:
              McsChannel_{0..7}
            McsGeneral: McsHaltOnStackPointerOverflow=0, McsSchedulingScheme=ACCELERATED_SCHEDULING_SCHEME, McsUsage=UNUSED
        Spe_0 (Spe)
          SpeErrorInterrupt:
            SpeEnableIntOnBouncingInputErr = 0
            SpeEnableIntOnNewPatternDetectErr = 0
            SpeEnableIntOnRegCompErr = 0
            SpeEnableIntOnSpeDirBitChangeErr = 0
            SpeEnableIntOnWrongPatternErr = 0
          SpeGeneral:
            SpeEnableFastShutOff = 0
            SpeEnableInput{0..2} = 0
            SpeEnableModule = 0
            SpeInputSigRevCntr = 60
            SpeInputSigRevCntrCmpVal = 60
            SpeTimChannelsSelect = SEL0_TIM0_CH0_TO_2
            SpeTriggerInputSelect = SPE_NIPD
            SpeUsage = UNUSED
          8 x SpeInputPattern, all with SpeInputPattern=0, SpeIsPatternValid=0:
            SpeInputPattern_{0..7}
          SpeInterrupt:
            SpeEnableIntOnBouncingInput = 0
            SpeEnableIntOnNewPatternDetect = 0
            SpeEnableIntOnRegComp = 0
            SpeEnableIntOnSpeDirBitChange = 0
            SpeEnableIntOnWrongPattern = 0
            SpeInterruptMode = GTM_INTERRUPT_LEVEL_MODE
          8 x SpeOutputConfig, all with SpeFastShutoffLevel=LOW_LEVEL, SpeOutputSelect=TOM_CH0_SOUR:
            SpeOutputConfig_{0..7}
        Spe_1 (Spe)
          SpeErrorInterrupt:
            SpeEnableIntOnBouncingInputErr = 0
            SpeEnableIntOnNewPatternDetectErr = 0
            SpeEnableIntOnRegCompErr = 0
            SpeEnableIntOnSpeDirBitChangeErr = 0
            SpeEnableIntOnWrongPatternErr = 0
          SpeGeneral:
            SpeEnableFastShutOff = 0
            SpeEnableInput{0..2} = 0
            SpeEnableModule = 0
            SpeInputSigRevCntr = 60
            SpeInputSigRevCntrCmpVal = 60
            SpeTimChannelsSelect = SEL0_TIM0_CH3_TO_5
            SpeTriggerInputSelect = SPE_NIPD
            SpeUsage = UNUSED
          8 x SpeInputPattern, all with SpeInputPattern=0, SpeIsPatternValid=0:
            SpeInputPattern_{0..7}
          SpeInterrupt:
            SpeEnableIntOnBouncingInput = 0
            SpeEnableIntOnNewPatternDetect = 0
            SpeEnableIntOnRegComp = 0
            SpeEnableIntOnSpeDirBitChange = 0
            SpeEnableIntOnWrongPattern = 0
            SpeInterruptMode = GTM_INTERRUPT_LEVEL_MODE
          8 x SpeOutputConfig, all with SpeFastShutoffLevel=LOW_LEVEL, SpeOutputSelect=TOM_CH0_SOUR:
            SpeOutputConfig_{0..7}
        4 x Tim:
          Tim_0
            8 x TimChannel:
              TimChannel_0
                TimChannelErrorInterrupt:
                  TimInterruptEnableOnCntOflErr = 0
                  TimInterruptEnableOnEcntOflErr = 0
                  TimInterruptEnableOnGlitchDetErr = 0
                  TimInterruptEnableOnGprxOflErr = 0
                  TimInterruptEnableOnNewValErr = 0
                  TimInterruptEnableOnToDetErr = 0
                TimChannelFilterConfig:
                  TimChFilterCounterFreqSelect = GTM_CONFIGURABLE_CLOCK_0
                  TimChFilterModeForFallingEdge = IMMEDIATE_EDGE_PROPAGATION_MODE
                  TimChFilterModeForRisingEdge = IMMEDIATE_EDGE_PROPAGATION_MODE
                  TimChFilterTimeForFallingEdge = 0
                  TimChFilterTimeForRisingEdge = 0
                  TimChannelFilterEnable = 0
                TimChannelGeneral:
                  TimChannelAruEnable = 0
                  TimChannelClockSelect = GTM_CONFIGURABLE_CLOCK_0
                  TimChannelCntsInputSelect = CNT_VALUE
                  TimChannelCntsValue = 0
                  TimChannelEcntOvflwSetting = SEL0_OVRFLOW_SIG_ON_ECNT_BITWIDTH_8
                  TimChannelEcntResetSetting = SEL0_ECNT_IN_WRAP_AROUND_MODE
                  TimChannelEnable = 0
                  TimChannelExtCaptureModeEnable = 0
                  TimChannelExtCaptureSrc = SEL0_NEW_VAL_IRQ
                  TimChannelGpr0InputSelect = TIMEBASE_TBU_TS0
                  TimChannelGpr1InputSelect = TIMEBASE_TBU_TS0
                  TimChannelInputSelect = INPUT_OF_CURRENT_TIM_CHANNEL
                  TimChannelModeSelect = PWM_MEASUREMENT_MODE_TPWM
                  TimChannelOneShotMode = 0
                  TimChannelPortPinSelect = NONE_SEL0
                  TimChannelSignalEdgeSelect = FALLING_EDGE
                  TimChannelTbu0Ts0BitsSelect = BITS_0_TO_23
                  TimChannelUsage = USED_BY_OTHER_DRIVERS_OR_UNUSED
                  TimChannelValInitSignal = VAL_LOW
                TimChannelInterrupt:
                  TimInterruptEnableOnCntOfl = 0
                  TimInterruptEnableOnEcntOfl = 0
                  TimInterruptEnableOnGlitchDet = 0
                  TimInterruptEnableOnGprxOfl = 0
                  TimInterruptEnableOnNewVal = 0
                  TimInterruptEnableOnToDet = 0
                  TimInterruptMode = GTM_INTERRUPT_LEVEL_MODE
                  TimNotification = NULL_PTR
                TimChannelTimeoutDetection: TimChTimeoutClockSelect=GTM_CONFIGURABLE_CLOCK_0, TimChTimeoutDetectionEnable=SEL0_TIMOUT_DISABLED, TimChTimeoutDuration=0
              TimChannel_1
                TimChannelErrorInterrupt:
                  TimInterruptEnableOnCntOflErr = 0
                  TimInterruptEnableOnEcntOflErr = 0
                  TimInterruptEnableOnGlitchDetErr = 0
                  TimInterruptEnableOnGprxOflErr = 0
                  TimInterruptEnableOnNewValErr = 0
                  TimInterruptEnableOnToDetErr = 0
                TimChannelFilterConfig:
                  TimChFilterCounterFreqSelect = GTM_CONFIGURABLE_CLOCK_0
                  TimChFilterModeForFallingEdge = IMMEDIATE_EDGE_PROPAGATION_MODE
                  TimChFilterModeForRisingEdge = IMMEDIATE_EDGE_PROPAGATION_MODE
                  TimChFilterTimeForFallingEdge = 0
                  TimChFilterTimeForRisingEdge = 0
                  TimChannelFilterEnable = 0
                TimChannelGeneral:
                  TimChannelAruEnable = 0
                  TimChannelClockSelect = GTM_CONFIGURABLE_CLOCK_0
                  TimChannelCntsInputSelect = CNT_VALUE
                  TimChannelCntsValue = 0
                  TimChannelEcntOvflwSetting = SEL0_OVRFLOW_SIG_ON_ECNT_BITWIDTH_8
                  TimChannelEcntResetSetting = SEL0_ECNT_IN_WRAP_AROUND_MODE
                  TimChannelEnable = 0
                  TimChannelExtCaptureModeEnable = 0
                  TimChannelExtCaptureSrc = SEL0_NEW_VAL_IRQ
                  TimChannelGpr0InputSelect = TIMEBASE_TBU_TS0
                  TimChannelGpr1InputSelect = TIMEBASE_TBU_TS0
                  TimChannelInputSelect = INPUT_OF_CURRENT_TIM_CHANNEL
                  TimChannelModeSelect = PWM_MEASUREMENT_MODE_TPWM
                  TimChannelOneShotMode = 0
                  TimChannelPortPinSelect = NONE_SEL0
                  TimChannelSignalEdgeSelect = FALLING_EDGE
                  TimChannelTbu0Ts0BitsSelect = BITS_0_TO_23
                  TimChannelUsage = USED_BY_OTHER_DRIVERS_OR_UNUSED
                  TimChannelValInitSignal = VAL_LOW
                TimChannelInterrupt:
                  TimInterruptEnableOnCntOfl = 0
                  TimInterruptEnableOnEcntOfl = 0
                  TimInterruptEnableOnGlitchDet = 0
                  TimInterruptEnableOnGprxOfl = 0
                  TimInterruptEnableOnNewVal = 0
                  TimInterruptEnableOnToDet = 0
                  TimInterruptMode = GTM_INTERRUPT_LEVEL_MODE
                  TimNotification = NULL_PTR
                TimChannelTimeoutDetection: TimChTimeoutClockSelect=GTM_CONFIGURABLE_CLOCK_0, TimChTimeoutDetectionEnable=SEL0_TIMOUT_DISABLED, TimChTimeoutDuration=0
              TimChannel_2
                TimChannelErrorInterrupt:
                  TimInterruptEnableOnCntOflErr = 0
                  TimInterruptEnableOnEcntOflErr = 0
                  TimInterruptEnableOnGlitchDetErr = 0
                  TimInterruptEnableOnGprxOflErr = 0
                  TimInterruptEnableOnNewValErr = 0
                  TimInterruptEnableOnToDetErr = 0
                TimChannelFilterConfig:
                  TimChFilterCounterFreqSelect = GTM_CONFIGURABLE_CLOCK_0
                  TimChFilterModeForFallingEdge = IMMEDIATE_EDGE_PROPAGATION_MODE
                  TimChFilterModeForRisingEdge = IMMEDIATE_EDGE_PROPAGATION_MODE
                  TimChFilterTimeForFallingEdge = 0
                  TimChFilterTimeForRisingEdge = 0
                  TimChannelFilterEnable = 0
                TimChannelGeneral:
                  TimChannelAruEnable = 0
                  TimChannelClockSelect = GTM_CONFIGURABLE_CLOCK_0
                  TimChannelCntsInputSelect = CNT_VALUE
                  TimChannelCntsValue = 0
                  TimChannelEcntOvflwSetting = SEL0_OVRFLOW_SIG_ON_ECNT_BITWIDTH_8
                  TimChannelEcntResetSetting = SEL0_ECNT_IN_WRAP_AROUND_MODE
                  TimChannelEnable = 0
                  TimChannelExtCaptureModeEnable = 0
                  TimChannelExtCaptureSrc = SEL0_NEW_VAL_IRQ
                  TimChannelGpr0InputSelect = TIMEBASE_TBU_TS0
                  TimChannelGpr1InputSelect = TIMEBASE_TBU_TS0
                  TimChannelInputSelect = INPUT_OF_CURRENT_TIM_CHANNEL
                  TimChannelModeSelect = PWM_MEASUREMENT_MODE_TPWM
                  TimChannelOneShotMode = 0
                  TimChannelPortPinSelect = NONE_SEL0
                  TimChannelSignalEdgeSelect = FALLING_EDGE
                  TimChannelTbu0Ts0BitsSelect = BITS_0_TO_23
                  TimChannelUsage = USED_BY_OTHER_DRIVERS_OR_UNUSED
                  TimChannelValInitSignal = VAL_LOW
                TimChannelInterrupt:
                  TimInterruptEnableOnCntOfl = 0
                  TimInterruptEnableOnEcntOfl = 0
                  TimInterruptEnableOnGlitchDet = 0
                  TimInterruptEnableOnGprxOfl = 0
                  TimInterruptEnableOnNewVal = 0
                  TimInterruptEnableOnToDet = 0
                  TimInterruptMode = GTM_INTERRUPT_LEVEL_MODE
                  TimNotification = NULL_PTR
                TimChannelTimeoutDetection: TimChTimeoutClockSelect=GTM_CONFIGURABLE_CLOCK_0, TimChTimeoutDetectionEnable=SEL0_TIMOUT_DISABLED, TimChTimeoutDuration=0
              TimChannel_3
                TimChannelErrorInterrupt:
                  TimInterruptEnableOnCntOflErr = 0
                  TimInterruptEnableOnEcntOflErr = 0
                  TimInterruptEnableOnGlitchDetErr = 0
                  TimInterruptEnableOnGprxOflErr = 0
                  TimInterruptEnableOnNewValErr = 0
                  TimInterruptEnableOnToDetErr = 0
                TimChannelFilterConfig:
                  TimChFilterCounterFreqSelect = GTM_CONFIGURABLE_CLOCK_0
                  TimChFilterModeForFallingEdge = IMMEDIATE_EDGE_PROPAGATION_MODE
                  TimChFilterModeForRisingEdge = IMMEDIATE_EDGE_PROPAGATION_MODE
                  TimChFilterTimeForFallingEdge = 0
                  TimChFilterTimeForRisingEdge = 0
                  TimChannelFilterEnable = 0
                TimChannelGeneral:
                  TimChannelAruEnable = 0
                  TimChannelClockSelect = GTM_CONFIGURABLE_CLOCK_0
                  TimChannelCntsInputSelect = CNT_VALUE
                  TimChannelCntsValue = 0
                  TimChannelEcntOvflwSetting = SEL0_OVRFLOW_SIG_ON_ECNT_BITWIDTH_8
                  TimChannelEcntResetSetting = SEL0_ECNT_IN_WRAP_AROUND_MODE
                  TimChannelEnable = 0
                  TimChannelExtCaptureModeEnable = 0
                  TimChannelExtCaptureSrc = SEL0_NEW_VAL_IRQ
                  TimChannelGpr0InputSelect = TIMEBASE_TBU_TS0
                  TimChannelGpr1InputSelect = TIMEBASE_TBU_TS0
                  TimChannelInputSelect = INPUT_OF_CURRENT_TIM_CHANNEL
                  TimChannelModeSelect = PWM_MEASUREMENT_MODE_TPWM
                  TimChannelOneShotMode = 0
                  TimChannelPortPinSelect = NONE_SEL0
                  TimChannelSignalEdgeSelect = FALLING_EDGE
                  TimChannelTbu0Ts0BitsSelect = BITS_0_TO_23
                  TimChannelUsage = USED_BY_OTHER_DRIVERS_OR_UNUSED
                  TimChannelValInitSignal = VAL_LOW
                TimChannelInterrupt:
                  TimInterruptEnableOnCntOfl = 0
                  TimInterruptEnableOnEcntOfl = 0
                  TimInterruptEnableOnGlitchDet = 0
                  TimInterruptEnableOnGprxOfl = 0
                  TimInterruptEnableOnNewVal = 0
                  TimInterruptEnableOnToDet = 0
                  TimInterruptMode = GTM_INTERRUPT_LEVEL_MODE
                  TimNotification = NULL_PTR
                TimChannelTimeoutDetection: TimChTimeoutClockSelect=GTM_CONFIGURABLE_CLOCK_0, TimChTimeoutDetectionEnable=SEL0_TIMOUT_DISABLED, TimChTimeoutDuration=0
              TimChannel_4
                TimChannelErrorInterrupt:
                  TimInterruptEnableOnCntOflErr = 0
                  TimInterruptEnableOnEcntOflErr = 0
                  TimInterruptEnableOnGlitchDetErr = 0
                  TimInterruptEnableOnGprxOflErr = 0
                  TimInterruptEnableOnNewValErr = 0
                  TimInterruptEnableOnToDetErr = 0
                TimChannelFilterConfig:
                  TimChFilterCounterFreqSelect = GTM_CONFIGURABLE_CLOCK_0
                  TimChFilterModeForFallingEdge = IMMEDIATE_EDGE_PROPAGATION_MODE
                  TimChFilterModeForRisingEdge = IMMEDIATE_EDGE_PROPAGATION_MODE
                  TimChFilterTimeForFallingEdge = 0
                  TimChFilterTimeForRisingEdge = 0
                  TimChannelFilterEnable = 0
                TimChannelGeneral:
                  TimChannelAruEnable = 0
                  TimChannelClockSelect = GTM_CONFIGURABLE_CLOCK_0
                  TimChannelCntsInputSelect = CNT_VALUE
                  TimChannelCntsValue = 0
                  TimChannelEcntOvflwSetting = SEL0_OVRFLOW_SIG_ON_ECNT_BITWIDTH_8
                  TimChannelEcntResetSetting = SEL0_ECNT_IN_WRAP_AROUND_MODE
                  TimChannelEnable = 0
                  TimChannelExtCaptureModeEnable = 0
                  TimChannelExtCaptureSrc = SEL0_NEW_VAL_IRQ
                  TimChannelGpr0InputSelect = TIMEBASE_TBU_TS0
                  TimChannelGpr1InputSelect = TIMEBASE_TBU_TS0
                  TimChannelInputSelect = INPUT_OF_CURRENT_TIM_CHANNEL
                  TimChannelModeSelect = PWM_MEASUREMENT_MODE_TPWM
                  TimChannelOneShotMode = 0
                  TimChannelPortPinSelect = NONE_SEL0
                  TimChannelSignalEdgeSelect = FALLING_EDGE
                  TimChannelTbu0Ts0BitsSelect = BITS_0_TO_23
                  TimChannelUsage = USED_BY_OTHER_DRIVERS_OR_UNUSED
                  TimChannelValInitSignal = VAL_LOW
                TimChannelInterrupt:
                  TimInterruptEnableOnCntOfl = 0
                  TimInterruptEnableOnEcntOfl = 0
                  TimInterruptEnableOnGlitchDet = 0
                  TimInterruptEnableOnGprxOfl = 0
                  TimInterruptEnableOnNewVal = 0
                  TimInterruptEnableOnToDet = 0
                  TimInterruptMode = GTM_INTERRUPT_LEVEL_MODE
                  TimNotification = NULL_PTR
                TimChannelTimeoutDetection: TimChTimeoutClockSelect=GTM_CONFIGURABLE_CLOCK_0, TimChTimeoutDetectionEnable=SEL0_TIMOUT_DISABLED, TimChTimeoutDuration=0
              TimChannel_5
                TimChannelErrorInterrupt:
                  TimInterruptEnableOnCntOflErr = 0
                  TimInterruptEnableOnEcntOflErr = 0
                  TimInterruptEnableOnGlitchDetErr = 0
                  TimInterruptEnableOnGprxOflErr = 0
                  TimInterruptEnableOnNewValErr = 0
                  TimInterruptEnableOnToDetErr = 0
                TimChannelFilterConfig:
                  TimChFilterCounterFreqSelect = GTM_CONFIGURABLE_CLOCK_0
                  TimChFilterModeForFallingEdge = IMMEDIATE_EDGE_PROPAGATION_MODE
                  TimChFilterModeForRisingEdge = IMMEDIATE_EDGE_PROPAGATION_MODE
                  TimChFilterTimeForFallingEdge = 0
                  TimChFilterTimeForRisingEdge = 0
                  TimChannelFilterEnable = 0
                TimChannelGeneral:
                  TimChannelAruEnable = 0
                  TimChannelClockSelect = GTM_CONFIGURABLE_CLOCK_0
                  TimChannelCntsInputSelect = CNT_VALUE
                  TimChannelCntsValue = 0
                  TimChannelEcntOvflwSetting = SEL0_OVRFLOW_SIG_ON_ECNT_BITWIDTH_8
                  TimChannelEcntResetSetting = SEL0_ECNT_IN_WRAP_AROUND_MODE
                  TimChannelEnable = 0
                  TimChannelExtCaptureModeEnable = 0
                  TimChannelExtCaptureSrc = SEL0_NEW_VAL_IRQ
                  TimChannelGpr0InputSelect = TIMEBASE_TBU_TS0
                  TimChannelGpr1InputSelect = TIMEBASE_TBU_TS0
                  TimChannelInputSelect = INPUT_OF_CURRENT_TIM_CHANNEL
                  TimChannelModeSelect = PWM_MEASUREMENT_MODE_TPWM
                  TimChannelOneShotMode = 0
                  TimChannelPortPinSelect = NONE_SEL0
                  TimChannelSignalEdgeSelect = FALLING_EDGE
                  TimChannelTbu0Ts0BitsSelect = BITS_0_TO_23
                  TimChannelUsage = USED_BY_OTHER_DRIVERS_OR_UNUSED
                  TimChannelValInitSignal = VAL_LOW
                TimChannelInterrupt:
                  TimInterruptEnableOnCntOfl = 0
                  TimInterruptEnableOnEcntOfl = 0
                  TimInterruptEnableOnGlitchDet = 0
                  TimInterruptEnableOnGprxOfl = 0
                  TimInterruptEnableOnNewVal = 0
                  TimInterruptEnableOnToDet = 0
                  TimInterruptMode = GTM_INTERRUPT_LEVEL_MODE
                  TimNotification = NULL_PTR
                TimChannelTimeoutDetection: TimChTimeoutClockSelect=GTM_CONFIGURABLE_CLOCK_0, TimChTimeoutDetectionEnable=SEL0_TIMOUT_DISABLED, TimChTimeoutDuration=0
              TimChannel_6
                TimChannelErrorInterrupt:
                  TimInterruptEnableOnCntOflErr = 0
                  TimInterruptEnableOnEcntOflErr = 0
                  TimInterruptEnableOnGlitchDetErr = 0
                  TimInterruptEnableOnGprxOflErr = 0
                  TimInterruptEnableOnNewValErr = 0
                  TimInterruptEnableOnToDetErr = 0
                TimChannelFilterConfig:
                  TimChFilterCounterFreqSelect = GTM_CONFIGURABLE_CLOCK_0
                  TimChFilterModeForFallingEdge = IMMEDIATE_EDGE_PROPAGATION_MODE
                  TimChFilterModeForRisingEdge = IMMEDIATE_EDGE_PROPAGATION_MODE
                  TimChFilterTimeForFallingEdge = 0
                  TimChFilterTimeForRisingEdge = 0
                  TimChannelFilterEnable = 0
                TimChannelGeneral:
                  TimChannelAruEnable = 0
                  TimChannelClockSelect = GTM_CONFIGURABLE_CLOCK_0
                  TimChannelCntsInputSelect = CNT_VALUE
                  TimChannelCntsValue = 0
                  TimChannelEcntOvflwSetting = SEL0_OVRFLOW_SIG_ON_ECNT_BITWIDTH_8
                  TimChannelEcntResetSetting = SEL0_ECNT_IN_WRAP_AROUND_MODE
                  TimChannelEnable = 0
                  TimChannelExtCaptureModeEnable = 0
                  TimChannelExtCaptureSrc = SEL0_NEW_VAL_IRQ
                  TimChannelGpr0InputSelect = TIMEBASE_TBU_TS0
                  TimChannelGpr1InputSelect = TIMEBASE_TBU_TS0
                  TimChannelInputSelect = INPUT_OF_CURRENT_TIM_CHANNEL
                  TimChannelModeSelect = PWM_MEASUREMENT_MODE_TPWM
                  TimChannelOneShotMode = 0
                  TimChannelPortPinSelect = NONE_SEL0
                  TimChannelSignalEdgeSelect = FALLING_EDGE
                  TimChannelTbu0Ts0BitsSelect = BITS_0_TO_23
                  TimChannelUsage = USED_BY_OTHER_DRIVERS_OR_UNUSED
                  TimChannelValInitSignal = VAL_LOW
                TimChannelInterrupt:
                  TimInterruptEnableOnCntOfl = 0
                  TimInterruptEnableOnEcntOfl = 0
                  TimInterruptEnableOnGlitchDet = 0
                  TimInterruptEnableOnGprxOfl = 0
                  TimInterruptEnableOnNewVal = 0
                  TimInterruptEnableOnToDet = 0
                  TimInterruptMode = GTM_INTERRUPT_LEVEL_MODE
                  TimNotification = NULL_PTR
                TimChannelTimeoutDetection: TimChTimeoutClockSelect=GTM_CONFIGURABLE_CLOCK_0, TimChTimeoutDetectionEnable=SEL0_TIMOUT_DISABLED, TimChTimeoutDuration=0
              TimChannel_7
                TimChannelErrorInterrupt:
                  TimInterruptEnableOnCntOflErr = 0
                  TimInterruptEnableOnEcntOflErr = 0
                  TimInterruptEnableOnGlitchDetErr = 0
                  TimInterruptEnableOnGprxOflErr = 0
                  TimInterruptEnableOnNewValErr = 0
                  TimInterruptEnableOnToDetErr = 0
                TimChannelFilterConfig:
                  TimChFilterCounterFreqSelect = GTM_CONFIGURABLE_CLOCK_0
                  TimChFilterModeForFallingEdge = IMMEDIATE_EDGE_PROPAGATION_MODE
                  TimChFilterModeForRisingEdge = IMMEDIATE_EDGE_PROPAGATION_MODE
                  TimChFilterTimeForFallingEdge = 0
                  TimChFilterTimeForRisingEdge = 0
                  TimChannelFilterEnable = 0
                TimChannelGeneral:
                  TimChannelAruEnable = 0
                  TimChannelClockSelect = GTM_CONFIGURABLE_CLOCK_0
                  TimChannelCntsInputSelect = CNT_VALUE
                  TimChannelCntsValue = 0
                  TimChannelEcntOvflwSetting = SEL0_OVRFLOW_SIG_ON_ECNT_BITWIDTH_8
                  TimChannelEcntResetSetting = SEL0_ECNT_IN_WRAP_AROUND_MODE
                  TimChannelEnable = 0
                  TimChannelExtCaptureModeEnable = 0
                  TimChannelExtCaptureSrc = SEL0_NEW_VAL_IRQ
                  TimChannelGpr0InputSelect = TIMEBASE_TBU_TS0
                  TimChannelGpr1InputSelect = TIMEBASE_TBU_TS0
                  TimChannelInputSelect = INPUT_OF_CURRENT_TIM_CHANNEL
                  TimChannelModeSelect = PWM_MEASUREMENT_MODE_TPWM
                  TimChannelOneShotMode = 0
                  TimChannelPortPinSelect = NONE_SEL0
                  TimChannelSignalEdgeSelect = FALLING_EDGE
                  TimChannelTbu0Ts0BitsSelect = BITS_0_TO_23
                  TimChannelUsage = USED_BY_OTHER_DRIVERS_OR_UNUSED
                  TimChannelValInitSignal = VAL_LOW
                TimChannelInterrupt:
                  TimInterruptEnableOnCntOfl = 0
                  TimInterruptEnableOnEcntOfl = 0
                  TimInterruptEnableOnGlitchDet = 0
                  TimInterruptEnableOnGprxOfl = 0
                  TimInterruptEnableOnNewVal = 0
                  TimInterruptEnableOnToDet = 0
                  TimInterruptMode = GTM_INTERRUPT_LEVEL_MODE
                  TimNotification = NULL_PTR
                TimChannelTimeoutDetection: TimChTimeoutClockSelect=GTM_CONFIGURABLE_CLOCK_0, TimChTimeoutDetectionEnable=SEL0_TIMOUT_DISABLED, TimChTimeoutDuration=0
          Tim_1
            8 x TimChannel:
              TimChannel_0
                TimChannelErrorInterrupt:
                  TimInterruptEnableOnCntOflErr = 0
                  TimInterruptEnableOnEcntOflErr = 0
                  TimInterruptEnableOnGlitchDetErr = 0
                  TimInterruptEnableOnGprxOflErr = 0
                  TimInterruptEnableOnNewValErr = 0
                  TimInterruptEnableOnToDetErr = 0
                TimChannelFilterConfig:
                  TimChFilterCounterFreqSelect = GTM_CONFIGURABLE_CLOCK_0
                  TimChFilterModeForFallingEdge = IMMEDIATE_EDGE_PROPAGATION_MODE
                  TimChFilterModeForRisingEdge = IMMEDIATE_EDGE_PROPAGATION_MODE
                  TimChFilterTimeForFallingEdge = 0
                  TimChFilterTimeForRisingEdge = 0
                  TimChannelFilterEnable = 0
                TimChannelGeneral:
                  TimChannelAruEnable = 0
                  TimChannelClockSelect = GTM_CONFIGURABLE_CLOCK_0
                  TimChannelCntsInputSelect = CNT_VALUE
                  TimChannelCntsValue = 0
                  TimChannelEcntOvflwSetting = SEL0_OVRFLOW_SIG_ON_ECNT_BITWIDTH_8
                  TimChannelEcntResetSetting = SEL0_ECNT_IN_WRAP_AROUND_MODE
                  TimChannelEnable = 0
                  TimChannelExtCaptureModeEnable = 0
                  TimChannelExtCaptureSrc = SEL0_NEW_VAL_IRQ
                  TimChannelGpr0InputSelect = TIMEBASE_TBU_TS0
                  TimChannelGpr1InputSelect = TIMEBASE_TBU_TS0
                  TimChannelInputSelect = INPUT_OF_CURRENT_TIM_CHANNEL
                  TimChannelModeSelect = PWM_MEASUREMENT_MODE_TPWM
                  TimChannelOneShotMode = 0
                  TimChannelPortPinSelect = NONE_SEL0
                  TimChannelSignalEdgeSelect = FALLING_EDGE
                  TimChannelTbu0Ts0BitsSelect = BITS_0_TO_23
                  TimChannelUsage = USED_BY_OTHER_DRIVERS_OR_UNUSED
                  TimChannelValInitSignal = VAL_LOW
                TimChannelInterrupt:
                  TimInterruptEnableOnCntOfl = 0
                  TimInterruptEnableOnEcntOfl = 0
                  TimInterruptEnableOnGlitchDet = 0
                  TimInterruptEnableOnGprxOfl = 0
                  TimInterruptEnableOnNewVal = 0
                  TimInterruptEnableOnToDet = 0
                  TimInterruptMode = GTM_INTERRUPT_LEVEL_MODE
                  TimNotification = NULL_PTR
                TimChannelTimeoutDetection: TimChTimeoutClockSelect=GTM_CONFIGURABLE_CLOCK_0, TimChTimeoutDetectionEnable=SEL0_TIMOUT_DISABLED, TimChTimeoutDuration=0
              TimChannel_1
                TimChannelErrorInterrupt:
                  TimInterruptEnableOnCntOflErr = 0
                  TimInterruptEnableOnEcntOflErr = 0
                  TimInterruptEnableOnGlitchDetErr = 0
                  TimInterruptEnableOnGprxOflErr = 0
                  TimInterruptEnableOnNewValErr = 0
                  TimInterruptEnableOnToDetErr = 0
                TimChannelFilterConfig:
                  TimChFilterCounterFreqSelect = GTM_CONFIGURABLE_CLOCK_0
                  TimChFilterModeForFallingEdge = IMMEDIATE_EDGE_PROPAGATION_MODE
                  TimChFilterModeForRisingEdge = IMMEDIATE_EDGE_PROPAGATION_MODE
                  TimChFilterTimeForFallingEdge = 0
                  TimChFilterTimeForRisingEdge = 0
                  TimChannelFilterEnable = 0
                TimChannelGeneral:
                  TimChannelAruEnable = 0
                  TimChannelClockSelect = GTM_CONFIGURABLE_CLOCK_0
                  TimChannelCntsInputSelect = CNT_VALUE
                  TimChannelCntsValue = 0
                  TimChannelEcntOvflwSetting = SEL0_OVRFLOW_SIG_ON_ECNT_BITWIDTH_8
                  TimChannelEcntResetSetting = SEL0_ECNT_IN_WRAP_AROUND_MODE
                  TimChannelEnable = 0
                  TimChannelExtCaptureModeEnable = 0
                  TimChannelExtCaptureSrc = SEL0_NEW_VAL_IRQ
                  TimChannelGpr0InputSelect = TIMEBASE_TBU_TS0
                  TimChannelGpr1InputSelect = TIMEBASE_TBU_TS0
                  TimChannelInputSelect = INPUT_OF_CURRENT_TIM_CHANNEL
                  TimChannelModeSelect = PWM_MEASUREMENT_MODE_TPWM
                  TimChannelOneShotMode = 0
                  TimChannelPortPinSelect = NONE_SEL0
                  TimChannelSignalEdgeSelect = FALLING_EDGE
                  TimChannelTbu0Ts0BitsSelect = BITS_0_TO_23
                  TimChannelUsage = USED_BY_OTHER_DRIVERS_OR_UNUSED
                  TimChannelValInitSignal = VAL_LOW
                TimChannelInterrupt:
                  TimInterruptEnableOnCntOfl = 0
                  TimInterruptEnableOnEcntOfl = 0
                  TimInterruptEnableOnGlitchDet = 0
                  TimInterruptEnableOnGprxOfl = 0
                  TimInterruptEnableOnNewVal = 0
                  TimInterruptEnableOnToDet = 0
                  TimInterruptMode = GTM_INTERRUPT_LEVEL_MODE
                  TimNotification = NULL_PTR
                TimChannelTimeoutDetection: TimChTimeoutClockSelect=GTM_CONFIGURABLE_CLOCK_0, TimChTimeoutDetectionEnable=SEL0_TIMOUT_DISABLED, TimChTimeoutDuration=0
              TimChannel_2
                TimChannelErrorInterrupt:
                  TimInterruptEnableOnCntOflErr = 0
                  TimInterruptEnableOnEcntOflErr = 0
                  TimInterruptEnableOnGlitchDetErr = 0
                  TimInterruptEnableOnGprxOflErr = 0
                  TimInterruptEnableOnNewValErr = 0
                  TimInterruptEnableOnToDetErr = 0
                TimChannelFilterConfig:
                  TimChFilterCounterFreqSelect = GTM_CONFIGURABLE_CLOCK_0
                  TimChFilterModeForFallingEdge = IMMEDIATE_EDGE_PROPAGATION_MODE
                  TimChFilterModeForRisingEdge = IMMEDIATE_EDGE_PROPAGATION_MODE
                  TimChFilterTimeForFallingEdge = 0
                  TimChFilterTimeForRisingEdge = 0
                  TimChannelFilterEnable = 0
                TimChannelGeneral:
                  TimChannelAruEnable = 0
                  TimChannelClockSelect = GTM_CONFIGURABLE_CLOCK_0
                  TimChannelCntsInputSelect = CNT_VALUE
                  TimChannelCntsValue = 0
                  TimChannelEcntOvflwSetting = SEL0_OVRFLOW_SIG_ON_ECNT_BITWIDTH_8
                  TimChannelEcntResetSetting = SEL0_ECNT_IN_WRAP_AROUND_MODE
                  TimChannelEnable = 0
                  TimChannelExtCaptureModeEnable = 0
                  TimChannelExtCaptureSrc = SEL0_NEW_VAL_IRQ
                  TimChannelGpr0InputSelect = TIMEBASE_TBU_TS0
                  TimChannelGpr1InputSelect = TIMEBASE_TBU_TS0
                  TimChannelInputSelect = INPUT_OF_CURRENT_TIM_CHANNEL
                  TimChannelModeSelect = PWM_MEASUREMENT_MODE_TPWM
                  TimChannelOneShotMode = 0
                  TimChannelPortPinSelect = NONE_SEL0
                  TimChannelSignalEdgeSelect = FALLING_EDGE
                  TimChannelTbu0Ts0BitsSelect = BITS_0_TO_23
                  TimChannelUsage = USED_BY_OTHER_DRIVERS_OR_UNUSED
                  TimChannelValInitSignal = VAL_LOW
                TimChannelInterrupt:
                  TimInterruptEnableOnCntOfl = 0
                  TimInterruptEnableOnEcntOfl = 0
                  TimInterruptEnableOnGlitchDet = 0
                  TimInterruptEnableOnGprxOfl = 0
                  TimInterruptEnableOnNewVal = 0
                  TimInterruptEnableOnToDet = 0
                  TimInterruptMode = GTM_INTERRUPT_LEVEL_MODE
                  TimNotification = NULL_PTR
                TimChannelTimeoutDetection: TimChTimeoutClockSelect=GTM_CONFIGURABLE_CLOCK_0, TimChTimeoutDetectionEnable=SEL0_TIMOUT_DISABLED, TimChTimeoutDuration=0
              TimChannel_3
                TimChannelErrorInterrupt:
                  TimInterruptEnableOnCntOflErr = 0
                  TimInterruptEnableOnEcntOflErr = 0
                  TimInterruptEnableOnGlitchDetErr = 0
                  TimInterruptEnableOnGprxOflErr = 0
                  TimInterruptEnableOnNewValErr = 0
                  TimInterruptEnableOnToDetErr = 0
                TimChannelFilterConfig:
                  TimChFilterCounterFreqSelect = GTM_CONFIGURABLE_CLOCK_0
                  TimChFilterModeForFallingEdge = IMMEDIATE_EDGE_PROPAGATION_MODE
                  TimChFilterModeForRisingEdge = IMMEDIATE_EDGE_PROPAGATION_MODE
                  TimChFilterTimeForFallingEdge = 0
                  TimChFilterTimeForRisingEdge = 0
                  TimChannelFilterEnable = 0
                TimChannelGeneral:
                  TimChannelAruEnable = 0
                  TimChannelClockSelect = GTM_CONFIGURABLE_CLOCK_0
                  TimChannelCntsInputSelect = CNT_VALUE
                  TimChannelCntsValue = 0
                  TimChannelEcntOvflwSetting = SEL0_OVRFLOW_SIG_ON_ECNT_BITWIDTH_8
                  TimChannelEcntResetSetting = SEL0_ECNT_IN_WRAP_AROUND_MODE
                  TimChannelEnable = 0
                  TimChannelExtCaptureModeEnable = 0
                  TimChannelExtCaptureSrc = SEL0_NEW_VAL_IRQ
                  TimChannelGpr0InputSelect = TIMEBASE_TBU_TS0
                  TimChannelGpr1InputSelect = TIMEBASE_TBU_TS0
                  TimChannelInputSelect = INPUT_OF_CURRENT_TIM_CHANNEL
                  TimChannelModeSelect = PWM_MEASUREMENT_MODE_TPWM
                  TimChannelOneShotMode = 0
                  TimChannelPortPinSelect = NONE_SEL0
                  TimChannelSignalEdgeSelect = FALLING_EDGE
                  TimChannelTbu0Ts0BitsSelect = BITS_0_TO_23
                  TimChannelUsage = USED_BY_OTHER_DRIVERS_OR_UNUSED
                  TimChannelValInitSignal = VAL_LOW
                TimChannelInterrupt:
                  TimInterruptEnableOnCntOfl = 0
                  TimInterruptEnableOnEcntOfl = 0
                  TimInterruptEnableOnGlitchDet = 0
                  TimInterruptEnableOnGprxOfl = 0
                  TimInterruptEnableOnNewVal = 0
                  TimInterruptEnableOnToDet = 0
                  TimInterruptMode = GTM_INTERRUPT_LEVEL_MODE
                  TimNotification = NULL_PTR
                TimChannelTimeoutDetection: TimChTimeoutClockSelect=GTM_CONFIGURABLE_CLOCK_0, TimChTimeoutDetectionEnable=SEL0_TIMOUT_DISABLED, TimChTimeoutDuration=0
              TimChannel_4
                TimChannelErrorInterrupt:
                  TimInterruptEnableOnCntOflErr = 0
                  TimInterruptEnableOnEcntOflErr = 0
                  TimInterruptEnableOnGlitchDetErr = 0
                  TimInterruptEnableOnGprxOflErr = 0
                  TimInterruptEnableOnNewValErr = 0
                  TimInterruptEnableOnToDetErr = 0
                TimChannelFilterConfig:
                  TimChFilterCounterFreqSelect = GTM_CONFIGURABLE_CLOCK_0
                  TimChFilterModeForFallingEdge = IMMEDIATE_EDGE_PROPAGATION_MODE
                  TimChFilterModeForRisingEdge = IMMEDIATE_EDGE_PROPAGATION_MODE
                  TimChFilterTimeForFallingEdge = 0
                  TimChFilterTimeForRisingEdge = 0
                  TimChannelFilterEnable = 0
                TimChannelGeneral:
                  TimChannelAruEnable = 0
                  TimChannelClockSelect = GTM_CONFIGURABLE_CLOCK_0
                  TimChannelCntsInputSelect = CNT_VALUE
                  TimChannelCntsValue = 0
                  TimChannelEcntOvflwSetting = SEL0_OVRFLOW_SIG_ON_ECNT_BITWIDTH_8
                  TimChannelEcntResetSetting = SEL0_ECNT_IN_WRAP_AROUND_MODE
                  TimChannelEnable = 0
                  TimChannelExtCaptureModeEnable = 0
                  TimChannelExtCaptureSrc = SEL0_NEW_VAL_IRQ
                  TimChannelGpr0InputSelect = TIMEBASE_TBU_TS0
                  TimChannelGpr1InputSelect = TIMEBASE_TBU_TS0
                  TimChannelInputSelect = INPUT_OF_CURRENT_TIM_CHANNEL
                  TimChannelModeSelect = PWM_MEASUREMENT_MODE_TPWM
                  TimChannelOneShotMode = 0
                  TimChannelPortPinSelect = NONE_SEL0
                  TimChannelSignalEdgeSelect = FALLING_EDGE
                  TimChannelTbu0Ts0BitsSelect = BITS_0_TO_23
                  TimChannelUsage = USED_BY_OTHER_DRIVERS_OR_UNUSED
                  TimChannelValInitSignal = VAL_LOW
                TimChannelInterrupt:
                  TimInterruptEnableOnCntOfl = 0
                  TimInterruptEnableOnEcntOfl = 0
                  TimInterruptEnableOnGlitchDet = 0
                  TimInterruptEnableOnGprxOfl = 0
                  TimInterruptEnableOnNewVal = 0
                  TimInterruptEnableOnToDet = 0
                  TimInterruptMode = GTM_INTERRUPT_LEVEL_MODE
                  TimNotification = NULL_PTR
                TimChannelTimeoutDetection: TimChTimeoutClockSelect=GTM_CONFIGURABLE_CLOCK_0, TimChTimeoutDetectionEnable=SEL0_TIMOUT_DISABLED, TimChTimeoutDuration=0
              TimChannel_5
                TimChannelErrorInterrupt:
                  TimInterruptEnableOnCntOflErr = 0
                  TimInterruptEnableOnEcntOflErr = 0
                  TimInterruptEnableOnGlitchDetErr = 0
                  TimInterruptEnableOnGprxOflErr = 0
                  TimInterruptEnableOnNewValErr = 0
                  TimInterruptEnableOnToDetErr = 0
                TimChannelFilterConfig:
                  TimChFilterCounterFreqSelect = GTM_CONFIGURABLE_CLOCK_0
                  TimChFilterModeForFallingEdge = IMMEDIATE_EDGE_PROPAGATION_MODE
                  TimChFilterModeForRisingEdge = IMMEDIATE_EDGE_PROPAGATION_MODE
                  TimChFilterTimeForFallingEdge = 0
                  TimChFilterTimeForRisingEdge = 0
                  TimChannelFilterEnable = 0
                TimChannelGeneral:
                  TimChannelAruEnable = 0
                  TimChannelClockSelect = GTM_CONFIGURABLE_CLOCK_0
                  TimChannelCntsInputSelect = CNT_VALUE
                  TimChannelCntsValue = 0
                  TimChannelEcntOvflwSetting = SEL0_OVRFLOW_SIG_ON_ECNT_BITWIDTH_8
                  TimChannelEcntResetSetting = SEL0_ECNT_IN_WRAP_AROUND_MODE
                  TimChannelEnable = 0
                  TimChannelExtCaptureModeEnable = 0
                  TimChannelExtCaptureSrc = SEL0_NEW_VAL_IRQ
                  TimChannelGpr0InputSelect = TIMEBASE_TBU_TS0
                  TimChannelGpr1InputSelect = TIMEBASE_TBU_TS0
                  TimChannelInputSelect = INPUT_OF_CURRENT_TIM_CHANNEL
                  TimChannelModeSelect = PWM_MEASUREMENT_MODE_TPWM
                  TimChannelOneShotMode = 0
                  TimChannelPortPinSelect = NONE_SEL0
                  TimChannelSignalEdgeSelect = FALLING_EDGE
                  TimChannelTbu0Ts0BitsSelect = BITS_0_TO_23
                  TimChannelUsage = USED_BY_OTHER_DRIVERS_OR_UNUSED
                  TimChannelValInitSignal = VAL_LOW
                TimChannelInterrupt:
                  TimInterruptEnableOnCntOfl = 0
                  TimInterruptEnableOnEcntOfl = 0
                  TimInterruptEnableOnGlitchDet = 0
                  TimInterruptEnableOnGprxOfl = 0
                  TimInterruptEnableOnNewVal = 0
                  TimInterruptEnableOnToDet = 0
                  TimInterruptMode = GTM_INTERRUPT_LEVEL_MODE
                  TimNotification = NULL_PTR
                TimChannelTimeoutDetection: TimChTimeoutClockSelect=GTM_CONFIGURABLE_CLOCK_0, TimChTimeoutDetectionEnable=SEL0_TIMOUT_DISABLED, TimChTimeoutDuration=0
              TimChannel_6
                TimChannelErrorInterrupt:
                  TimInterruptEnableOnCntOflErr = 0
                  TimInterruptEnableOnEcntOflErr = 0
                  TimInterruptEnableOnGlitchDetErr = 0
                  TimInterruptEnableOnGprxOflErr = 0
                  TimInterruptEnableOnNewValErr = 0
                  TimInterruptEnableOnToDetErr = 0
                TimChannelFilterConfig:
                  TimChFilterCounterFreqSelect = GTM_CONFIGURABLE_CLOCK_0
                  TimChFilterModeForFallingEdge = IMMEDIATE_EDGE_PROPAGATION_MODE
                  TimChFilterModeForRisingEdge = IMMEDIATE_EDGE_PROPAGATION_MODE
                  TimChFilterTimeForFallingEdge = 0
                  TimChFilterTimeForRisingEdge = 0
                  TimChannelFilterEnable = 0
                TimChannelGeneral:
                  TimChannelAruEnable = 0
                  TimChannelClockSelect = GTM_CONFIGURABLE_CLOCK_0
                  TimChannelCntsInputSelect = CNT_VALUE
                  TimChannelCntsValue = 0
                  TimChannelEcntOvflwSetting = SEL0_OVRFLOW_SIG_ON_ECNT_BITWIDTH_8
                  TimChannelEcntResetSetting = SEL0_ECNT_IN_WRAP_AROUND_MODE
                  TimChannelEnable = 0
                  TimChannelExtCaptureModeEnable = 0
                  TimChannelExtCaptureSrc = SEL0_NEW_VAL_IRQ
                  TimChannelGpr0InputSelect = TIMEBASE_TBU_TS0
                  TimChannelGpr1InputSelect = TIMEBASE_TBU_TS0
                  TimChannelInputSelect = INPUT_OF_CURRENT_TIM_CHANNEL
                  TimChannelModeSelect = PWM_MEASUREMENT_MODE_TPWM
                  TimChannelOneShotMode = 0
                  TimChannelPortPinSelect = NONE_SEL0
                  TimChannelSignalEdgeSelect = FALLING_EDGE
                  TimChannelTbu0Ts0BitsSelect = BITS_0_TO_23
                  TimChannelUsage = USED_BY_OTHER_DRIVERS_OR_UNUSED
                  TimChannelValInitSignal = VAL_LOW
                TimChannelInterrupt:
                  TimInterruptEnableOnCntOfl = 0
                  TimInterruptEnableOnEcntOfl = 0
                  TimInterruptEnableOnGlitchDet = 0
                  TimInterruptEnableOnGprxOfl = 0
                  TimInterruptEnableOnNewVal = 0
                  TimInterruptEnableOnToDet = 0
                  TimInterruptMode = GTM_INTERRUPT_LEVEL_MODE
                  TimNotification = NULL_PTR
                TimChannelTimeoutDetection: TimChTimeoutClockSelect=GTM_CONFIGURABLE_CLOCK_0, TimChTimeoutDetectionEnable=SEL0_TIMOUT_DISABLED, TimChTimeoutDuration=0
              TimChannel_7
                TimChannelErrorInterrupt:
                  TimInterruptEnableOnCntOflErr = 0
                  TimInterruptEnableOnEcntOflErr = 0
                  TimInterruptEnableOnGlitchDetErr = 0
                  TimInterruptEnableOnGprxOflErr = 0
                  TimInterruptEnableOnNewValErr = 0
                  TimInterruptEnableOnToDetErr = 0
                TimChannelFilterConfig:
                  TimChFilterCounterFreqSelect = GTM_CONFIGURABLE_CLOCK_0
                  TimChFilterModeForFallingEdge = IMMEDIATE_EDGE_PROPAGATION_MODE
                  TimChFilterModeForRisingEdge = IMMEDIATE_EDGE_PROPAGATION_MODE
                  TimChFilterTimeForFallingEdge = 0
                  TimChFilterTimeForRisingEdge = 0
                  TimChannelFilterEnable = 0
                TimChannelGeneral:
                  TimChannelAruEnable = 0
                  TimChannelClockSelect = GTM_CONFIGURABLE_CLOCK_0
                  TimChannelCntsInputSelect = CNT_VALUE
                  TimChannelCntsValue = 0
                  TimChannelEcntOvflwSetting = SEL0_OVRFLOW_SIG_ON_ECNT_BITWIDTH_8
                  TimChannelEcntResetSetting = SEL0_ECNT_IN_WRAP_AROUND_MODE
                  TimChannelEnable = 0
                  TimChannelExtCaptureModeEnable = 0
                  TimChannelExtCaptureSrc = SEL0_NEW_VAL_IRQ
                  TimChannelGpr0InputSelect = TIMEBASE_TBU_TS0
                  TimChannelGpr1InputSelect = TIMEBASE_TBU_TS0
                  TimChannelInputSelect = INPUT_OF_CURRENT_TIM_CHANNEL
                  TimChannelModeSelect = PWM_MEASUREMENT_MODE_TPWM
                  TimChannelOneShotMode = 0
                  TimChannelPortPinSelect = NONE_SEL0
                  TimChannelSignalEdgeSelect = FALLING_EDGE
                  TimChannelTbu0Ts0BitsSelect = BITS_0_TO_23
                  TimChannelUsage = USED_BY_OTHER_DRIVERS_OR_UNUSED
                  TimChannelValInitSignal = VAL_LOW
                TimChannelInterrupt:
                  TimInterruptEnableOnCntOfl = 0
                  TimInterruptEnableOnEcntOfl = 0
                  TimInterruptEnableOnGlitchDet = 0
                  TimInterruptEnableOnGprxOfl = 0
                  TimInterruptEnableOnNewVal = 0
                  TimInterruptEnableOnToDet = 0
                  TimInterruptMode = GTM_INTERRUPT_LEVEL_MODE
                  TimNotification = NULL_PTR
                TimChannelTimeoutDetection: TimChTimeoutClockSelect=GTM_CONFIGURABLE_CLOCK_0, TimChTimeoutDetectionEnable=SEL0_TIMOUT_DISABLED, TimChTimeoutDuration=0
          Tim_2
            8 x TimChannel:
              TimChannel_0
                TimChannelErrorInterrupt:
                  TimInterruptEnableOnCntOflErr = 0
                  TimInterruptEnableOnEcntOflErr = 0
                  TimInterruptEnableOnGlitchDetErr = 0
                  TimInterruptEnableOnGprxOflErr = 0
                  TimInterruptEnableOnNewValErr = 0
                  TimInterruptEnableOnToDetErr = 0
                TimChannelFilterConfig:
                  TimChFilterCounterFreqSelect = GTM_CONFIGURABLE_CLOCK_0
                  TimChFilterModeForFallingEdge = IMMEDIATE_EDGE_PROPAGATION_MODE
                  TimChFilterModeForRisingEdge = IMMEDIATE_EDGE_PROPAGATION_MODE
                  TimChFilterTimeForFallingEdge = 0
                  TimChFilterTimeForRisingEdge = 0
                  TimChannelFilterEnable = 0
                TimChannelGeneral:
                  TimChannelAruEnable = 0
                  TimChannelClockSelect = GTM_CONFIGURABLE_CLOCK_0
                  TimChannelCntsInputSelect = CNT_VALUE
                  TimChannelCntsValue = 0
                  TimChannelEcntOvflwSetting = SEL0_OVRFLOW_SIG_ON_ECNT_BITWIDTH_8
                  TimChannelEcntResetSetting = SEL0_ECNT_IN_WRAP_AROUND_MODE
                  TimChannelEnable = 0
                  TimChannelExtCaptureModeEnable = 0
                  TimChannelExtCaptureSrc = SEL0_NEW_VAL_IRQ
                  TimChannelGpr0InputSelect = TIMEBASE_TBU_TS0
                  TimChannelGpr1InputSelect = TIMEBASE_TBU_TS0
                  TimChannelInputSelect = INPUT_OF_CURRENT_TIM_CHANNEL
                  TimChannelModeSelect = PWM_MEASUREMENT_MODE_TPWM
                  TimChannelOneShotMode = 0
                  TimChannelPortPinSelect = NONE_SEL0
                  TimChannelSignalEdgeSelect = FALLING_EDGE
                  TimChannelTbu0Ts0BitsSelect = BITS_0_TO_23
                  TimChannelUsage = USED_BY_OTHER_DRIVERS_OR_UNUSED
                  TimChannelValInitSignal = VAL_LOW
                TimChannelInterrupt:
                  TimInterruptEnableOnCntOfl = 0
                  TimInterruptEnableOnEcntOfl = 0
                  TimInterruptEnableOnGlitchDet = 0
                  TimInterruptEnableOnGprxOfl = 0
                  TimInterruptEnableOnNewVal = 0
                  TimInterruptEnableOnToDet = 0
                  TimInterruptMode = GTM_INTERRUPT_LEVEL_MODE
                  TimNotification = NULL_PTR
                TimChannelTimeoutDetection: TimChTimeoutClockSelect=GTM_CONFIGURABLE_CLOCK_0, TimChTimeoutDetectionEnable=SEL0_TIMOUT_DISABLED, TimChTimeoutDuration=0
              TimChannel_1
                TimChannelErrorInterrupt:
                  TimInterruptEnableOnCntOflErr = 0
                  TimInterruptEnableOnEcntOflErr = 0
                  TimInterruptEnableOnGlitchDetErr = 0
                  TimInterruptEnableOnGprxOflErr = 0
                  TimInterruptEnableOnNewValErr = 0
                  TimInterruptEnableOnToDetErr = 0
                TimChannelFilterConfig:
                  TimChFilterCounterFreqSelect = GTM_CONFIGURABLE_CLOCK_0
                  TimChFilterModeForFallingEdge = IMMEDIATE_EDGE_PROPAGATION_MODE
                  TimChFilterModeForRisingEdge = IMMEDIATE_EDGE_PROPAGATION_MODE
                  TimChFilterTimeForFallingEdge = 0
                  TimChFilterTimeForRisingEdge = 0
                  TimChannelFilterEnable = 0
                TimChannelGeneral:
                  TimChannelAruEnable = 0
                  TimChannelClockSelect = GTM_CONFIGURABLE_CLOCK_0
                  TimChannelCntsInputSelect = CNT_VALUE
                  TimChannelCntsValue = 0
                  TimChannelEcntOvflwSetting = SEL0_OVRFLOW_SIG_ON_ECNT_BITWIDTH_8
                  TimChannelEcntResetSetting = SEL0_ECNT_IN_WRAP_AROUND_MODE
                  TimChannelEnable = 0
                  TimChannelExtCaptureModeEnable = 0
                  TimChannelExtCaptureSrc = SEL0_NEW_VAL_IRQ
                  TimChannelGpr0InputSelect = TIMEBASE_TBU_TS0
                  TimChannelGpr1InputSelect = TIMEBASE_TBU_TS0
                  TimChannelInputSelect = INPUT_OF_CURRENT_TIM_CHANNEL
                  TimChannelModeSelect = PWM_MEASUREMENT_MODE_TPWM
                  TimChannelOneShotMode = 0
                  TimChannelPortPinSelect = NONE_SEL0
                  TimChannelSignalEdgeSelect = FALLING_EDGE
                  TimChannelTbu0Ts0BitsSelect = BITS_0_TO_23
                  TimChannelUsage = USED_BY_OTHER_DRIVERS_OR_UNUSED
                  TimChannelValInitSignal = VAL_LOW
                TimChannelInterrupt:
                  TimInterruptEnableOnCntOfl = 0
                  TimInterruptEnableOnEcntOfl = 0
                  TimInterruptEnableOnGlitchDet = 0
                  TimInterruptEnableOnGprxOfl = 0
                  TimInterruptEnableOnNewVal = 0
                  TimInterruptEnableOnToDet = 0
                  TimInterruptMode = GTM_INTERRUPT_LEVEL_MODE
                  TimNotification = NULL_PTR
                TimChannelTimeoutDetection: TimChTimeoutClockSelect=GTM_CONFIGURABLE_CLOCK_0, TimChTimeoutDetectionEnable=SEL0_TIMOUT_DISABLED, TimChTimeoutDuration=0
              TimChannel_2
                TimChannelErrorInterrupt:
                  TimInterruptEnableOnCntOflErr = 0
                  TimInterruptEnableOnEcntOflErr = 0
                  TimInterruptEnableOnGlitchDetErr = 0
                  TimInterruptEnableOnGprxOflErr = 0
                  TimInterruptEnableOnNewValErr = 0
                  TimInterruptEnableOnToDetErr = 0
                TimChannelFilterConfig:
                  TimChFilterCounterFreqSelect = GTM_CONFIGURABLE_CLOCK_0
                  TimChFilterModeForFallingEdge = IMMEDIATE_EDGE_PROPAGATION_MODE
                  TimChFilterModeForRisingEdge = IMMEDIATE_EDGE_PROPAGATION_MODE
                  TimChFilterTimeForFallingEdge = 0
                  TimChFilterTimeForRisingEdge = 0
                  TimChannelFilterEnable = 0
                TimChannelGeneral:
                  TimChannelAruEnable = 0
                  TimChannelClockSelect = GTM_CONFIGURABLE_CLOCK_0
                  TimChannelCntsInputSelect = CNT_VALUE
                  TimChannelCntsValue = 0
                  TimChannelEcntOvflwSetting = SEL0_OVRFLOW_SIG_ON_ECNT_BITWIDTH_8
                  TimChannelEcntResetSetting = SEL0_ECNT_IN_WRAP_AROUND_MODE
                  TimChannelEnable = 0
                  TimChannelExtCaptureModeEnable = 0
                  TimChannelExtCaptureSrc = SEL0_NEW_VAL_IRQ
                  TimChannelGpr0InputSelect = TIMEBASE_TBU_TS0
                  TimChannelGpr1InputSelect = TIMEBASE_TBU_TS0
                  TimChannelInputSelect = INPUT_OF_CURRENT_TIM_CHANNEL
                  TimChannelModeSelect = PWM_MEASUREMENT_MODE_TPWM
                  TimChannelOneShotMode = 0
                  TimChannelPortPinSelect = NONE_SEL0
                  TimChannelSignalEdgeSelect = FALLING_EDGE
                  TimChannelTbu0Ts0BitsSelect = BITS_0_TO_23
                  TimChannelUsage = USED_BY_OTHER_DRIVERS_OR_UNUSED
                  TimChannelValInitSignal = VAL_LOW
                TimChannelInterrupt:
                  TimInterruptEnableOnCntOfl = 0
                  TimInterruptEnableOnEcntOfl = 0
                  TimInterruptEnableOnGlitchDet = 0
                  TimInterruptEnableOnGprxOfl = 0
                  TimInterruptEnableOnNewVal = 0
                  TimInterruptEnableOnToDet = 0
                  TimInterruptMode = GTM_INTERRUPT_LEVEL_MODE
                  TimNotification = NULL_PTR
                TimChannelTimeoutDetection: TimChTimeoutClockSelect=GTM_CONFIGURABLE_CLOCK_0, TimChTimeoutDetectionEnable=SEL0_TIMOUT_DISABLED, TimChTimeoutDuration=0
              TimChannel_3
                TimChannelErrorInterrupt:
                  TimInterruptEnableOnCntOflErr = 0
                  TimInterruptEnableOnEcntOflErr = 0
                  TimInterruptEnableOnGlitchDetErr = 0
                  TimInterruptEnableOnGprxOflErr = 0
                  TimInterruptEnableOnNewValErr = 0
                  TimInterruptEnableOnToDetErr = 0
                TimChannelFilterConfig:
                  TimChFilterCounterFreqSelect = GTM_CONFIGURABLE_CLOCK_0
                  TimChFilterModeForFallingEdge = IMMEDIATE_EDGE_PROPAGATION_MODE
                  TimChFilterModeForRisingEdge = IMMEDIATE_EDGE_PROPAGATION_MODE
                  TimChFilterTimeForFallingEdge = 0
                  TimChFilterTimeForRisingEdge = 0
                  TimChannelFilterEnable = 0
                TimChannelGeneral:
                  TimChannelAruEnable = 0
                  TimChannelClockSelect = GTM_CONFIGURABLE_CLOCK_0
                  TimChannelCntsInputSelect = CNT_VALUE
                  TimChannelCntsValue = 0
                  TimChannelEcntOvflwSetting = SEL0_OVRFLOW_SIG_ON_ECNT_BITWIDTH_8
                  TimChannelEcntResetSetting = SEL0_ECNT_IN_WRAP_AROUND_MODE
                  TimChannelEnable = 0
                  TimChannelExtCaptureModeEnable = 0
                  TimChannelExtCaptureSrc = SEL0_NEW_VAL_IRQ
                  TimChannelGpr0InputSelect = TIMEBASE_TBU_TS0
                  TimChannelGpr1InputSelect = TIMEBASE_TBU_TS0
                  TimChannelInputSelect = INPUT_OF_CURRENT_TIM_CHANNEL
                  TimChannelModeSelect = PWM_MEASUREMENT_MODE_TPWM
                  TimChannelOneShotMode = 0
                  TimChannelPortPinSelect = NONE_SEL0
                  TimChannelSignalEdgeSelect = FALLING_EDGE
                  TimChannelTbu0Ts0BitsSelect = BITS_0_TO_23
                  TimChannelUsage = USED_BY_OTHER_DRIVERS_OR_UNUSED
                  TimChannelValInitSignal = VAL_LOW
                TimChannelInterrupt:
                  TimInterruptEnableOnCntOfl = 0
                  TimInterruptEnableOnEcntOfl = 0
                  TimInterruptEnableOnGlitchDet = 0
                  TimInterruptEnableOnGprxOfl = 0
                  TimInterruptEnableOnNewVal = 0
                  TimInterruptEnableOnToDet = 0
                  TimInterruptMode = GTM_INTERRUPT_LEVEL_MODE
                  TimNotification = NULL_PTR
                TimChannelTimeoutDetection: TimChTimeoutClockSelect=GTM_CONFIGURABLE_CLOCK_0, TimChTimeoutDetectionEnable=SEL0_TIMOUT_DISABLED, TimChTimeoutDuration=0
              TimChannel_4
                TimChannelErrorInterrupt:
                  TimInterruptEnableOnCntOflErr = 0
                  TimInterruptEnableOnEcntOflErr = 0
                  TimInterruptEnableOnGlitchDetErr = 0
                  TimInterruptEnableOnGprxOflErr = 0
                  TimInterruptEnableOnNewValErr = 0
                  TimInterruptEnableOnToDetErr = 0
                TimChannelFilterConfig:
                  TimChFilterCounterFreqSelect = GTM_CONFIGURABLE_CLOCK_0
                  TimChFilterModeForFallingEdge = IMMEDIATE_EDGE_PROPAGATION_MODE
                  TimChFilterModeForRisingEdge = IMMEDIATE_EDGE_PROPAGATION_MODE
                  TimChFilterTimeForFallingEdge = 0
                  TimChFilterTimeForRisingEdge = 0
                  TimChannelFilterEnable = 0
                TimChannelGeneral:
                  TimChannelAruEnable = 0
                  TimChannelClockSelect = GTM_CONFIGURABLE_CLOCK_0
                  TimChannelCntsInputSelect = CNT_VALUE
                  TimChannelCntsValue = 0
                  TimChannelEcntOvflwSetting = SEL0_OVRFLOW_SIG_ON_ECNT_BITWIDTH_8
                  TimChannelEcntResetSetting = SEL0_ECNT_IN_WRAP_AROUND_MODE
                  TimChannelEnable = 0
                  TimChannelExtCaptureModeEnable = 0
                  TimChannelExtCaptureSrc = SEL0_NEW_VAL_IRQ
                  TimChannelGpr0InputSelect = TIMEBASE_TBU_TS0
                  TimChannelGpr1InputSelect = TIMEBASE_TBU_TS0
                  TimChannelInputSelect = INPUT_OF_CURRENT_TIM_CHANNEL
                  TimChannelModeSelect = PWM_MEASUREMENT_MODE_TPWM
                  TimChannelOneShotMode = 0
                  TimChannelPortPinSelect = NONE_SEL0
                  TimChannelSignalEdgeSelect = FALLING_EDGE
                  TimChannelTbu0Ts0BitsSelect = BITS_0_TO_23
                  TimChannelUsage = USED_BY_OTHER_DRIVERS_OR_UNUSED
                  TimChannelValInitSignal = VAL_LOW
                TimChannelInterrupt:
                  TimInterruptEnableOnCntOfl = 0
                  TimInterruptEnableOnEcntOfl = 0
                  TimInterruptEnableOnGlitchDet = 0
                  TimInterruptEnableOnGprxOfl = 0
                  TimInterruptEnableOnNewVal = 0
                  TimInterruptEnableOnToDet = 0
                  TimInterruptMode = GTM_INTERRUPT_LEVEL_MODE
                  TimNotification = NULL_PTR
                TimChannelTimeoutDetection: TimChTimeoutClockSelect=GTM_CONFIGURABLE_CLOCK_0, TimChTimeoutDetectionEnable=SEL0_TIMOUT_DISABLED, TimChTimeoutDuration=0
              TimChannel_5
                TimChannelErrorInterrupt:
                  TimInterruptEnableOnCntOflErr = 0
                  TimInterruptEnableOnEcntOflErr = 0
                  TimInterruptEnableOnGlitchDetErr = 0
                  TimInterruptEnableOnGprxOflErr = 0
                  TimInterruptEnableOnNewValErr = 0
                  TimInterruptEnableOnToDetErr = 0
                TimChannelFilterConfig:
                  TimChFilterCounterFreqSelect = GTM_CONFIGURABLE_CLOCK_0
                  TimChFilterModeForFallingEdge = IMMEDIATE_EDGE_PROPAGATION_MODE
                  TimChFilterModeForRisingEdge = IMMEDIATE_EDGE_PROPAGATION_MODE
                  TimChFilterTimeForFallingEdge = 0
                  TimChFilterTimeForRisingEdge = 0
                  TimChannelFilterEnable = 0
                TimChannelGeneral:
                  TimChannelAruEnable = 0
                  TimChannelClockSelect = GTM_CONFIGURABLE_CLOCK_0
                  TimChannelCntsInputSelect = CNT_VALUE
                  TimChannelCntsValue = 0
                  TimChannelEcntOvflwSetting = SEL0_OVRFLOW_SIG_ON_ECNT_BITWIDTH_8
                  TimChannelEcntResetSetting = SEL0_ECNT_IN_WRAP_AROUND_MODE
                  TimChannelEnable = 0
                  TimChannelExtCaptureModeEnable = 0
                  TimChannelExtCaptureSrc = SEL0_NEW_VAL_IRQ
                  TimChannelGpr0InputSelect = TIMEBASE_TBU_TS0
                  TimChannelGpr1InputSelect = TIMEBASE_TBU_TS0
                  TimChannelInputSelect = INPUT_OF_CURRENT_TIM_CHANNEL
                  TimChannelModeSelect = PWM_MEASUREMENT_MODE_TPWM
                  TimChannelOneShotMode = 0
                  TimChannelPortPinSelect = NONE_SEL0
                  TimChannelSignalEdgeSelect = FALLING_EDGE
                  TimChannelTbu0Ts0BitsSelect = BITS_0_TO_23
                  TimChannelUsage = USED_BY_OTHER_DRIVERS_OR_UNUSED
                  TimChannelValInitSignal = VAL_LOW
                TimChannelInterrupt:
                  TimInterruptEnableOnCntOfl = 0
                  TimInterruptEnableOnEcntOfl = 0
                  TimInterruptEnableOnGlitchDet = 0
                  TimInterruptEnableOnGprxOfl = 0
                  TimInterruptEnableOnNewVal = 0
                  TimInterruptEnableOnToDet = 0
                  TimInterruptMode = GTM_INTERRUPT_LEVEL_MODE
                  TimNotification = NULL_PTR
                TimChannelTimeoutDetection: TimChTimeoutClockSelect=GTM_CONFIGURABLE_CLOCK_0, TimChTimeoutDetectionEnable=SEL0_TIMOUT_DISABLED, TimChTimeoutDuration=0
              TimChannel_6
                TimChannelErrorInterrupt:
                  TimInterruptEnableOnCntOflErr = 0
                  TimInterruptEnableOnEcntOflErr = 0
                  TimInterruptEnableOnGlitchDetErr = 0
                  TimInterruptEnableOnGprxOflErr = 0
                  TimInterruptEnableOnNewValErr = 0
                  TimInterruptEnableOnToDetErr = 0
                TimChannelFilterConfig:
                  TimChFilterCounterFreqSelect = GTM_CONFIGURABLE_CLOCK_0
                  TimChFilterModeForFallingEdge = IMMEDIATE_EDGE_PROPAGATION_MODE
                  TimChFilterModeForRisingEdge = IMMEDIATE_EDGE_PROPAGATION_MODE
                  TimChFilterTimeForFallingEdge = 0
                  TimChFilterTimeForRisingEdge = 0
                  TimChannelFilterEnable = 0
                TimChannelGeneral:
                  TimChannelAruEnable = 0
                  TimChannelClockSelect = GTM_CONFIGURABLE_CLOCK_0
                  TimChannelCntsInputSelect = CNT_VALUE
                  TimChannelCntsValue = 0
                  TimChannelEcntOvflwSetting = SEL0_OVRFLOW_SIG_ON_ECNT_BITWIDTH_8
                  TimChannelEcntResetSetting = SEL0_ECNT_IN_WRAP_AROUND_MODE
                  TimChannelEnable = 0
                  TimChannelExtCaptureModeEnable = 0
                  TimChannelExtCaptureSrc = SEL0_NEW_VAL_IRQ
                  TimChannelGpr0InputSelect = TIMEBASE_TBU_TS0
                  TimChannelGpr1InputSelect = TIMEBASE_TBU_TS0
                  TimChannelInputSelect = INPUT_OF_CURRENT_TIM_CHANNEL
                  TimChannelModeSelect = PWM_MEASUREMENT_MODE_TPWM
                  TimChannelOneShotMode = 0
                  TimChannelPortPinSelect = NONE_SEL0
                  TimChannelSignalEdgeSelect = FALLING_EDGE
                  TimChannelTbu0Ts0BitsSelect = BITS_0_TO_23
                  TimChannelUsage = USED_BY_OTHER_DRIVERS_OR_UNUSED
                  TimChannelValInitSignal = VAL_LOW
                TimChannelInterrupt:
                  TimInterruptEnableOnCntOfl = 0
                  TimInterruptEnableOnEcntOfl = 0
                  TimInterruptEnableOnGlitchDet = 0
                  TimInterruptEnableOnGprxOfl = 0
                  TimInterruptEnableOnNewVal = 0
                  TimInterruptEnableOnToDet = 0
                  TimInterruptMode = GTM_INTERRUPT_LEVEL_MODE
                  TimNotification = NULL_PTR
                TimChannelTimeoutDetection: TimChTimeoutClockSelect=GTM_CONFIGURABLE_CLOCK_0, TimChTimeoutDetectionEnable=SEL0_TIMOUT_DISABLED, TimChTimeoutDuration=0
              TimChannel_7
                TimChannelErrorInterrupt:
                  TimInterruptEnableOnCntOflErr = 0
                  TimInterruptEnableOnEcntOflErr = 0
                  TimInterruptEnableOnGlitchDetErr = 0
                  TimInterruptEnableOnGprxOflErr = 0
                  TimInterruptEnableOnNewValErr = 0
                  TimInterruptEnableOnToDetErr = 0
                TimChannelFilterConfig:
                  TimChFilterCounterFreqSelect = GTM_CONFIGURABLE_CLOCK_0
                  TimChFilterModeForFallingEdge = IMMEDIATE_EDGE_PROPAGATION_MODE
                  TimChFilterModeForRisingEdge = IMMEDIATE_EDGE_PROPAGATION_MODE
                  TimChFilterTimeForFallingEdge = 0
                  TimChFilterTimeForRisingEdge = 0
                  TimChannelFilterEnable = 0
                TimChannelGeneral:
                  TimChannelAruEnable = 0
                  TimChannelClockSelect = GTM_CONFIGURABLE_CLOCK_0
                  TimChannelCntsInputSelect = CNT_VALUE
                  TimChannelCntsValue = 0
                  TimChannelEcntOvflwSetting = SEL0_OVRFLOW_SIG_ON_ECNT_BITWIDTH_8
                  TimChannelEcntResetSetting = SEL0_ECNT_IN_WRAP_AROUND_MODE
                  TimChannelEnable = 0
                  TimChannelExtCaptureModeEnable = 0
                  TimChannelExtCaptureSrc = SEL0_NEW_VAL_IRQ
                  TimChannelGpr0InputSelect = TIMEBASE_TBU_TS0
                  TimChannelGpr1InputSelect = TIMEBASE_TBU_TS0
                  TimChannelInputSelect = INPUT_OF_CURRENT_TIM_CHANNEL
                  TimChannelModeSelect = PWM_MEASUREMENT_MODE_TPWM
                  TimChannelOneShotMode = 0
                  TimChannelPortPinSelect = NONE_SEL0
                  TimChannelSignalEdgeSelect = FALLING_EDGE
                  TimChannelTbu0Ts0BitsSelect = BITS_0_TO_23
                  TimChannelUsage = USED_BY_OTHER_DRIVERS_OR_UNUSED
                  TimChannelValInitSignal = VAL_LOW
                TimChannelInterrupt:
                  TimInterruptEnableOnCntOfl = 0
                  TimInterruptEnableOnEcntOfl = 0
                  TimInterruptEnableOnGlitchDet = 0
                  TimInterruptEnableOnGprxOfl = 0
                  TimInterruptEnableOnNewVal = 0
                  TimInterruptEnableOnToDet = 0
                  TimInterruptMode = GTM_INTERRUPT_LEVEL_MODE
                  TimNotification = NULL_PTR
                TimChannelTimeoutDetection: TimChTimeoutClockSelect=GTM_CONFIGURABLE_CLOCK_0, TimChTimeoutDetectionEnable=SEL0_TIMOUT_DISABLED, TimChTimeoutDuration=0
          Tim_3
            8 x TimChannel:
              TimChannel_0
                TimChannelErrorInterrupt:
                  TimInterruptEnableOnCntOflErr = 0
                  TimInterruptEnableOnEcntOflErr = 0
                  TimInterruptEnableOnGlitchDetErr = 0
                  TimInterruptEnableOnGprxOflErr = 0
                  TimInterruptEnableOnNewValErr = 0
                  TimInterruptEnableOnToDetErr = 0
                TimChannelFilterConfig:
                  TimChFilterCounterFreqSelect = GTM_CONFIGURABLE_CLOCK_0
                  TimChFilterModeForFallingEdge = IMMEDIATE_EDGE_PROPAGATION_MODE
                  TimChFilterModeForRisingEdge = IMMEDIATE_EDGE_PROPAGATION_MODE
                  TimChFilterTimeForFallingEdge = 0
                  TimChFilterTimeForRisingEdge = 0
                  TimChannelFilterEnable = 0
                TimChannelGeneral:
                  TimChannelAruEnable = 0
                  TimChannelClockSelect = GTM_CONFIGURABLE_CLOCK_0
                  TimChannelCntsInputSelect = CNT_VALUE
                  TimChannelCntsValue = 0
                  TimChannelEcntOvflwSetting = SEL0_OVRFLOW_SIG_ON_ECNT_BITWIDTH_8
                  TimChannelEcntResetSetting = SEL0_ECNT_IN_WRAP_AROUND_MODE
                  TimChannelEnable = 0
                  TimChannelExtCaptureModeEnable = 0
                  TimChannelExtCaptureSrc = SEL0_NEW_VAL_IRQ
                  TimChannelGpr0InputSelect = TIMEBASE_TBU_TS0
                  TimChannelGpr1InputSelect = TIMEBASE_TBU_TS0
                  TimChannelInputSelect = INPUT_OF_CURRENT_TIM_CHANNEL
                  TimChannelModeSelect = PWM_MEASUREMENT_MODE_TPWM
                  TimChannelOneShotMode = 0
                  TimChannelPortPinSelect = NONE_SEL0
                  TimChannelSignalEdgeSelect = FALLING_EDGE
                  TimChannelTbu0Ts0BitsSelect = BITS_0_TO_23
                  TimChannelUsage = USED_BY_OTHER_DRIVERS_OR_UNUSED
                  TimChannelValInitSignal = VAL_LOW
                TimChannelInterrupt:
                  TimInterruptEnableOnCntOfl = 0
                  TimInterruptEnableOnEcntOfl = 0
                  TimInterruptEnableOnGlitchDet = 0
                  TimInterruptEnableOnGprxOfl = 0
                  TimInterruptEnableOnNewVal = 0
                  TimInterruptEnableOnToDet = 0
                  TimInterruptMode = GTM_INTERRUPT_LEVEL_MODE
                  TimNotification = NULL_PTR
                TimChannelTimeoutDetection: TimChTimeoutClockSelect=GTM_CONFIGURABLE_CLOCK_0, TimChTimeoutDetectionEnable=SEL0_TIMOUT_DISABLED, TimChTimeoutDuration=0
              TimChannel_1
                TimChannelErrorInterrupt:
                  TimInterruptEnableOnCntOflErr = 0
                  TimInterruptEnableOnEcntOflErr = 0
                  TimInterruptEnableOnGlitchDetErr = 0
                  TimInterruptEnableOnGprxOflErr = 0
                  TimInterruptEnableOnNewValErr = 0
                  TimInterruptEnableOnToDetErr = 0
                TimChannelFilterConfig:
                  TimChFilterCounterFreqSelect = GTM_CONFIGURABLE_CLOCK_0
                  TimChFilterModeForFallingEdge = IMMEDIATE_EDGE_PROPAGATION_MODE
                  TimChFilterModeForRisingEdge = IMMEDIATE_EDGE_PROPAGATION_MODE
                  TimChFilterTimeForFallingEdge = 0
                  TimChFilterTimeForRisingEdge = 0
                  TimChannelFilterEnable = 0
                TimChannelGeneral:
                  TimChannelAruEnable = 0
                  TimChannelClockSelect = GTM_CONFIGURABLE_CLOCK_0
                  TimChannelCntsInputSelect = CNT_VALUE
                  TimChannelCntsValue = 0
                  TimChannelEcntOvflwSetting = SEL0_OVRFLOW_SIG_ON_ECNT_BITWIDTH_8
                  TimChannelEcntResetSetting = SEL0_ECNT_IN_WRAP_AROUND_MODE
                  TimChannelEnable = 0
                  TimChannelExtCaptureModeEnable = 0
                  TimChannelExtCaptureSrc = SEL0_NEW_VAL_IRQ
                  TimChannelGpr0InputSelect = TIMEBASE_TBU_TS0
                  TimChannelGpr1InputSelect = TIMEBASE_TBU_TS0
                  TimChannelInputSelect = INPUT_OF_CURRENT_TIM_CHANNEL
                  TimChannelModeSelect = PWM_MEASUREMENT_MODE_TPWM
                  TimChannelOneShotMode = 0
                  TimChannelPortPinSelect = NONE_SEL0
                  TimChannelSignalEdgeSelect = FALLING_EDGE
                  TimChannelTbu0Ts0BitsSelect = BITS_0_TO_23
                  TimChannelUsage = USED_BY_OTHER_DRIVERS_OR_UNUSED
                  TimChannelValInitSignal = VAL_LOW
                TimChannelInterrupt:
                  TimInterruptEnableOnCntOfl = 0
                  TimInterruptEnableOnEcntOfl = 0
                  TimInterruptEnableOnGlitchDet = 0
                  TimInterruptEnableOnGprxOfl = 0
                  TimInterruptEnableOnNewVal = 0
                  TimInterruptEnableOnToDet = 0
                  TimInterruptMode = GTM_INTERRUPT_LEVEL_MODE
                  TimNotification = NULL_PTR
                TimChannelTimeoutDetection: TimChTimeoutClockSelect=GTM_CONFIGURABLE_CLOCK_0, TimChTimeoutDetectionEnable=SEL0_TIMOUT_DISABLED, TimChTimeoutDuration=0
              TimChannel_2
                TimChannelErrorInterrupt:
                  TimInterruptEnableOnCntOflErr = 0
                  TimInterruptEnableOnEcntOflErr = 0
                  TimInterruptEnableOnGlitchDetErr = 0
                  TimInterruptEnableOnGprxOflErr = 0
                  TimInterruptEnableOnNewValErr = 0
                  TimInterruptEnableOnToDetErr = 0
                TimChannelFilterConfig:
                  TimChFilterCounterFreqSelect = GTM_CONFIGURABLE_CLOCK_0
                  TimChFilterModeForFallingEdge = IMMEDIATE_EDGE_PROPAGATION_MODE
                  TimChFilterModeForRisingEdge = IMMEDIATE_EDGE_PROPAGATION_MODE
                  TimChFilterTimeForFallingEdge = 0
                  TimChFilterTimeForRisingEdge = 0
                  TimChannelFilterEnable = 0
                TimChannelGeneral:
                  TimChannelAruEnable = 0
                  TimChannelClockSelect = GTM_CONFIGURABLE_CLOCK_0
                  TimChannelCntsInputSelect = CNT_VALUE
                  TimChannelCntsValue = 0
                  TimChannelEcntOvflwSetting = SEL0_OVRFLOW_SIG_ON_ECNT_BITWIDTH_8
                  TimChannelEcntResetSetting = SEL0_ECNT_IN_WRAP_AROUND_MODE
                  TimChannelEnable = 0
                  TimChannelExtCaptureModeEnable = 0
                  TimChannelExtCaptureSrc = SEL0_NEW_VAL_IRQ
                  TimChannelGpr0InputSelect = TIMEBASE_TBU_TS0
                  TimChannelGpr1InputSelect = TIMEBASE_TBU_TS0
                  TimChannelInputSelect = INPUT_OF_CURRENT_TIM_CHANNEL
                  TimChannelModeSelect = PWM_MEASUREMENT_MODE_TPWM
                  TimChannelOneShotMode = 0
                  TimChannelPortPinSelect = NONE_SEL0
                  TimChannelSignalEdgeSelect = FALLING_EDGE
                  TimChannelTbu0Ts0BitsSelect = BITS_0_TO_23
                  TimChannelUsage = USED_BY_OTHER_DRIVERS_OR_UNUSED
                  TimChannelValInitSignal = VAL_LOW
                TimChannelInterrupt:
                  TimInterruptEnableOnCntOfl = 0
                  TimInterruptEnableOnEcntOfl = 0
                  TimInterruptEnableOnGlitchDet = 0
                  TimInterruptEnableOnGprxOfl = 0
                  TimInterruptEnableOnNewVal = 0
                  TimInterruptEnableOnToDet = 0
                  TimInterruptMode = GTM_INTERRUPT_LEVEL_MODE
                  TimNotification = NULL_PTR
                TimChannelTimeoutDetection: TimChTimeoutClockSelect=GTM_CONFIGURABLE_CLOCK_0, TimChTimeoutDetectionEnable=SEL0_TIMOUT_DISABLED, TimChTimeoutDuration=0
              TimChannel_3
                TimChannelErrorInterrupt:
                  TimInterruptEnableOnCntOflErr = 0
                  TimInterruptEnableOnEcntOflErr = 0
                  TimInterruptEnableOnGlitchDetErr = 0
                  TimInterruptEnableOnGprxOflErr = 0
                  TimInterruptEnableOnNewValErr = 0
                  TimInterruptEnableOnToDetErr = 0
                TimChannelFilterConfig:
                  TimChFilterCounterFreqSelect = GTM_CONFIGURABLE_CLOCK_0
                  TimChFilterModeForFallingEdge = IMMEDIATE_EDGE_PROPAGATION_MODE
                  TimChFilterModeForRisingEdge = IMMEDIATE_EDGE_PROPAGATION_MODE
                  TimChFilterTimeForFallingEdge = 0
                  TimChFilterTimeForRisingEdge = 0
                  TimChannelFilterEnable = 0
                TimChannelGeneral:
                  TimChannelAruEnable = 0
                  TimChannelClockSelect = GTM_CONFIGURABLE_CLOCK_0
                  TimChannelCntsInputSelect = CNT_VALUE
                  TimChannelCntsValue = 0
                  TimChannelEcntOvflwSetting = SEL0_OVRFLOW_SIG_ON_ECNT_BITWIDTH_8
                  TimChannelEcntResetSetting = SEL0_ECNT_IN_WRAP_AROUND_MODE
                  TimChannelEnable = 0
                  TimChannelExtCaptureModeEnable = 0
                  TimChannelExtCaptureSrc = SEL0_NEW_VAL_IRQ
                  TimChannelGpr0InputSelect = TIMEBASE_TBU_TS0
                  TimChannelGpr1InputSelect = TIMEBASE_TBU_TS0
                  TimChannelInputSelect = INPUT_OF_CURRENT_TIM_CHANNEL
                  TimChannelModeSelect = PWM_MEASUREMENT_MODE_TPWM
                  TimChannelOneShotMode = 0
                  TimChannelPortPinSelect = NONE_SEL0
                  TimChannelSignalEdgeSelect = FALLING_EDGE
                  TimChannelTbu0Ts0BitsSelect = BITS_0_TO_23
                  TimChannelUsage = USED_BY_OTHER_DRIVERS_OR_UNUSED
                  TimChannelValInitSignal = VAL_LOW
                TimChannelInterrupt:
                  TimInterruptEnableOnCntOfl = 0
                  TimInterruptEnableOnEcntOfl = 0
                  TimInterruptEnableOnGlitchDet = 0
                  TimInterruptEnableOnGprxOfl = 0
                  TimInterruptEnableOnNewVal = 0
                  TimInterruptEnableOnToDet = 0
                  TimInterruptMode = GTM_INTERRUPT_LEVEL_MODE
                  TimNotification = NULL_PTR
                TimChannelTimeoutDetection: TimChTimeoutClockSelect=GTM_CONFIGURABLE_CLOCK_0, TimChTimeoutDetectionEnable=SEL0_TIMOUT_DISABLED, TimChTimeoutDuration=0
              TimChannel_4
                TimChannelErrorInterrupt:
                  TimInterruptEnableOnCntOflErr = 0
                  TimInterruptEnableOnEcntOflErr = 0
                  TimInterruptEnableOnGlitchDetErr = 0
                  TimInterruptEnableOnGprxOflErr = 0
                  TimInterruptEnableOnNewValErr = 0
                  TimInterruptEnableOnToDetErr = 0
                TimChannelFilterConfig:
                  TimChFilterCounterFreqSelect = GTM_CONFIGURABLE_CLOCK_0
                  TimChFilterModeForFallingEdge = IMMEDIATE_EDGE_PROPAGATION_MODE
                  TimChFilterModeForRisingEdge = IMMEDIATE_EDGE_PROPAGATION_MODE
                  TimChFilterTimeForFallingEdge = 0
                  TimChFilterTimeForRisingEdge = 0
                  TimChannelFilterEnable = 0
                TimChannelGeneral:
                  TimChannelAruEnable = 0
                  TimChannelClockSelect = GTM_CONFIGURABLE_CLOCK_0
                  TimChannelCntsInputSelect = CNT_VALUE
                  TimChannelCntsValue = 0
                  TimChannelEcntOvflwSetting = SEL0_OVRFLOW_SIG_ON_ECNT_BITWIDTH_8
                  TimChannelEcntResetSetting = SEL0_ECNT_IN_WRAP_AROUND_MODE
                  TimChannelEnable = 0
                  TimChannelExtCaptureModeEnable = 0
                  TimChannelExtCaptureSrc = SEL0_NEW_VAL_IRQ
                  TimChannelGpr0InputSelect = TIMEBASE_TBU_TS0
                  TimChannelGpr1InputSelect = TIMEBASE_TBU_TS0
                  TimChannelInputSelect = INPUT_OF_CURRENT_TIM_CHANNEL
                  TimChannelModeSelect = PWM_MEASUREMENT_MODE_TPWM
                  TimChannelOneShotMode = 0
                  TimChannelPortPinSelect = NONE_SEL0
                  TimChannelSignalEdgeSelect = FALLING_EDGE
                  TimChannelTbu0Ts0BitsSelect = BITS_0_TO_23
                  TimChannelUsage = USED_BY_OTHER_DRIVERS_OR_UNUSED
                  TimChannelValInitSignal = VAL_LOW
                TimChannelInterrupt:
                  TimInterruptEnableOnCntOfl = 0
                  TimInterruptEnableOnEcntOfl = 0
                  TimInterruptEnableOnGlitchDet = 0
                  TimInterruptEnableOnGprxOfl = 0
                  TimInterruptEnableOnNewVal = 0
                  TimInterruptEnableOnToDet = 0
                  TimInterruptMode = GTM_INTERRUPT_LEVEL_MODE
                  TimNotification = NULL_PTR
                TimChannelTimeoutDetection: TimChTimeoutClockSelect=GTM_CONFIGURABLE_CLOCK_0, TimChTimeoutDetectionEnable=SEL0_TIMOUT_DISABLED, TimChTimeoutDuration=0
              TimChannel_5
                TimChannelErrorInterrupt:
                  TimInterruptEnableOnCntOflErr = 0
                  TimInterruptEnableOnEcntOflErr = 0
                  TimInterruptEnableOnGlitchDetErr = 0
                  TimInterruptEnableOnGprxOflErr = 0
                  TimInterruptEnableOnNewValErr = 0
                  TimInterruptEnableOnToDetErr = 0
                TimChannelFilterConfig:
                  TimChFilterCounterFreqSelect = GTM_CONFIGURABLE_CLOCK_0
                  TimChFilterModeForFallingEdge = IMMEDIATE_EDGE_PROPAGATION_MODE
                  TimChFilterModeForRisingEdge = IMMEDIATE_EDGE_PROPAGATION_MODE
                  TimChFilterTimeForFallingEdge = 0
                  TimChFilterTimeForRisingEdge = 0
                  TimChannelFilterEnable = 0
                TimChannelGeneral:
                  TimChannelAruEnable = 0
                  TimChannelClockSelect = GTM_CONFIGURABLE_CLOCK_0
                  TimChannelCntsInputSelect = CNT_VALUE
                  TimChannelCntsValue = 0
                  TimChannelEcntOvflwSetting = SEL0_OVRFLOW_SIG_ON_ECNT_BITWIDTH_8
                  TimChannelEcntResetSetting = SEL0_ECNT_IN_WRAP_AROUND_MODE
                  TimChannelEnable = 0
                  TimChannelExtCaptureModeEnable = 0
                  TimChannelExtCaptureSrc = SEL0_NEW_VAL_IRQ
                  TimChannelGpr0InputSelect = TIMEBASE_TBU_TS0
                  TimChannelGpr1InputSelect = TIMEBASE_TBU_TS0
                  TimChannelInputSelect = INPUT_OF_CURRENT_TIM_CHANNEL
                  TimChannelModeSelect = PWM_MEASUREMENT_MODE_TPWM
                  TimChannelOneShotMode = 0
                  TimChannelPortPinSelect = NONE_SEL0
                  TimChannelSignalEdgeSelect = FALLING_EDGE
                  TimChannelTbu0Ts0BitsSelect = BITS_0_TO_23
                  TimChannelUsage = USED_BY_OTHER_DRIVERS_OR_UNUSED
                  TimChannelValInitSignal = VAL_LOW
                TimChannelInterrupt:
                  TimInterruptEnableOnCntOfl = 0
                  TimInterruptEnableOnEcntOfl = 0
                  TimInterruptEnableOnGlitchDet = 0
                  TimInterruptEnableOnGprxOfl = 0
                  TimInterruptEnableOnNewVal = 0
                  TimInterruptEnableOnToDet = 0
                  TimInterruptMode = GTM_INTERRUPT_LEVEL_MODE
                  TimNotification = NULL_PTR
                TimChannelTimeoutDetection: TimChTimeoutClockSelect=GTM_CONFIGURABLE_CLOCK_0, TimChTimeoutDetectionEnable=SEL0_TIMOUT_DISABLED, TimChTimeoutDuration=0
              TimChannel_6
                TimChannelErrorInterrupt:
                  TimInterruptEnableOnCntOflErr = 0
                  TimInterruptEnableOnEcntOflErr = 0
                  TimInterruptEnableOnGlitchDetErr = 0
                  TimInterruptEnableOnGprxOflErr = 0
                  TimInterruptEnableOnNewValErr = 0
                  TimInterruptEnableOnToDetErr = 0
                TimChannelFilterConfig:
                  TimChFilterCounterFreqSelect = GTM_CONFIGURABLE_CLOCK_0
                  TimChFilterModeForFallingEdge = IMMEDIATE_EDGE_PROPAGATION_MODE
                  TimChFilterModeForRisingEdge = IMMEDIATE_EDGE_PROPAGATION_MODE
                  TimChFilterTimeForFallingEdge = 0
                  TimChFilterTimeForRisingEdge = 0
                  TimChannelFilterEnable = 0
                TimChannelGeneral:
                  TimChannelAruEnable = 0
                  TimChannelClockSelect = GTM_CONFIGURABLE_CLOCK_0
                  TimChannelCntsInputSelect = CNT_VALUE
                  TimChannelCntsValue = 0
                  TimChannelEcntOvflwSetting = SEL0_OVRFLOW_SIG_ON_ECNT_BITWIDTH_8
                  TimChannelEcntResetSetting = SEL0_ECNT_IN_WRAP_AROUND_MODE
                  TimChannelEnable = 0
                  TimChannelExtCaptureModeEnable = 0
                  TimChannelExtCaptureSrc = SEL0_NEW_VAL_IRQ
                  TimChannelGpr0InputSelect = TIMEBASE_TBU_TS0
                  TimChannelGpr1InputSelect = TIMEBASE_TBU_TS0
                  TimChannelInputSelect = INPUT_OF_CURRENT_TIM_CHANNEL
                  TimChannelModeSelect = PWM_MEASUREMENT_MODE_TPWM
                  TimChannelOneShotMode = 0
                  TimChannelPortPinSelect = NONE_SEL0
                  TimChannelSignalEdgeSelect = FALLING_EDGE
                  TimChannelTbu0Ts0BitsSelect = BITS_0_TO_23
                  TimChannelUsage = USED_BY_OTHER_DRIVERS_OR_UNUSED
                  TimChannelValInitSignal = VAL_LOW
                TimChannelInterrupt:
                  TimInterruptEnableOnCntOfl = 0
                  TimInterruptEnableOnEcntOfl = 0
                  TimInterruptEnableOnGlitchDet = 0
                  TimInterruptEnableOnGprxOfl = 0
                  TimInterruptEnableOnNewVal = 0
                  TimInterruptEnableOnToDet = 0
                  TimInterruptMode = GTM_INTERRUPT_LEVEL_MODE
                  TimNotification = NULL_PTR
                TimChannelTimeoutDetection: TimChTimeoutClockSelect=GTM_CONFIGURABLE_CLOCK_0, TimChTimeoutDetectionEnable=SEL0_TIMOUT_DISABLED, TimChTimeoutDuration=0
              TimChannel_7
                TimChannelErrorInterrupt:
                  TimInterruptEnableOnCntOflErr = 0
                  TimInterruptEnableOnEcntOflErr = 0
                  TimInterruptEnableOnGlitchDetErr = 0
                  TimInterruptEnableOnGprxOflErr = 0
                  TimInterruptEnableOnNewValErr = 0
                  TimInterruptEnableOnToDetErr = 0
                TimChannelFilterConfig:
                  TimChFilterCounterFreqSelect = GTM_CONFIGURABLE_CLOCK_0
                  TimChFilterModeForFallingEdge = IMMEDIATE_EDGE_PROPAGATION_MODE
                  TimChFilterModeForRisingEdge = IMMEDIATE_EDGE_PROPAGATION_MODE
                  TimChFilterTimeForFallingEdge = 0
                  TimChFilterTimeForRisingEdge = 0
                  TimChannelFilterEnable = 0
                TimChannelGeneral:
                  TimChannelAruEnable = 0
                  TimChannelClockSelect = GTM_CONFIGURABLE_CLOCK_0
                  TimChannelCntsInputSelect = CNT_VALUE
                  TimChannelCntsValue = 0
                  TimChannelEcntOvflwSetting = SEL0_OVRFLOW_SIG_ON_ECNT_BITWIDTH_8
                  TimChannelEcntResetSetting = SEL0_ECNT_IN_WRAP_AROUND_MODE
                  TimChannelEnable = 0
                  TimChannelExtCaptureModeEnable = 0
                  TimChannelExtCaptureSrc = SEL0_NEW_VAL_IRQ
                  TimChannelGpr0InputSelect = TIMEBASE_TBU_TS0
                  TimChannelGpr1InputSelect = TIMEBASE_TBU_TS0
                  TimChannelInputSelect = INPUT_OF_CURRENT_TIM_CHANNEL
                  TimChannelModeSelect = PWM_MEASUREMENT_MODE_TPWM
                  TimChannelOneShotMode = 0
                  TimChannelPortPinSelect = NONE_SEL0
                  TimChannelSignalEdgeSelect = FALLING_EDGE
                  TimChannelTbu0Ts0BitsSelect = BITS_0_TO_23
                  TimChannelUsage = USED_BY_OTHER_DRIVERS_OR_UNUSED
                  TimChannelValInitSignal = VAL_LOW
                TimChannelInterrupt:
                  TimInterruptEnableOnCntOfl = 0
                  TimInterruptEnableOnEcntOfl = 0
                  TimInterruptEnableOnGlitchDet = 0
                  TimInterruptEnableOnGprxOfl = 0
                  TimInterruptEnableOnNewVal = 0
                  TimInterruptEnableOnToDet = 0
                  TimInterruptMode = GTM_INTERRUPT_LEVEL_MODE
                  TimNotification = NULL_PTR
                TimChannelTimeoutDetection: TimChTimeoutClockSelect=GTM_CONFIGURABLE_CLOCK_0, TimChTimeoutDetectionEnable=SEL0_TIMOUT_DISABLED, TimChTimeoutDuration=0
